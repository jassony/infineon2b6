/* generated by ASAP2 Studio 1.8.70.8381 */
/* @@@@ File written by CANAPE_VERSION 17 0 70 @@@@ */ ASAP2_VERSION 1 71
/begin PROJECT CYT2B6_XCP_M4_TEST "CYT2B6 M0 XCP server with M4 FOC measurements"
/begin HEADER "Minimal read-only XCP test A2L" VERSION "1.0" /end HEADER
/begin MODULE CYT2B6_M0_XCP "XCP server on M0, measurements in M4 SRAM"
/begin MOD_PAR "M4 SRAM addresses; address extension is zero"
 /begin MEMORY_SEGMENT XCP_CAL_TEST_RAM "" DATA RAM INTERN 0x8000800 0x20 -1 -1 -1 -1 -1 /end MEMORY_SEGMENT
/end MOD_PAR
/begin MOD_COMMON "" BYTE_ORDER MSB_LAST ALIGNMENT_BYTE 1 ALIGNMENT_WORD 2 ALIGNMENT_LONG 4 ALIGNMENT_FLOAT16_IEEE 1 ALIGNMENT_FLOAT32_IEEE 4 ALIGNMENT_FLOAT64_IEEE 1 ALIGNMENT_INT64 1 /end MOD_COMMON
/begin IF_DATA XCP
 /begin PROTOCOL_LAYER 0x0103 0x07D0 0x2710 0x00 0x00 0x00 0x00 0x00 0x08 0x08 BYTE_ORDER_MSB_LAST ADDRESS_GRANULARITY_BYTE OPTIONAL_CMD ALLOC_ODT_ENTRY OPTIONAL_CMD ALLOC_ODT OPTIONAL_CMD ALLOC_DAQ OPTIONAL_CMD FREE_DAQ OPTIONAL_CMD GET_DAQ_EVENT_INFO OPTIONAL_CMD GET_DAQ_RESOLUTION_INFO OPTIONAL_CMD GET_DAQ_PROCESSOR_INFO OPTIONAL_CMD START_STOP_SYNCH OPTIONAL_CMD START_STOP_DAQ_LIST OPTIONAL_CMD GET_DAQ_LIST_MODE OPTIONAL_CMD SET_DAQ_LIST_MODE OPTIONAL_CMD WRITE_DAQ OPTIONAL_CMD SET_DAQ_PTR OPTIONAL_CMD CLEAR_DAQ_LIST OPTIONAL_CMD DOWNLOAD OPTIONAL_CMD SHORT_UPLOAD OPTIONAL_CMD UPLOAD OPTIONAL_CMD SET_MTA OPTIONAL_CMD GET_COMM_MODE_INFO /end PROTOCOL_LAYER
 /begin DAQ DYNAMIC 0x00 0x04 0x00 OPTIMISATION_TYPE_DEFAULT ADDRESS_EXTENSION_FREE IDENTIFICATION_FIELD_TYPE_ABSOLUTE GRANULARITY_ODT_ENTRY_SIZE_DAQ_BYTE 0x07 NO_OVERLOAD_INDICATION /begin EVENT "Event_1ms" "Event_1ms" 0x00 DAQ 0x01 0x01 0x06 0x00 /end EVENT /begin EVENT "Event_2ms" "Event_2ms" 0x01 DAQ 0x01 0x02 0x06 0x00 /end EVENT /begin EVENT "Event_10ms" "Event_10m" 0x02 DAQ 0x01 0x01 0x07 0x00 /end EVENT /begin EVENT "Event_100ms" "Event_100" 0x03 DAQ 0x01 0x01 0x08 0x00 /end EVENT /end DAQ
 /begin PAG 0x01 /end PAG
 /begin PGM PGM_MODE_ABSOLUTE 0x00 0x00 /end PGM
 /begin XCP_ON_CAN 0x0100 CAN_ID_MASTER 0x98FF0010 CAN_ID_SLAVE 0x98FF0011 BAUDRATE 0x07A120 SAMPLE_RATE SINGLE SYNC_EDGE SINGLE SAMPLE_POINT 0x4B BTL_CYCLES 0x08 SJW 0x02 /end XCP_ON_CAN
/end IF_DATA
/begin CHARACTERISTIC FocDemoClosedLoop.modulator.p_forceDutyEnable "" VALUE 0x8008CDD __SBYTE_Z 0 NO_COMPU_METHOD -1 0 BIT_MASK 0x1 EXTENDED_LIMITS -128 127 /end CHARACTERISTIC
/begin CHARACTERISTIC FocDemoClosedLoop.modulator.p_forceDutyU "" VALUE 0x8008CDE __UWORD_Z 0 NO_COMPU_METHOD 0 65535 /end CHARACTERISTIC
/begin CHARACTERISTIC FocDemoClosedLoop.modulator.p_forceDutyV "" VALUE 0x8008CE0 __UWORD_Z 0 NO_COMPU_METHOD 0 65535 /end CHARACTERISTIC
/begin CHARACTERISTIC FocDemoClosedLoop.modulator.p_forceDutyW "" VALUE 0x8008CE2 __UWORD_Z 0 NO_COMPU_METHOD 0 65535 /end CHARACTERISTIC
/begin MEASUREMENT M4_ControlMode "0: VToF, 1: IToF or FOC" UBYTE NO_COMPU_METHOD 0 0 0 1 ECU_ADDRESS 0x80085CD FORMAT "%1.0" /end MEASUREMENT
/begin MEASUREMENT M4_EnableControl "FOC control enable request" UBYTE NO_COMPU_METHOD 0 0 0 1 ECU_ADDRESS 0x80085CC FORMAT "%1.0" /end MEASUREMENT
/begin MEASUREMENT M4_EnableDirectInterface "FOC direct interface enable request" UBYTE NO_COMPU_METHOD 0 0 0 1 ECU_ADDRESS 0x80085CE FORMAT "%1.0" /end MEASUREMENT
/begin MEASUREMENT M4_EnablePowerStage "FOC power stage enable request" UBYTE NO_COMPU_METHOD 0 0 0 1 ECU_ADDRESS 0x80085CB FORMAT "%1.0" /end MEASUREMENT
/begin MEASUREMENT M4_ReferenceSpeedQ0 "FOC reference speed in rpm" SWORD NO_COMPU_METHOD 0 0 -32768 32767 ECU_ADDRESS 0x80085D0 FORMAT "%6.0" /end MEASUREMENT
/begin MEASUREMENT M4_RotorAlignCounter "Remaining rotor alignment steps" UWORD NO_COMPU_METHOD 0 0 0 666 ECU_ADDRESS 0x80085D2 FORMAT "%6.0" /end MEASUREMENT
/begin MEASUREMENT XCP_CalibrationTest_Readback "Dedicated XCP calibration test value" UWORD NO_COMPU_METHOD 0 0 0 65535 ECU_ADDRESS 0x8000800 FORMAT "%5.0" /end MEASUREMENT
/begin CHARACTERISTIC XCP_CalibrationTest_Value "Writable XCP calibration test value" VALUE 0x8000800 __UWORD_S 0 NO_COMPU_METHOD 0 65535 FORMAT "%5.0" /end CHARACTERISTIC
/begin RECORD_LAYOUT SSV__A_INT64_S AXIS_PTS_X 1 A_INT64 INDEX_INCR DIRECT /end RECORD_LAYOUT
/begin RECORD_LAYOUT SSV__A_UINT64_S AXIS_PTS_X 1 A_UINT64 INDEX_INCR DIRECT /end RECORD_LAYOUT
/begin RECORD_LAYOUT SSV__FLOAT32_IEEE_S AXIS_PTS_X 1 FLOAT32_IEEE INDEX_INCR DIRECT /end RECORD_LAYOUT
/begin RECORD_LAYOUT SSV__FLOAT64_IEEE_S AXIS_PTS_X 1 FLOAT64_IEEE INDEX_INCR DIRECT /end RECORD_LAYOUT
/begin RECORD_LAYOUT SSV__SBYTE_S AXIS_PTS_X 1 SBYTE INDEX_INCR DIRECT /end RECORD_LAYOUT
/begin RECORD_LAYOUT SSV__SLONG_S AXIS_PTS_X 1 SLONG INDEX_INCR DIRECT /end RECORD_LAYOUT
/begin RECORD_LAYOUT SSV__SWORD_S AXIS_PTS_X 1 SWORD INDEX_INCR DIRECT /end RECORD_LAYOUT
/begin RECORD_LAYOUT SSV__UBYTE_S AXIS_PTS_X 1 UBYTE INDEX_INCR DIRECT /end RECORD_LAYOUT
/begin RECORD_LAYOUT SSV__ULONG_S AXIS_PTS_X 1 ULONG INDEX_INCR DIRECT /end RECORD_LAYOUT
/begin RECORD_LAYOUT SSV__UWORD_S AXIS_PTS_X 1 UWORD INDEX_INCR DIRECT /end RECORD_LAYOUT
/begin RECORD_LAYOUT __A_INT64_S FNC_VALUES 1 A_INT64 COLUMN_DIR DIRECT /end RECORD_LAYOUT
/begin RECORD_LAYOUT __A_INT64_Z FNC_VALUES 1 A_INT64 ROW_DIR DIRECT /end RECORD_LAYOUT
/begin RECORD_LAYOUT __A_UINT64_S FNC_VALUES 1 A_UINT64 COLUMN_DIR DIRECT /end RECORD_LAYOUT
/begin RECORD_LAYOUT __A_UINT64_Z FNC_VALUES 1 A_UINT64 ROW_DIR DIRECT /end RECORD_LAYOUT
/begin RECORD_LAYOUT __FLOAT32_IEEE_S FNC_VALUES 1 FLOAT32_IEEE COLUMN_DIR DIRECT /end RECORD_LAYOUT
/begin RECORD_LAYOUT __FLOAT32_IEEE_Z FNC_VALUES 1 FLOAT32_IEEE ROW_DIR DIRECT /end RECORD_LAYOUT
/begin RECORD_LAYOUT __FLOAT64_IEEE_S FNC_VALUES 1 FLOAT64_IEEE COLUMN_DIR DIRECT /end RECORD_LAYOUT
/begin RECORD_LAYOUT __FLOAT64_IEEE_Z FNC_VALUES 1 FLOAT64_IEEE ROW_DIR DIRECT /end RECORD_LAYOUT
/begin RECORD_LAYOUT __SBYTE_S FNC_VALUES 1 SBYTE COLUMN_DIR DIRECT /end RECORD_LAYOUT
/begin RECORD_LAYOUT __SBYTE_Z FNC_VALUES 1 SBYTE ROW_DIR DIRECT /end RECORD_LAYOUT
/begin RECORD_LAYOUT __SLONG_S FNC_VALUES 1 SLONG COLUMN_DIR DIRECT /end RECORD_LAYOUT
/begin RECORD_LAYOUT __SLONG_Z FNC_VALUES 1 SLONG ROW_DIR DIRECT /end RECORD_LAYOUT
/begin RECORD_LAYOUT __SWORD_S FNC_VALUES 1 SWORD COLUMN_DIR DIRECT /end RECORD_LAYOUT
/begin RECORD_LAYOUT __SWORD_Z FNC_VALUES 1 SWORD ROW_DIR DIRECT /end RECORD_LAYOUT
/begin RECORD_LAYOUT __UBYTE_S FNC_VALUES 1 UBYTE COLUMN_DIR DIRECT /end RECORD_LAYOUT
/begin RECORD_LAYOUT __UBYTE_Z FNC_VALUES 1 UBYTE ROW_DIR DIRECT /end RECORD_LAYOUT
/begin RECORD_LAYOUT __ULONG_S FNC_VALUES 1 ULONG COLUMN_DIR DIRECT /end RECORD_LAYOUT
/begin RECORD_LAYOUT __ULONG_Z FNC_VALUES 1 ULONG ROW_DIR DIRECT /end RECORD_LAYOUT
/begin RECORD_LAYOUT __UWORD_S FNC_VALUES 1 UWORD COLUMN_DIR DIRECT /end RECORD_LAYOUT
/begin RECORD_LAYOUT __UWORD_Z FNC_VALUES 1 UWORD ROW_DIR DIRECT /end RECORD_LAYOUT
/end MODULE
/end PROJECT
