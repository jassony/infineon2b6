/* generated by ASAP2 Studio 1.8.70.8381 */
/* @@@@ File written by CANAPE_VERSION 17 0 70 @@@@ */ ASAP2_VERSION 1 71
/begin PROJECT CYT2B6_XCP_M4_TEST "CYT2B6 M0 XCP server with M4 FOC measurements"
/begin HEADER "Minimal read-only XCP test A2L" VERSION "1.0" /end HEADER
/begin MODULE CYT2B6_M0_XCP "XCP server on M0, measurements in M4 SRAM"
/begin MOD_PAR "Fixed M0/M4 calibration windows; address extension is zero"
 /begin MEMORY_SEGMENT XCP_CAL_M0_RAM "" DATA RAM INTERN 0x8000800 0x100 -1 -1 -1 -1 -1 /end MEMORY_SEGMENT
 /begin MEMORY_SEGMENT XCP_CAL_M4_RAM "" DATA RAM INTERN 0x800D000 0x100 -1 -1 -1 -1 -1 /end MEMORY_SEGMENT
/end MOD_PAR
/begin MOD_COMMON "" BYTE_ORDER MSB_LAST ALIGNMENT_BYTE 1 ALIGNMENT_WORD 2 ALIGNMENT_LONG 4 ALIGNMENT_FLOAT16_IEEE 1 ALIGNMENT_FLOAT32_IEEE 4 ALIGNMENT_FLOAT64_IEEE 1 ALIGNMENT_INT64 1 /end MOD_COMMON
/begin IF_DATA XCP
 /begin PROTOCOL_LAYER 0x0103 0x1388 0x2710 0x00 0x00 0x00 0x00 0x00 0x08 0x08 BYTE_ORDER_MSB_LAST ADDRESS_GRANULARITY_BYTE OPTIONAL_CMD ALLOC_ODT_ENTRY OPTIONAL_CMD ALLOC_ODT OPTIONAL_CMD ALLOC_DAQ OPTIONAL_CMD FREE_DAQ OPTIONAL_CMD GET_DAQ_EVENT_INFO OPTIONAL_CMD GET_DAQ_RESOLUTION_INFO OPTIONAL_CMD GET_DAQ_PROCESSOR_INFO OPTIONAL_CMD START_STOP_SYNCH OPTIONAL_CMD START_STOP_DAQ_LIST OPTIONAL_CMD GET_DAQ_LIST_MODE OPTIONAL_CMD SET_DAQ_LIST_MODE OPTIONAL_CMD WRITE_DAQ OPTIONAL_CMD SET_DAQ_PTR OPTIONAL_CMD CLEAR_DAQ_LIST OPTIONAL_CMD DOWNLOAD OPTIONAL_CMD SHORT_UPLOAD OPTIONAL_CMD UPLOAD OPTIONAL_CMD SET_MTA OPTIONAL_CMD GET_COMM_MODE_INFO /end PROTOCOL_LAYER
 /begin DAQ DYNAMIC 0x00 0x04 0x00 OPTIMISATION_TYPE_DEFAULT ADDRESS_EXTENSION_FREE IDENTIFICATION_FIELD_TYPE_ABSOLUTE GRANULARITY_ODT_ENTRY_SIZE_DAQ_BYTE 0x07 NO_OVERLOAD_INDICATION /begin EVENT "Event_1ms" "Event_1ms" 0x00 DAQ 0x01 0x01 0x06 0x00 /end EVENT /begin EVENT "Event_2ms" "Event_2ms" 0x01 DAQ 0x01 0x02 0x06 0x00 /end EVENT /begin EVENT "Event_10ms" "Event_10m" 0x02 DAQ 0x01 0x01 0x07 0x00 /end EVENT /begin EVENT "Event_100ms" "Event_100" 0x03 DAQ 0x01 0x01 0x08 0x00 /end EVENT /end DAQ
 /begin PAG 0x02 /end PAG
 /begin PGM PGM_MODE_ABSOLUTE 0x00 0x00 /end PGM
 /begin XCP_ON_CAN 0x0100 CAN_ID_MASTER 0x98FF0010 CAN_ID_SLAVE 0x98FF0011 BAUDRATE 0x07A120 SAMPLE_RATE SINGLE SYNC_EDGE SINGLE SAMPLE_POINT 0x4B BTL_CYCLES 0x08 SJW 0x02 /end XCP_ON_CAN
/end IF_DATA
/begin CHARACTERISTIC CAL_PWM_forceDutyEnable_bool "" VALUE 0x8008A7D __SBYTE_S 0 NO_COMPU_METHOD 0 1 EXTENDED_LIMITS -128 127 FORMAT "%.15" SYMBOL_LINK "FocDemoClosedLoop.modulator.p_forceDutyEnable" 0 /end CHARACTERISTIC
/begin CHARACTERISTIC CAL_PWM_forceDutyU_percent "" VALUE 0x8008A7E __UWORD_S 0 NO_COMPU_METHOD 0 65535 FORMAT "%.15" SYMBOL_LINK "FocDemoClosedLoop.modulator.p_forceDutyU" 0 /end CHARACTERISTIC
/begin CHARACTERISTIC CAL_PWM_forceDutyV_percent "" VALUE 0x8008A80 __UWORD_S 0 NO_COMPU_METHOD 0 65535 FORMAT "%.15" SYMBOL_LINK "FocDemoClosedLoop.modulator.p_forceDutyV" 0 /end CHARACTERISTIC
/begin CHARACTERISTIC CAL_PWM_forceDutyW_percent "" VALUE 0x8008A82 __UWORD_S 0 NO_COMPU_METHOD 0 65535 FORMAT "%.15" SYMBOL_LINK "FocDemoClosedLoop.modulator.p_forceDutyW" 0 /end CHARACTERISTIC
/begin CHARACTERISTIC Cal_ADRC_Speed_ControlBandwidth_radps_f32 "" VALUE 0x800D29C __FLOAT32_IEEE_S 0 NO_COMPU_METHOD -3.40282346639E+38 3.40282346639E+38 FORMAT "%.15" /end CHARACTERISTIC
/begin CHARACTERISTIC Cal_ADRC_Speed_CriticalGain_PU_per_PU_s2_f32 "" VALUE 0x800D298 __FLOAT32_IEEE_S 0 NO_COMPU_METHOD -3.40282346639E+38 3.40282346639E+38 FORMAT "%.15" /end CHARACTERISTIC
/begin CHARACTERISTIC Cal_ADRC_Speed_IqLowerLimit_Q15_s16 "" VALUE 0x800D296 __SWORD_S 0 Foc_Q15_to_A -32768 32767 /end CHARACTERISTIC
/begin CHARACTERISTIC Cal_ADRC_Speed_IqUpperLimit_Q15_s16 "" VALUE 0x800D294 __SWORD_S 0 Foc_Q15_to_A -32768 32767 /end CHARACTERISTIC
/begin CHARACTERISTIC Cal_ADRC_Speed_ObserverBandwidth_radps_f32 "" VALUE 0x800D2A0 __FLOAT32_IEEE_S 0 NO_COMPU_METHOD -3.40282346639E+38 3.40282346639E+38 FORMAT "%.15" /end CHARACTERISTIC
/begin CHARACTERISTIC Cal_ADRC_Speed_Reset_u8 "" VALUE 0x800D28D __UBYTE_S 0 NO_COMPU_METHOD 0 255 FORMAT "%.15" /end CHARACTERISTIC
/begin CHARACTERISTIC Cal_ADRC_Speed_Selector_u8 "" VALUE 0x800D28C __UBYTE_S 0 NO_COMPU_METHOD 0 255 FORMAT "%.15" /end CHARACTERISTIC
/begin CHARACTERISTIC Cal_DiagBusCurCfmDelay_cnt_u16 "" VALUE 0x8001240 __UWORD_S 0 NO_COMPU_METHOD 0 65535 FORMAT "%.15" /end CHARACTERISTIC
/begin CHARACTERISTIC Cal_DiagBusCurTrip_dA_u16 "" VALUE 0x800123E __UWORD_S 0 NO_COMPU_METHOD 0 65535 FORMAT "%.15" /end CHARACTERISTIC
/begin CHARACTERISTIC Cal_DiagCanCommLostMonEn_u8 "" VALUE 0x800125F __UBYTE_S 0 NO_COMPU_METHOD 0 255 FORMAT "%.15" /end CHARACTERISTIC
/begin CHARACTERISTIC Cal_DiagCanCommLostTout_ms_u16 "" VALUE 0x8001222 __UWORD_S 0 NO_COMPU_METHOD 0 65535 FORMAT "%.15" /end CHARACTERISTIC
/begin CHARACTERISTIC Cal_DiagDcBusFltRecDelay_ms_u16 "" VALUE 0x8001228 __UWORD_S 0 NO_COMPU_METHOD 0 65535 FORMAT "%.15" /end CHARACTERISTIC
/begin CHARACTERISTIC Cal_DiagDcBusOvCfmDelay_ms_u16 "" VALUE 0x8001224 __UWORD_S 0 NO_COMPU_METHOD 0 65535 FORMAT "%.15" /end CHARACTERISTIC
/begin CHARACTERISTIC Cal_DiagDcBusOvRec_V_u16 "" VALUE 0x800122C __UWORD_S 0 NO_COMPU_METHOD 0 65535 FORMAT "%.15" /end CHARACTERISTIC
/begin CHARACTERISTIC Cal_DiagDcBusOvTrip_V_u16 "" VALUE 0x800122A __UWORD_S 0 NO_COMPU_METHOD 0 65535 FORMAT "%.15" /end CHARACTERISTIC
/begin CHARACTERISTIC Cal_DiagDcBusUvCfmDelay_ms_u16 "" VALUE 0x8001226 __UWORD_S 0 NO_COMPU_METHOD 0 65535 FORMAT "%.15" /end CHARACTERISTIC
/begin CHARACTERISTIC Cal_DiagDcBusUvDnSpd_rpm_u16 "" VALUE 0x8001230 __UWORD_S 0 NO_COMPU_METHOD 0 65535 FORMAT "%.15" /end CHARACTERISTIC
/begin CHARACTERISTIC Cal_DiagDcBusUvQkCfmDelay_ms_u16 "" VALUE 0x80069B4 __UWORD_S 0 NO_COMPU_METHOD 0 65535 FORMAT "%.15" /end CHARACTERISTIC
/begin CHARACTERISTIC Cal_DiagDcBusUvQkTrip_V_u16 "" VALUE 0x8001234 __UWORD_S 0 NO_COMPU_METHOD 0 65535 FORMAT "%.15" /end CHARACTERISTIC
/begin CHARACTERISTIC Cal_DiagDcBusUvRec_V_u16 "" VALUE 0x800122E __UWORD_S 0 NO_COMPU_METHOD 0 65535 FORMAT "%.15" /end CHARACTERISTIC
/begin CHARACTERISTIC Cal_DiagDcBusUvTrip_V_u16 "" VALUE 0x8001232 __UWORD_S 0 NO_COMPU_METHOD 0 65535 FORMAT "%.15" /end CHARACTERISTIC
/begin CHARACTERISTIC Cal_DiagDryBrnAutoRecLimit_cnt_u16 "" VALUE 0x8001220 __UWORD_S 0 NO_COMPU_METHOD 0 65535 FORMAT "%.15" /end CHARACTERISTIC
/begin CHARACTERISTIC Cal_DiagInTmpHys_degC_u16 "" VALUE 0x8001204 __UWORD_S 0 NO_COMPU_METHOD 0 65535 FORMAT "%.15" /end CHARACTERISTIC
/begin CHARACTERISTIC Cal_DiagInTmpTrip_degC_u16 "" VALUE 0x8001202 __UWORD_S 0 NO_COMPU_METHOD 0 65535 FORMAT "%.15" /end CHARACTERISTIC
/begin CHARACTERISTIC Cal_DiagMotStartMinSpd_rpm_u16 "" VALUE 0x80011E8 __UWORD_S 0 NO_COMPU_METHOD 0 65535 FORMAT "%.15" /end CHARACTERISTIC
/begin CHARACTERISTIC Cal_DiagOcAutoRecDelay_ms_u16 "" VALUE 0x80011EA __UWORD_S 0 NO_COMPU_METHOD 0 65535 FORMAT "%.15" /end CHARACTERISTIC
/begin CHARACTERISTIC Cal_DiagOcAutoRecLimit_cnt_u16 "" VALUE 0x80011EC __UWORD_S 0 NO_COMPU_METHOD 0 65535 FORMAT "%.15" /end CHARACTERISTIC
/begin CHARACTERISTIC Cal_DiagOcRstCntClrDelay_ms_u32 "" VALUE 0x800117C __ULONG_S 0 NO_COMPU_METHOD 0 4294967295 FORMAT "%.15" /end CHARACTERISTIC
/begin CHARACTERISTIC Cal_DiagOutTmpHys_degC_u16 "" VALUE 0x800120A __UWORD_S 0 NO_COMPU_METHOD 0 65535 FORMAT "%.15" /end CHARACTERISTIC
/begin CHARACTERISTIC Cal_DiagOutTmpPwrLim_degC_u16 "" VALUE 0x8001208 __UWORD_S 0 NO_COMPU_METHOD 0 65535 FORMAT "%.15" /end CHARACTERISTIC
/begin CHARACTERISTIC Cal_DiagOutTmpTrip_degC_u16 "" VALUE 0x8001206 __UWORD_S 0 NO_COMPU_METHOD 0 65535 FORMAT "%.15" /end CHARACTERISTIC
/begin CHARACTERISTIC Cal_DiagOvldCfmDelay_cnt_u16 "" VALUE 0x800125C __UWORD_S 0 NO_COMPU_METHOD 0 65535 FORMAT "%.15" /end CHARACTERISTIC
/begin CHARACTERISTIC Cal_DiagOvldEn_u8 "" VALUE 0x8001262 __UBYTE_S 0 NO_COMPU_METHOD 0 255 FORMAT "%.15" /end CHARACTERISTIC
/begin CHARACTERISTIC Cal_DiagOvldPhCurThd_A_u16 "" VALUE 0x800125A __UWORD_S 0 NO_COMPU_METHOD 0 65535 FORMAT "%.15" /end CHARACTERISTIC
/begin CHARACTERISTIC Cal_DiagOvldSpdThd_rpm_u16 "" VALUE 0x8001258 __UWORD_S 0 NO_COMPU_METHOD 0 65535 FORMAT "%.15" /end CHARACTERISTIC
/begin CHARACTERISTIC Cal_DiagPcbSicTmpHys_degC_u16 "" VALUE 0x80011FC __UWORD_S 0 NO_COMPU_METHOD 0 65535 FORMAT "%.15" /end CHARACTERISTIC
/begin CHARACTERISTIC Cal_DiagPcbSicTmpTrip_degC_u16 "" VALUE 0x80011FA __UWORD_S 0 NO_COMPU_METHOD 0 65535 FORMAT "%.15" /end CHARACTERISTIC
/begin CHARACTERISTIC Cal_DiagPhCurCfmDelay_cnt_u16 "" VALUE 0x8001238 __UWORD_S 0 NO_COMPU_METHOD 0 65535 FORMAT "%.15" /end CHARACTERISTIC
/begin CHARACTERISTIC Cal_DiagPhCurRmsEn_u8 "" VALUE 0x8001260 __UBYTE_S 0 NO_COMPU_METHOD 0 255 FORMAT "%.15" /end CHARACTERISTIC
/begin CHARACTERISTIC Cal_DiagPhCurTrip_A_u16 "" VALUE 0x8001236 __UWORD_S 0 NO_COMPU_METHOD 0 65535 FORMAT "%.15" /end CHARACTERISTIC
/begin CHARACTERISTIC Cal_DiagPhPkCurCfmDelay_cnt_u16 "" VALUE 0x800123C __UWORD_S 0 NO_COMPU_METHOD 0 65535 FORMAT "%.15" /end CHARACTERISTIC
/begin CHARACTERISTIC Cal_DiagPhPkCurEn_u8 "" VALUE 0x8001261 __UBYTE_S 0 NO_COMPU_METHOD 0 255 FORMAT "%.15" /end CHARACTERISTIC
/begin CHARACTERISTIC Cal_DiagPhPkCurTrip_A_u16 "" VALUE 0x800123A __UWORD_S 0 NO_COMPU_METHOD 0 65535 FORMAT "%.15" /end CHARACTERISTIC
/begin CHARACTERISTIC Cal_DiagPtcAdCurFltCfmDelay_ms_u16 "" VALUE 0x80011F2 __UWORD_S 0 NO_COMPU_METHOD 0 65535 FORMAT "%.15" /end CHARACTERISTIC
/begin CHARACTERISTIC Cal_DiagPtcAdCurMax_adc_u16 "" VALUE 0x8001216 __UWORD_S 0 NO_COMPU_METHOD 0 65535 FORMAT "%.15" /end CHARACTERISTIC
/begin CHARACTERISTIC Cal_DiagPtcAdCurMin_adc_u16 "" VALUE 0x8001214 __UWORD_S 0 NO_COMPU_METHOD 0 65535 FORMAT "%.15" /end CHARACTERISTIC
/begin CHARACTERISTIC Cal_DiagPtcHtProtCfmDelay_ms_u16 "" VALUE 0x80011F0 __UWORD_S 0 NO_COMPU_METHOD 0 65535 FORMAT "%.15" /end CHARACTERISTIC
/begin CHARACTERISTIC Cal_DiagPtcHtProtCur_dA_u16 "" VALUE 0x8001218 __UWORD_S 0 NO_COMPU_METHOD 0 65535 FORMAT "%.15" /end CHARACTERISTIC
/begin CHARACTERISTIC Cal_DiagPtcOcCurTrip_dA_u16 "" VALUE 0x8001212 __UWORD_S 0 NO_COMPU_METHOD 0 65535 FORMAT "%.15" /end CHARACTERISTIC
/begin CHARACTERISTIC Cal_DiagPtcOcFltCfmDelay_ms_u16 "" VALUE 0x80011EE __UWORD_S 0 NO_COMPU_METHOD 0 65535 FORMAT "%.15" /end CHARACTERISTIC
/begin CHARACTERISTIC Cal_DiagPtcPwrMax_pct_u16 "" VALUE 0x8001210 __UWORD_S 0 NO_COMPU_METHOD 0 65535 FORMAT "%.15" /end CHARACTERISTIC
/begin CHARACTERISTIC Cal_DiagPtcPwrMin_pct_u16 "" VALUE 0x80069B2 __UWORD_S 0 NO_COMPU_METHOD 0 65535 FORMAT "%.15" /end CHARACTERISTIC
/begin CHARACTERISTIC Cal_DiagPtcResFltCfmDelay_ms_u16 "" VALUE 0x80011F6 __UWORD_S 0 NO_COMPU_METHOD 0 65535 FORMAT "%.15" /end CHARACTERISTIC
/begin CHARACTERISTIC Cal_DiagPtcResHi_ohm_u16 "" VALUE 0x800121A __UWORD_S 0 NO_COMPU_METHOD 0 65535 FORMAT "%.15" /end CHARACTERISTIC
/begin CHARACTERISTIC Cal_DiagPtcResLo_ohm_u16 "" VALUE 0x800121C __UWORD_S 0 NO_COMPU_METHOD 0 65535 FORMAT "%.15" /end CHARACTERISTIC
/begin CHARACTERISTIC Cal_DiagPwrOvAutoRecLimit_cnt_u16 "" VALUE 0x8001248 __UWORD_S 0 NO_COMPU_METHOD 0 65535 FORMAT "%.15" /end CHARACTERISTIC
/begin CHARACTERISTIC Cal_DiagPwrOvDef_W_u16 "" VALUE 0x8001242 __UWORD_S 0 NO_COMPU_METHOD 0 65535 FORMAT "%.15" /end CHARACTERISTIC
/begin CHARACTERISTIC Cal_DiagPwrOvDnSpdEn_u8 "" VALUE 0x8006A20 __UBYTE_S 0 NO_COMPU_METHOD 0 255 FORMAT "%.15" /end CHARACTERISTIC
/begin CHARACTERISTIC Cal_DiagPwrOvEn_u8 "" VALUE 0x8001263 __UBYTE_S 0 NO_COMPU_METHOD 0 255 FORMAT "%.15" /end CHARACTERISTIC
/begin CHARACTERISTIC Cal_DiagPwrOvFltCfm_cnt_u16 "" VALUE 0x8001246 __UWORD_S 0 NO_COMPU_METHOD 0 65535 FORMAT "%.15" /end CHARACTERISTIC
/begin CHARACTERISTIC Cal_DiagPwrOvFltRstDelay_cnt_u16 "" VALUE 0x8001256 __UWORD_S 0 NO_COMPU_METHOD 0 65535 FORMAT "%.15" /end CHARACTERISTIC
/begin CHARACTERISTIC Cal_DiagPwrOvFltRstrtDelay_cnt_u16 "" VALUE 0x8001254 __UWORD_S 0 NO_COMPU_METHOD 0 65535 FORMAT "%.15" /end CHARACTERISTIC
/begin CHARACTERISTIC Cal_DiagPwrOvHys_W_u16 "" VALUE 0x8001244 __UWORD_S 0 NO_COMPU_METHOD 0 65535 FORMAT "%.15" /end CHARACTERISTIC
/begin CHARACTERISTIC Cal_DiagPwrOvMinSpd_rpm_u16 "" VALUE 0x8001252 __UWORD_S 0 NO_COMPU_METHOD 0 65535 FORMAT "%.15" /end CHARACTERISTIC
/begin CHARACTERISTIC Cal_DiagPwrOvSpdDirLock_cnt_u16 "" VALUE 0x800124E __UWORD_S 0 NO_COMPU_METHOD 0 65535 FORMAT "%.15" /end CHARACTERISTIC
/begin CHARACTERISTIC Cal_DiagPwrOvStepDn_rpmPer100ms_u16 "" VALUE 0x800124A __UWORD_S 0 NO_COMPU_METHOD 0 65535 FORMAT "%.15" /end CHARACTERISTIC
/begin CHARACTERISTIC Cal_DiagPwrOvStepUp_rpmPer100ms_u16 "" VALUE 0x800124C __UWORD_S 0 NO_COMPU_METHOD 0 65535 FORMAT "%.15" /end CHARACTERISTIC
/begin CHARACTERISTIC Cal_DiagPwrOvZ0ProbeCfm_cnt_u16 "" VALUE 0x8001250 __UWORD_S 0 NO_COMPU_METHOD 0 65535 FORMAT "%.15" /end CHARACTERISTIC
/begin CHARACTERISTIC Cal_DiagTfTmpAutoRecLimit_cnt_u16 "" VALUE 0x800121E __UWORD_S 0 NO_COMPU_METHOD 0 65535 FORMAT "%.15" /end CHARACTERISTIC
/begin CHARACTERISTIC Cal_DiagTfTmpHys_degC_u16 "" VALUE 0x8001200 __UWORD_S 0 NO_COMPU_METHOD 0 65535 FORMAT "%.15" /end CHARACTERISTIC
/begin CHARACTERISTIC Cal_DiagTfTmpTrip_degC_u16 "" VALUE 0x80011FE __UWORD_S 0 NO_COMPU_METHOD 0 65535 FORMAT "%.15" /end CHARACTERISTIC
/begin CHARACTERISTIC Cal_DiagTmpFltCfmDelay_ms_u16 "" VALUE 0x80011F4 __UWORD_S 0 NO_COMPU_METHOD 0 65535 FORMAT "%.15" /end CHARACTERISTIC
/begin CHARACTERISTIC Cal_DiagTmpFltRecDelay_ms_u16 "" VALUE 0x80011F8 __UWORD_S 0 NO_COMPU_METHOD 0 65535 FORMAT "%.15" /end CHARACTERISTIC
/begin CHARACTERISTIC Cal_DiagTmpSensMax_adc_u16 "" VALUE 0x800120C __UWORD_S 0 NO_COMPU_METHOD 0 65535 FORMAT "%.15" /end CHARACTERISTIC
/begin CHARACTERISTIC Cal_DiagTmpSensMin_adc_u16 "" VALUE 0x800120E __UWORD_S 0 NO_COMPU_METHOD 0 65535 FORMAT "%.15" /end CHARACTERISTIC
/begin CHARACTERISTIC Cal_FWC_CurAwGain_PU_f32 "" VALUE 0x800D030 __FLOAT32_IEEE_S 0 NO_COMPU_METHOD -3.40282346639E+38 3.40282346639E+38 FORMAT "%.15" /end CHARACTERISTIC
/begin CHARACTERISTIC Cal_FWC_Enable_u8 "" VALUE 0x800D000 __UBYTE_S 0 NO_COMPU_METHOD 0 255 FORMAT "%.15" /end CHARACTERISTIC
/begin CHARACTERISTIC Cal_FWC_Enter_ms_u16 "" VALUE 0x800D008 __UWORD_S 0 NO_COMPU_METHOD 0 65535 FORMAT "%.15" /end CHARACTERISTIC
/begin CHARACTERISTIC Cal_FWC_Exit_ms_u16 "" VALUE 0x800D00A __UWORD_S 0 NO_COMPU_METHOD 0 65535 FORMAT "%.15" /end CHARACTERISTIC
/begin CHARACTERISTIC Cal_FWC_Hyst_PU_f32 "" VALUE 0x800D038 __FLOAT32_IEEE_S 0 NO_COMPU_METHOD -3.40282346639E+38 3.40282346639E+38 FORMAT "%.15" /end CHARACTERISTIC
/begin CHARACTERISTIC Cal_FWC_IdDnRate_PUps_f32 "" VALUE 0x800D024 __FLOAT32_IEEE_S 0 NO_COMPU_METHOD -3.40282346639E+38 3.40282346639E+38 FORMAT "%.15" /end CHARACTERISTIC
/begin CHARACTERISTIC Cal_FWC_IdLo_Q15_s16 "" VALUE 0x800D016 __SWORD_S 0 Foc_Q15_to_A -32768 32767 FORMAT "%.15" /end CHARACTERISTIC
/begin CHARACTERISTIC Cal_FWC_IdUpRate_PUps_f32 "" VALUE 0x800D028 __FLOAT32_IEEE_S 0 NO_COMPU_METHOD -3.40282346639E+38 3.40282346639E+38 FORMAT "%.15" /end CHARACTERISTIC
/begin CHARACTERISTIC Cal_FWC_Ki_PUperPUs_f32 "" VALUE 0x800D020 __FLOAT32_IEEE_S 0 NO_COMPU_METHOD -3.40282346639E+38 3.40282346639E+38 FORMAT "%.15" /end CHARACTERISTIC
/begin CHARACTERISTIC Cal_FWC_Kp_PUperPU_f32 "" VALUE 0x800D01C __FLOAT32_IEEE_S 0 NO_COMPU_METHOD -3.40282346639E+38 3.40282346639E+38 FORMAT "%.15" /end CHARACTERISTIC
/begin CHARACTERISTIC Cal_FWC_LpfTau_ms_f32 "" VALUE 0x800D034 __FLOAT32_IEEE_S 0 NO_COMPU_METHOD -3.40282346639E+38 3.40282346639E+38 FORMAT "%.15" /end CHARACTERISTIC
/begin CHARACTERISTIC Cal_FWC_SatEps_PU_f32 "" VALUE 0x800D02C __FLOAT32_IEEE_S 0 NO_COMPU_METHOD -3.40282346639E+38 3.40282346639E+38 FORMAT "%.15" /end CHARACTERISTIC
/begin CHARACTERISTIC Cal_FWC_VutilTgt_PU_f32 "" VALUE 0x800D018 __FLOAT32_IEEE_S 0 NO_COMPU_METHOD -3.40282346639E+38 3.40282346639E+38 FORMAT "%.15" /end CHARACTERISTIC
/begin CHARACTERISTIC Cal_FocAlignmentCurrentD_Q15_s16 "" VALUE 0x800D25E __SWORD_S 0 Foc_Q15_to_A -32768 32767 /end CHARACTERISTIC
/begin CHARACTERISTIC Cal_FocAlignmentCurrentQ_Q15_s16 "" VALUE 0x800D260 __SWORD_S 0 Foc_Q15_to_A -32768 32767 /end CHARACTERISTIC
/begin CHARACTERISTIC Cal_FocAlignmentDuration_cnt_u16 "" VALUE 0x800D25A __UWORD_S 0 NO_COMPU_METHOD 0 65535 FORMAT "%.15" /end CHARACTERISTIC
/begin CHARACTERISTIC Cal_FocClosedLoopRampDownRate_Q30_s32 "FOC closed-loop speed ramp-down rate, Q30" VALUE 0x8008C44 __SLONG_S 0 Foc_Q32_to_rpss -2147483648 2147483647 FORMAT "%.15" SYMBOL_LINK "FocDemoClosedLoop.p_speedRampDownRateClosedLoopQ30" 0 /end CHARACTERISTIC
/begin CHARACTERISTIC Cal_FocClosedLoopRampUpRate_Q30_s32 "FOC closed-loop speed ramp-up rate, Q30" VALUE 0x8008C40 __SLONG_S 0 Foc_Q32_to_rpss -2147483648 2147483647 FORMAT "%.15" SYMBOL_LINK "FocDemoClosedLoop.p_speedRampUpRateClosedLoopQ30" 0 /end CHARACTERISTIC
/begin CHARACTERISTIC Cal_FocCommandSource_u8 "FOC command source: 0 = CAN, 1 = calibration" VALUE 0x80085C4 __UBYTE_S 0 NO_COMPU_METHOD 0 1 FORMAT "%.15" /end CHARACTERISTIC
/begin CHARACTERISTIC Cal_FocControlMode_u8 "FOC control mode: 0 = VToF, 1 = FOC" VALUE 0x80085C6 __UBYTE_S 0 NO_COMPU_METHOD 0 1 FORMAT "%.15" /end CHARACTERISTIC
/begin CHARACTERISTIC Cal_FocCurrentCommandD_Q15_s16 "FOC calibration D-axis current command, raw Q15" VALUE 0x80085DC __SWORD_S 0 NO_COMPU_METHOD -32768 32767 FORMAT "%.15" /end CHARACTERISTIC
/begin CHARACTERISTIC Cal_FocCurrentCommandIToFD_A_s16 "FOC IToF D-axis current command, A, observation" VALUE 0x8008BB4 __SWORD_S 0 Foc_Q15_to_A -32768 32767 SYMBOL_LINK "FocDemoClosedLoop.iToF.p_output.refCurrent.real" 0 /end CHARACTERISTIC
/begin CHARACTERISTIC Cal_FocCurrentCommandIToFQ_A_s16 "FOC IToF Q-axis current command, A, observation" VALUE 0x8008BB6 __SWORD_S 0 Foc_Q15_to_A -32768 32767 SYMBOL_LINK "FocDemoClosedLoop.iToF.p_output.refCurrent.imag" 0 /end CHARACTERISTIC
/begin CHARACTERISTIC Cal_FocCurrentCommandQ_Q15_s16 "FOC calibration Q-axis current command, raw Q15" VALUE 0x80085DE __SWORD_S 0 NO_COMPU_METHOD -32768 32767 FORMAT "%.15" /end CHARACTERISTIC
/begin CHARACTERISTIC Cal_FocCurrentDPiKawTs_Q_s16 "FOC D-axis current PI anti-windup gain multiplied by sampling time, internal Q format" VALUE 0x8008A2C __SWORD_S 0 NO_COMPU_METHOD -32768 32767 FORMAT "%.15" SYMBOL_LINK "FocDemoClosedLoop.focController.currentDPi.p_antiWindupGainSamplingTime.value" 0 /end CHARACTERISTIC
/begin CHARACTERISTIC Cal_FocCurrentDPiKiTs_Q_s16 "FOC D-axis current PI integral gain multiplied by sampling time, internal Q format" VALUE 0x8008A28 __SWORD_S 0 NO_COMPU_METHOD -32768 32767 FORMAT "%.15" SYMBOL_LINK "FocDemoClosedLoop.focController.currentDPi.p_integGainSamplingTime.value" 0 /end CHARACTERISTIC
/begin CHARACTERISTIC Cal_FocCurrentDPiKp_Q_s16 "FOC D-axis current PI proportional gain, internal Q format" VALUE 0x8008A30 __SWORD_S 0 NO_COMPU_METHOD -32768 32767 FORMAT "%.15" SYMBOL_LINK "FocDemoClosedLoop.focController.currentDPi.p_propGain.value" 0 /end CHARACTERISTIC
/begin CHARACTERISTIC Cal_FocCurrentDPiOutLowerLimit_Q15_s16 "FOC D-axis current PI output lower limit, Q15" VALUE 0x8008A36 __SWORD_S 0 NO_COMPU_METHOD -32768 32767 FORMAT "%.15" SYMBOL_LINK "FocDemoClosedLoop.focController.currentDPi.p_lowerLimit" 0 /end CHARACTERISTIC
/begin CHARACTERISTIC Cal_FocCurrentDPiOutUpperLimit_Q15_s16 "FOC D-axis current PI output upper limit, Q15" VALUE 0x8008A34 __SWORD_S 0 NO_COMPU_METHOD -32768 32767 FORMAT "%.15" SYMBOL_LINK "FocDemoClosedLoop.focController.currentDPi.p_upperLimit" 0 /end CHARACTERISTIC
/begin CHARACTERISTIC Cal_FocCurrentQPiKawTs_Q_s16 "FOC Q-axis current PI anti-windup gain multiplied by sampling time, internal Q format" VALUE 0x8008A48 __SWORD_S 0 NO_COMPU_METHOD -32768 32767 FORMAT "%.15" SYMBOL_LINK "FocDemoClosedLoop.focController.currentQPi.p_antiWindupGainSamplingTime.value" 0 /end CHARACTERISTIC
/begin CHARACTERISTIC Cal_FocCurrentQPiKiTs_Q_s16 "FOC Q-axis current PI integral gain multiplied by sampling time, internal Q format" VALUE 0x8008A44 __SWORD_S 0 NO_COMPU_METHOD -32768 32767 FORMAT "%.15" SYMBOL_LINK "FocDemoClosedLoop.focController.currentQPi.p_integGainSamplingTime.value" 0 /end CHARACTERISTIC
/begin CHARACTERISTIC Cal_FocCurrentQPiKp_Q_s16 "FOC Q-axis current PI proportional gain, internal Q format" VALUE 0x8008A4C __SWORD_S 0 NO_COMPU_METHOD -32768 32767 FORMAT "%.15" SYMBOL_LINK "FocDemoClosedLoop.focController.currentQPi.p_propGain.value" 0 /end CHARACTERISTIC
/begin CHARACTERISTIC Cal_FocCurrentQPiOutLowerLimit_Q15_s16 "FOC Q-axis current PI output lower limit, Q15" VALUE 0x8008A52 __SWORD_S 0 NO_COMPU_METHOD -32768 32767 FORMAT "%.15" SYMBOL_LINK "FocDemoClosedLoop.focController.currentQPi.p_lowerLimit" 0 /end CHARACTERISTIC
/begin CHARACTERISTIC Cal_FocCurrentQPiOutUpperLimit_Q15_s16 "FOC Q-axis current PI output upper limit, Q15" VALUE 0x8008A50 __SWORD_S 0 NO_COMPU_METHOD -32768 32767 FORMAT "%.15" SYMBOL_LINK "FocDemoClosedLoop.focController.currentQPi.p_upperLimit" 0 /end CHARACTERISTIC
/begin CHARACTERISTIC Cal_FocCurrentRingingTime_tick_s16 "FOC current-sense ringing time, timer ticks" VALUE 0x8008A72 __SWORD_S 0 NO_COMPU_METHOD -32768 32767 FORMAT "%.15" SYMBOL_LINK "FocDemoClosedLoop.modulator.p_currentMeasurement.p_ringingTime_tick" 0 /end CHARACTERISTIC
/begin CHARACTERISTIC Cal_FocDeadTime_tick_s16 "FOC modulator dead time, timer ticks" VALUE 0x8008A7A __SWORD_S 0 NO_COMPU_METHOD -32768 32767 FORMAT "%.15" SYMBOL_LINK "FocDemoClosedLoop.modulator.p_deadTime_tick" 0 /end CHARACTERISTIC
/begin CHARACTERISTIC Cal_FocDirectInterface_u8 "FOC direct DQ-current interface: 0 = speed loop, 1 = direct current" VALUE 0x80085C7 __UBYTE_S 0 NO_COMPU_METHOD 0 1 FORMAT "%.15" /end CHARACTERISTIC
/begin CHARACTERISTIC Cal_FocDriverDelay_tick_s16 "FOC gate-driver delay, timer ticks" VALUE 0x8008A74 __SWORD_S 0 NO_COMPU_METHOD -32768 32767 FORMAT "%.15" SYMBOL_LINK "FocDemoClosedLoop.modulator.p_currentMeasurement.p_driverDelay_tick" 0 /end CHARACTERISTIC
/begin CHARACTERISTIC Cal_FocEnable_u8 "FOC calibration enable: 0 = disable, 1 = enable" VALUE 0x80085C5 __UBYTE_S 0 NO_COMPU_METHOD 0 1 FORMAT "%.15" /end CHARACTERISTIC
/begin CHARACTERISTIC Cal_FocMeasurementTime_tick_s16 "FOC current measurement time, timer ticks" VALUE 0x8008A76 __SWORD_S 0 NO_COMPU_METHOD -32768 32767 FORMAT "%.15" SYMBOL_LINK "FocDemoClosedLoop.modulator.p_currentMeasurement.p_measurementTime_tick" 0 /end CHARACTERISTIC
/begin CHARACTERISTIC Cal_FocMinSenseTime_tick_s16 "FOC minimum current-sense time, timer ticks" VALUE 0x8008A8C __SWORD_S 0 NO_COMPU_METHOD -32768 32767 FORMAT "%.15" SYMBOL_LINK "FocDemoClosedLoop.modulator.p_minSenseTime_tick" 0 /end CHARACTERISTIC
/begin CHARACTERISTIC Cal_FocModulationMaxAmplitude_Q15_s16 "FOC modulator maximum voltage amplitude, Q15" VALUE 0x8008A8A __SWORD_S 0 NO_COMPU_METHOD -32768 32767 FORMAT "%.15" SYMBOL_LINK "FocDemoClosedLoop.modulator.p_maxAmplitudeQ15" 0 /end CHARACTERISTIC
/begin CHARACTERISTIC Cal_FocOpenLoopRampDownRate_Q30_s32 "FOC open-loop speed ramp-down rate, Q30" VALUE 0x8008C3C __SLONG_S 0 Foc_Q32_to_rpss -2147483648 2147483647 FORMAT "%.15" SYMBOL_LINK "FocDemoClosedLoop.p_speedRampDownRateOpenLoopQ30" 0 /end CHARACTERISTIC
/begin CHARACTERISTIC Cal_FocOpenLoopRampUpRate_Q30_s32 "FOC open-loop speed ramp-up rate, Q30" VALUE 0x8008C38 __SLONG_S 0 Foc_Q32_to_rpss -2147483648 2147483647 FORMAT "%.15" SYMBOL_LINK "FocDemoClosedLoop.p_speedRampUpRateOpenLoopQ30" 0 /end CHARACTERISTIC
/begin CHARACTERISTIC Cal_FocSpeedCommand_rpm_s16 "FOC calibration mechanical speed command, rpm" VALUE 0x80085DA __SWORD_S 0 NO_COMPU_METHOD -32768 32767 FORMAT "%.15" /end CHARACTERISTIC
/begin CHARACTERISTIC Cal_FocSpeedLowerLimit_Q15_s16 "FOC speed limiter lower limit, Q15" VALUE 0x8008BCA __SWORD_S 0 NO_COMPU_METHOD -32768 32767 FORMAT "%.15" SYMBOL_LINK "FocDemoClosedLoop.speedLimit.p_lowerLimit" 0 /end CHARACTERISTIC
/begin CHARACTERISTIC Cal_FocSpeedPiKawTs_Q_s16 "FOC speed PI anti-windup gain multiplied by sampling time, internal Q format" VALUE 0x8008BE0 __SWORD_S 0 NO_COMPU_METHOD -32768 32767 FORMAT "%.15" SYMBOL_LINK "FocDemoClosedLoop.speedPi.p_antiWindupGainSamplingTime.value" 0 /end CHARACTERISTIC
/begin CHARACTERISTIC Cal_FocSpeedPiKiTs_Q_s16 "FOC speed PI integral gain multiplied by sampling time, internal Q format" VALUE 0x8008BDC __SWORD_S 0 NO_COMPU_METHOD -32768 32767 FORMAT "%.15" SYMBOL_LINK "FocDemoClosedLoop.speedPi.p_integGainSamplingTime.value" 0 /end CHARACTERISTIC
/begin CHARACTERISTIC Cal_FocSpeedPiKp_Q_s16 "FOC speed PI proportional gain, internal Q format" VALUE 0x8008BE4 __SWORD_S 0 NO_COMPU_METHOD -32768 32767 FORMAT "%.15" SYMBOL_LINK "FocDemoClosedLoop.speedPi.p_propGain.value" 0 /end CHARACTERISTIC
/begin CHARACTERISTIC Cal_FocSpeedPiOutLowerLimit_Q15_s16 "FOC speed PI output lower limit, Q15" VALUE 0x8008BEA __SWORD_S 0 NO_COMPU_METHOD -32768 32767 FORMAT "%.15" SYMBOL_LINK "FocDemoClosedLoop.speedPi.p_lowerLimit" 0 /end CHARACTERISTIC
/begin CHARACTERISTIC Cal_FocSpeedPiOutUpperLimit_Q15_s16 "FOC speed PI output upper limit, Q15" VALUE 0x8008BE8 __SWORD_S 0 NO_COMPU_METHOD -32768 32767 FORMAT "%.15" SYMBOL_LINK "FocDemoClosedLoop.speedPi.p_upperLimit" 0 /end CHARACTERISTIC
/begin CHARACTERISTIC Cal_FocSpeedUpperLimit_Q15_s16 "FOC speed limiter upper limit, Q15" VALUE 0x8008BC8 __SWORD_S 0 NO_COMPU_METHOD -32768 32767 FORMAT "%.15" SYMBOL_LINK "FocDemoClosedLoop.speedLimit.p_upperLimit" 0 /end CHARACTERISTIC
/begin CHARACTERISTIC Cal_FocStartupMode_u8 "" VALUE 0x800D258 __UBYTE_S 0 NO_COMPU_METHOD 0 255 FORMAT "%.15" /end CHARACTERISTIC
/begin CHARACTERISTIC Cal_FocTransitionDownSpeed_Q15_s16 "FOC closed-loop to open-loop transition speed, Q15" VALUE 0x8008C4E __SWORD_S 0 Foc_Q15_to_rpm -32768 32767 FORMAT "%.15" SYMBOL_LINK "FocDemoClosedLoop.transitionSpeedDownQ15" 0 /end CHARACTERISTIC
/begin CHARACTERISTIC Cal_FocTransitionQCurrent_Q15_s16 "FOC Q-axis transition current, Q15" VALUE 0x8008C52 __SWORD_S 0 Foc_Q15_to_A -32768 32767 FORMAT "%.15" SYMBOL_LINK "FocDemoClosedLoop.p_qCurrentAtTransitionQ15" 0 /end CHARACTERISTIC
/begin CHARACTERISTIC Cal_FocTransitionUpSpeed_Q15_s16 "FOC open-loop to closed-loop transition speed, Q15" VALUE 0x8008C4C __SWORD_S 0 Foc_Q15_to_rpm -32768 32767 FORMAT "%.15" SYMBOL_LINK "FocDemoClosedLoop.transitionSpeedUpQ15" 0 /end CHARACTERISTIC
/begin AXIS_PTS Cal_IdMap_IqAxis_A_f32._0_ "" 0x800D144 NO_INPUT_QUANTITY SSV__FLOAT32_IEEE_S 0 NO_COMPU_METHOD 11 -3.40282346639E+38 3.40282346639E+38 DEPOSIT ABSOLUTE FORMAT "%.15" /end AXIS_PTS
/begin CHARACTERISTIC Cal_IdMap_IqFltAlpha_Q15_u16 "IdMap Iq-input LPF alpha, Q15" VALUE 0x800D1A0 __UWORD_S 0 IdMap_Q15_to_Alpha 0 32767 /end CHARACTERISTIC
/begin CHARACTERISTIC Cal_IdMap_IsFltAlpha_Q15_u16 "" VALUE 0x800D1A2 __UWORD_S 0 IdMap_Q15_to_Alpha 0 65535 /end CHARACTERISTIC
/begin AXIS_PTS Cal_IdMap_SpdAxis_rpm_f32._0_ "" 0x800D170 NO_INPUT_QUANTITY SSV__FLOAT32_IEEE_S 0 NO_COMPU_METHOD 11 -3.40282346639E+38 3.40282346639E+38 DEPOSIT ABSOLUTE FORMAT "%.15" /end AXIS_PTS
/begin CHARACTERISTIC Cal_IdMap_SpdFltAlpha_Q15_u16 "IdMap speed-input LPF alpha, Q15" VALUE 0x800D19E __UWORD_S 0 IdMap_Q15_to_Alpha 0 32767 /end CHARACTERISTIC
/begin CHARACTERISTIC Cal_IdMap_Table_Q15_s16._0_._0_ "Id map: X speed in rpm, Y Iq in A, value Id in A" MAP 0x800D050 __SWORD_S 0 Foc_Q15_to_A -32768 32767
 /begin AXIS_DESCR COM_AXIS NO_INPUT_QUANTITY NO_COMPU_METHOD 11 -3.40282346639E+38 3.40282346639E+38 AXIS_PTS_REF Cal_IdMap_SpdAxis_rpm_f32._0_ FORMAT "%.15" /end AXIS_DESCR
 /begin AXIS_DESCR COM_AXIS NO_INPUT_QUANTITY NO_COMPU_METHOD 11 -3.40282346639E+38 3.40282346639E+38 AXIS_PTS_REF Cal_IdMap_IqAxis_A_f32._0_ FORMAT "%.15" /end AXIS_DESCR
/end CHARACTERISTIC
/begin CHARACTERISTIC Cal_Kre_A_radps_f32 "" VALUE 0x800D1C0 __FLOAT32_IEEE_S 0 NO_COMPU_METHOD -3.40282346639E+38 3.40282346639E+38 FORMAT "%.15" /end CHARACTERISTIC
/begin CHARACTERISTIC Cal_Kre_Alpha_radps_f32 "" VALUE 0x800D1BC __FLOAT32_IEEE_S 0 NO_COMPU_METHOD -3.40282346639E+38 3.40282346639E+38 FORMAT "%.15" /end CHARACTERISTIC
/begin CHARACTERISTIC Cal_Kre_Gamma_f32 "" VALUE 0x800D1C4 __FLOAT32_IEEE_S 0 NO_COMPU_METHOD -3.40282346639E+38 3.40282346639E+38 FORMAT "%.15" /end CHARACTERISTIC
/begin CHARACTERISTIC Cal_Kre_PllBandwidth_Hz_f32 "" VALUE 0x800D1D0 __FLOAT32_IEEE_S 0 NO_COMPU_METHOD -3.40282346639E+38 3.40282346639E+38 FORMAT "%.15" /end CHARACTERISTIC
/begin CHARACTERISTIC Cal_Kre_PllDamping_f32 "" VALUE 0x800D1D4 __FLOAT32_IEEE_S 0 NO_COMPU_METHOD -3.40282346639E+38 3.40282346639E+38 FORMAT "%.15" /end CHARACTERISTIC
/begin CHARACTERISTIC Cal_Kre_SigmaEpsilon_Wb_f32 "" VALUE 0x800D1C8 __FLOAT32_IEEE_S 0 NO_COMPU_METHOD -3.40282346639E+38 3.40282346639E+38 FORMAT "%.15" /end CHARACTERISTIC
/begin CHARACTERISTIC Cal_Kre_SpeedFilter_Hz_f32 "" VALUE 0x800D1CC __FLOAT32_IEEE_S 0 NO_COMPU_METHOD -3.40282346639E+38 3.40282346639E+38 FORMAT "%.15" /end CHARACTERISTIC
/begin CHARACTERISTIC Cal_MAS_SampleOffset_tick_u16 "" VALUE 0x800D374 __UWORD_S 0 NO_COMPU_METHOD 0 65535 FORMAT "%.15" /end CHARACTERISTIC
/begin MEASUREMENT Cal_MTPA_AppliedPermanentMagnetFlux_mWb_u16 "" UWORD NO_COMPU_METHOD 0 0 0 65535 ECU_ADDRESS 0x800D272 FORMAT "%.15" /end MEASUREMENT
/begin CHARACTERISTIC Cal_MTPA_PermanentMagnetFlux_mWb_u16 "" VALUE 0x800D270 __UWORD_S 0 NO_COMPU_METHOD 0 65535 FORMAT "%.15" /end CHARACTERISTIC
/begin MEASUREMENT Cal_MotorAppliedDirectInductance_uH_u16 "Applied motor d-axis inductance in uH" UWORD NO_COMPU_METHOD 0 0 0 5619 ECU_ADDRESS 0x800D27C FORMAT "%5.0" /end MEASUREMENT
/begin MEASUREMENT Cal_MotorAppliedFluxInductance_Q15_s16 "Applied flux-estimator phase inductance in Q15" SWORD NO_COMPU_METHOD 0 0 0 32767 ECU_ADDRESS 0x800D282 FORMAT "%6.0" /end MEASUREMENT
/begin MEASUREMENT Cal_MotorAppliedFluxResistance_Q15_s16 "Applied flux-estimator phase resistance in Q15" SWORD NO_COMPU_METHOD 0 0 0 32767 ECU_ADDRESS 0x800D280 FORMAT "%6.0" /end MEASUREMENT
/begin MEASUREMENT Cal_MotorAppliedIToFAngleIncrement_Q14_s16 "Applied IToF electrical angle increment in Q14" SWORD NO_COMPU_METHOD 0 0 0 32767 ECU_ADDRESS 0x800D284 FORMAT "%6.0" /end MEASUREMENT
/begin MEASUREMENT Cal_MotorAppliedPhaseResistance_mOhm_u16 "Applied motor phase resistance in mOhm" UWORD NO_COMPU_METHOD 0 0 0 19999 ECU_ADDRESS 0x800D27A FORMAT "%5.0" /end MEASUREMENT
/begin MEASUREMENT Cal_MotorAppliedPolePairs_u8 "Applied motor pole pairs" UBYTE NO_COMPU_METHOD 0 0 0 255 ECU_ADDRESS 0x800D26E FORMAT "%3.0" /end MEASUREMENT
/begin MEASUREMENT Cal_MotorAppliedQuadratureInductance_uH_u16 "Applied motor q-axis inductance in uH" UWORD NO_COMPU_METHOD 0 0 0 5619 ECU_ADDRESS 0x800D27E FORMAT "%5.0" /end MEASUREMENT
/begin MEASUREMENT Cal_MotorAppliedSystemBaseTime_Q30_s32 "Applied flux-estimator system base time in Q30" SLONG NO_COMPU_METHOD 0 0 0 2147483647 ECU_ADDRESS 0x800D288 FORMAT "%10.0" /end MEASUREMENT
/begin MEASUREMENT Cal_MotorAppliedVToFAngleIncrement_Q14_s16 "Applied VToF electrical angle increment in Q14" SWORD NO_COMPU_METHOD 0 0 0 32767 ECU_ADDRESS 0x800D286 FORMAT "%6.0" /end MEASUREMENT
/begin CHARACTERISTIC Cal_MotorDirectInductance_uH_u16 "Motor d-axis inductance, source value in uH" VALUE 0x800D276 __UWORD_S 0 NO_COMPU_METHOD 0 5619 FORMAT "%5.0" /end CHARACTERISTIC
/begin MEASUREMENT Cal_MotorParameterStatus_u8 "0: applied, 1: rejected by fixed-Q range validation" UBYTE NO_COMPU_METHOD 0 0 0 1 ECU_ADDRESS 0x800D26D FORMAT "%1.0" /end MEASUREMENT
/begin CHARACTERISTIC Cal_MotorPhaseResistance_mOhm_u16 "Motor phase resistance, source value in mOhm" VALUE 0x800D274 __UWORD_S 0 NO_COMPU_METHOD 0 19999 FORMAT "%5.0" /end CHARACTERISTIC
/begin CHARACTERISTIC Cal_MotorPolePairs_u8 "Motor pole pairs, source value" VALUE 0x800D26C __UBYTE_S 0 NO_COMPU_METHOD 1 255 FORMAT "%3.0" /end CHARACTERISTIC
/begin CHARACTERISTIC Cal_MotorQuadratureInductance_uH_u16 "Motor q-axis inductance, source value in uH" VALUE 0x800D278 __UWORD_S 0 NO_COMPU_METHOD 0 5619 FORMAT "%5.0" /end CHARACTERISTIC
/begin CHARACTERISTIC Cal_PwrEst_DqLpfFc_Hz_f32 "" VALUE 0x800D230 __FLOAT32_IEEE_S 0 NO_COMPU_METHOD -3.40282346639E+38 3.40282346639E+38 FORMAT "%.15" /end CHARACTERISTIC
/begin CHARACTERISTIC Cal_PwrEst_KCu_unitless_f32 "" VALUE 0x800D204 __FLOAT32_IEEE_S 0 NO_COMPU_METHOD -3.40282346639E+38 3.40282346639E+38 FORMAT "%.15" /end CHARACTERISTIC
/begin CHARACTERISTIC Cal_PwrEst_KFe_unitless_f32 "" VALUE 0x800D208 __FLOAT32_IEEE_S 0 NO_COMPU_METHOD -3.40282346639E+38 3.40282346639E+38 FORMAT "%.15" /end CHARACTERISTIC
/begin CHARACTERISTIC Cal_PwrEst_KInvCond_unitless_f32 "" VALUE 0x800D20C __FLOAT32_IEEE_S 0 NO_COMPU_METHOD -3.40282346639E+38 3.40282346639E+38 FORMAT "%.15" /end CHARACTERISTIC
/begin CHARACTERISTIC Cal_PwrEst_KInvSw_unitless_f32 "" VALUE 0x800D210 __FLOAT32_IEEE_S 0 NO_COMPU_METHOD -3.40282346639E+38 3.40282346639E+38 FORMAT "%.15" /end CHARACTERISTIC
/begin CHARACTERISTIC Cal_PwrEst_PowerLpfFc_Hz_f32 "" VALUE 0x800D234 __FLOAT32_IEEE_S 0 NO_COMPU_METHOD -3.40282346639E+38 3.40282346639E+38 FORMAT "%.15" /end CHARACTERISTIC
/begin CHARACTERISTIC Cal_RRCDOB_Lead_us_u16 "" VALUE 0x800D378 __UWORD_Z 0 NO_COMPU_METHOD 0 65535 /end CHARACTERISTIC
/begin CHARACTERISTIC Cal_RRCDOB_OutHi_Q15_s16 "" VALUE 0x800D382 __SWORD_S 0 NO_COMPU_METHOD -32768 32767 FORMAT "%.15" /end CHARACTERISTIC
/begin CHARACTERISTIC Cal_RRCDOB_Ramp_ms_u16 "" VALUE 0x800D37E __UWORD_S 0 NO_COMPU_METHOD 0 65535 FORMAT "%.15" /end CHARACTERISTIC
/begin CHARACTERISTIC Cal_RRCDOB_Rev_u8 "" VALUE 0x800D377 __UBYTE_S 0 NO_COMPU_METHOD 0 255 FORMAT "%.15" /end CHARACTERISTIC
/begin CHARACTERISTIC Cal_RRCDOB_Rst_u8 "" VALUE 0x800D397 __UBYTE_S 0 NO_COMPU_METHOD 0 255 FORMAT "%.15" /end CHARACTERISTIC
/begin CHARACTERISTIC Cal_RRCDOB_Sel_u8 "" VALUE 0x800D376 __UBYTE_S 0 NO_COMPU_METHOD 0 255 FORMAT "%.15" /end CHARACTERISTIC
/begin CHARACTERISTIC Cal_RRCDOB_SpdHi_rpm_u16 "" VALUE 0x800D37C __UWORD_S 0 NO_COMPU_METHOD 0 65535 FORMAT "%.15" /end CHARACTERISTIC
/begin CHARACTERISTIC Cal_RRCDOB_SpdLo_rpm_u16 "" VALUE 0x800D37A __UWORD_S 0 NO_COMPU_METHOD 0 65535 FORMAT "%.15" /end CHARACTERISTIC
/begin CHARACTERISTIC Cal_RRCDOB_WcRatio_Q15_s16 "" VALUE 0x800D380 __SWORD_S 0 NO_COMPU_METHOD -32768 32767 FORMAT "%.15" /end CHARACTERISTIC
/begin CHARACTERISTIC Cal_Rte_VoltUtilLpfEnable_u8 "" VALUE 0x800D238 __UBYTE_S 0 NO_COMPU_METHOD 0 255 FORMAT "%.15" /end CHARACTERISTIC
/begin CHARACTERISTIC Cal_Rte_VoltUtilLpfFc_Hz_f32 "" VALUE 0x800D23C __FLOAT32_IEEE_S 0 NO_COMPU_METHOD -3.40282346639E+38 3.40282346639E+38 FORMAT "%.15" /end CHARACTERISTIC
/begin MEASUREMENT FocDemoClosedLoop "" UBYTE NO_COMPU_METHOD 0 0 0 255 ECU_ADDRESS 0x8008A24 FORMAT "%.15" /end MEASUREMENT
/begin MEASUREMENT FocDemoClosedLoop.accelerationLimit "" UBYTE NO_COMPU_METHOD 0 0 0 255 ECU_ADDRESS 0x8008BCC FORMAT "%.15" /end MEASUREMENT
/begin MEASUREMENT FocDemoClosedLoop.accelerationLimit.p_speedStepDownLimitQ30 "" SLONG NO_COMPU_METHOD 0 0 -2147483648 2147483647 ECU_ADDRESS 0x8008BD4 FORMAT "%.15" /end MEASUREMENT
/begin MEASUREMENT FocDemoClosedLoop.accelerationLimit.p_speedStepPreviousValue "" SLONG NO_COMPU_METHOD 0 0 -2147483648 2147483647 ECU_ADDRESS 0x8008BCC FORMAT "%.15" /end MEASUREMENT
/begin MEASUREMENT FocDemoClosedLoop.accelerationLimit.p_speedStepUpLimitQ30 "" SLONG NO_COMPU_METHOD 0 0 -2147483648 2147483647 ECU_ADDRESS 0x8008BD0 FORMAT "%.15" /end MEASUREMENT
/begin MEASUREMENT FocDemoClosedLoop.bridgeDrvTLE9563 "" UBYTE NO_COMPU_METHOD 0 0 0 255 ECU_ADDRESS 0x8008AD0 FORMAT "%.15" /end MEASUREMENT
/begin MEASUREMENT FocDemoClosedLoop.bridgeDrvTLE9563._Super_Ifx_MHA_BridgeDrv "" UBYTE NO_COMPU_METHOD 0 0 0 255 ECU_ADDRESS 0x8008AD0 FORMAT "%.15" /end MEASUREMENT
/begin MEASUREMENT FocDemoClosedLoop.bridgeDrvTLE9563._Super_Ifx_MHA_BridgeDrv.p_clearFault "" SBYTE NO_COMPU_METHOD 0 0 -1 0 BIT_MASK 0x1 ECU_ADDRESS 0x8008AD1 FORMAT "%.15" /end MEASUREMENT
/begin MEASUREMENT FocDemoClosedLoop.bridgeDrvTLE9563._Super_Ifx_MHA_BridgeDrv.p_enable "" SBYTE NO_COMPU_METHOD 0 0 -1 0 BIT_MASK 0x1 ECU_ADDRESS 0x8008AD0 FORMAT "%.15" /end MEASUREMENT
/begin MEASUREMENT FocDemoClosedLoop.bridgeDrvTLE9563.p_clrFaultsCounter "" UBYTE NO_COMPU_METHOD 0 0 0 255 ECU_ADDRESS 0x8008B10 FORMAT "%.15" /end MEASUREMENT
/begin MEASUREMENT FocDemoClosedLoop.bridgeDrvTLE9563.p_clrFaultsStep "" UBYTE FocDemoClosedLoop.bridgeDrvTLE9563.p_clrFaultsStep.CONVERSION 0 0 0 255 ECU_ADDRESS 0x8008B11 FORMAT "%6.3" /end MEASUREMENT
/begin MEASUREMENT FocDemoClosedLoop.bridgeDrvTLE9563.p_cycleCounter "" ULONG NO_COMPU_METHOD 0 0 0 4294967295 ECU_ADDRESS 0x8008B08 FORMAT "%.15" /end MEASUREMENT
/begin MEASUREMENT FocDemoClosedLoop.bridgeDrvTLE9563.p_queueElement "" UBYTE NO_COMPU_METHOD 0 0 0 255 ECU_ADDRESS 0x8008ADA FORMAT "%.15" /end MEASUREMENT
/begin MEASUREMENT FocDemoClosedLoop.bridgeDrvTLE9563.p_queueElement._0_ "" UBYTE NO_COMPU_METHOD 0 0 0 255 ECU_ADDRESS 0x8008ADA FORMAT "%.15" /end MEASUREMENT
/begin MEASUREMENT FocDemoClosedLoop.bridgeDrvTLE9563.p_queueElement._0_.data "" UWORD NO_COMPU_METHOD 0 0 0 65535 ECU_ADDRESS 0x8008ADA FORMAT "%.15" /end MEASUREMENT
/begin MEASUREMENT FocDemoClosedLoop.bridgeDrvTLE9563.p_queueElement._0_.processed "" SBYTE NO_COMPU_METHOD 0 0 -1 0 BIT_MASK 0x1 ECU_ADDRESS 0x8008ADD FORMAT "%.15" /end MEASUREMENT
/begin MEASUREMENT FocDemoClosedLoop.bridgeDrvTLE9563.p_queueElement._0_.requested "" SBYTE NO_COMPU_METHOD 0 0 -1 0 BIT_MASK 0x1 ECU_ADDRESS 0x8008ADC FORMAT "%.15" /end MEASUREMENT
/begin MEASUREMENT FocDemoClosedLoop.bridgeDrvTLE9563.p_queueElement._10_ "" UBYTE NO_COMPU_METHOD 0 0 0 255 ECU_ADDRESS 0x8008B02 FORMAT "%.15" /end MEASUREMENT
/begin MEASUREMENT FocDemoClosedLoop.bridgeDrvTLE9563.p_queueElement._10_.data "" UWORD NO_COMPU_METHOD 0 0 0 65535 ECU_ADDRESS 0x8008B02 FORMAT "%.15" /end MEASUREMENT
/begin MEASUREMENT FocDemoClosedLoop.bridgeDrvTLE9563.p_queueElement._10_.processed "" SBYTE NO_COMPU_METHOD 0 0 -1 0 BIT_MASK 0x1 ECU_ADDRESS 0x8008B05 FORMAT "%.15" /end MEASUREMENT
/begin MEASUREMENT FocDemoClosedLoop.bridgeDrvTLE9563.p_queueElement._10_.requested "" SBYTE NO_COMPU_METHOD 0 0 -1 0 BIT_MASK 0x1 ECU_ADDRESS 0x8008B04 FORMAT "%.15" /end MEASUREMENT
/begin MEASUREMENT FocDemoClosedLoop.bridgeDrvTLE9563.p_queueElement._1_ "" UBYTE NO_COMPU_METHOD 0 0 0 255 ECU_ADDRESS 0x8008ADE FORMAT "%.15" /end MEASUREMENT
/begin MEASUREMENT FocDemoClosedLoop.bridgeDrvTLE9563.p_queueElement._1_.data "" UWORD NO_COMPU_METHOD 0 0 0 65535 ECU_ADDRESS 0x8008ADE FORMAT "%.15" /end MEASUREMENT
/begin MEASUREMENT FocDemoClosedLoop.bridgeDrvTLE9563.p_queueElement._1_.processed "" SBYTE NO_COMPU_METHOD 0 0 -1 0 BIT_MASK 0x1 ECU_ADDRESS 0x8008AE1 FORMAT "%.15" /end MEASUREMENT
/begin MEASUREMENT FocDemoClosedLoop.bridgeDrvTLE9563.p_queueElement._1_.requested "" SBYTE NO_COMPU_METHOD 0 0 -1 0 BIT_MASK 0x1 ECU_ADDRESS 0x8008AE0 FORMAT "%.15" /end MEASUREMENT
/begin MEASUREMENT FocDemoClosedLoop.bridgeDrvTLE9563.p_queueElement._2_ "" UBYTE NO_COMPU_METHOD 0 0 0 255 ECU_ADDRESS 0x8008AE2 FORMAT "%.15" /end MEASUREMENT
/begin MEASUREMENT FocDemoClosedLoop.bridgeDrvTLE9563.p_queueElement._2_.data "" UWORD NO_COMPU_METHOD 0 0 0 65535 ECU_ADDRESS 0x8008AE2 FORMAT "%.15" /end MEASUREMENT
/begin MEASUREMENT FocDemoClosedLoop.bridgeDrvTLE9563.p_queueElement._2_.processed "" SBYTE NO_COMPU_METHOD 0 0 -1 0 BIT_MASK 0x1 ECU_ADDRESS 0x8008AE5 FORMAT "%.15" /end MEASUREMENT
/begin MEASUREMENT FocDemoClosedLoop.bridgeDrvTLE9563.p_queueElement._2_.requested "" SBYTE NO_COMPU_METHOD 0 0 -1 0 BIT_MASK 0x1 ECU_ADDRESS 0x8008AE4 FORMAT "%.15" /end MEASUREMENT
/begin MEASUREMENT FocDemoClosedLoop.bridgeDrvTLE9563.p_queueElement._3_ "" UBYTE NO_COMPU_METHOD 0 0 0 255 ECU_ADDRESS 0x8008AE6 FORMAT "%.15" /end MEASUREMENT
/begin MEASUREMENT FocDemoClosedLoop.bridgeDrvTLE9563.p_queueElement._3_.data "" UWORD NO_COMPU_METHOD 0 0 0 65535 ECU_ADDRESS 0x8008AE6 FORMAT "%.15" /end MEASUREMENT
/begin MEASUREMENT FocDemoClosedLoop.bridgeDrvTLE9563.p_queueElement._3_.processed "" SBYTE NO_COMPU_METHOD 0 0 -1 0 BIT_MASK 0x1 ECU_ADDRESS 0x8008AE9 FORMAT "%.15" /end MEASUREMENT
/begin MEASUREMENT FocDemoClosedLoop.bridgeDrvTLE9563.p_queueElement._3_.requested "" SBYTE NO_COMPU_METHOD 0 0 -1 0 BIT_MASK 0x1 ECU_ADDRESS 0x8008AE8 FORMAT "%.15" /end MEASUREMENT
/begin MEASUREMENT FocDemoClosedLoop.bridgeDrvTLE9563.p_queueElement._4_ "" UBYTE NO_COMPU_METHOD 0 0 0 255 ECU_ADDRESS 0x8008AEA FORMAT "%.15" /end MEASUREMENT
/begin MEASUREMENT FocDemoClosedLoop.bridgeDrvTLE9563.p_queueElement._4_.data "" UWORD NO_COMPU_METHOD 0 0 0 65535 ECU_ADDRESS 0x8008AEA FORMAT "%.15" /end MEASUREMENT
/begin MEASUREMENT FocDemoClosedLoop.bridgeDrvTLE9563.p_queueElement._4_.processed "" SBYTE NO_COMPU_METHOD 0 0 -1 0 BIT_MASK 0x1 ECU_ADDRESS 0x8008AED FORMAT "%.15" /end MEASUREMENT
/begin MEASUREMENT FocDemoClosedLoop.bridgeDrvTLE9563.p_queueElement._4_.requested "" SBYTE NO_COMPU_METHOD 0 0 -1 0 BIT_MASK 0x1 ECU_ADDRESS 0x8008AEC FORMAT "%.15" /end MEASUREMENT
/begin MEASUREMENT FocDemoClosedLoop.bridgeDrvTLE9563.p_queueElement._5_ "" UBYTE NO_COMPU_METHOD 0 0 0 255 ECU_ADDRESS 0x8008AEE FORMAT "%.15" /end MEASUREMENT
/begin MEASUREMENT FocDemoClosedLoop.bridgeDrvTLE9563.p_queueElement._5_.data "" UWORD NO_COMPU_METHOD 0 0 0 65535 ECU_ADDRESS 0x8008AEE FORMAT "%.15" /end MEASUREMENT
/begin MEASUREMENT FocDemoClosedLoop.bridgeDrvTLE9563.p_queueElement._5_.processed "" SBYTE NO_COMPU_METHOD 0 0 -1 0 BIT_MASK 0x1 ECU_ADDRESS 0x8008AF1 FORMAT "%.15" /end MEASUREMENT
/begin MEASUREMENT FocDemoClosedLoop.bridgeDrvTLE9563.p_queueElement._5_.requested "" SBYTE NO_COMPU_METHOD 0 0 -1 0 BIT_MASK 0x1 ECU_ADDRESS 0x8008AF0 FORMAT "%.15" /end MEASUREMENT
/begin MEASUREMENT FocDemoClosedLoop.bridgeDrvTLE9563.p_queueElement._6_ "" UBYTE NO_COMPU_METHOD 0 0 0 255 ECU_ADDRESS 0x8008AF2 FORMAT "%.15" /end MEASUREMENT
/begin MEASUREMENT FocDemoClosedLoop.bridgeDrvTLE9563.p_queueElement._6_.data "" UWORD NO_COMPU_METHOD 0 0 0 65535 ECU_ADDRESS 0x8008AF2 FORMAT "%.15" /end MEASUREMENT
/begin MEASUREMENT FocDemoClosedLoop.bridgeDrvTLE9563.p_queueElement._6_.processed "" SBYTE NO_COMPU_METHOD 0 0 -1 0 BIT_MASK 0x1 ECU_ADDRESS 0x8008AF5 FORMAT "%.15" /end MEASUREMENT
/begin MEASUREMENT FocDemoClosedLoop.bridgeDrvTLE9563.p_queueElement._6_.requested "" SBYTE NO_COMPU_METHOD 0 0 -1 0 BIT_MASK 0x1 ECU_ADDRESS 0x8008AF4 FORMAT "%.15" /end MEASUREMENT
/begin MEASUREMENT FocDemoClosedLoop.bridgeDrvTLE9563.p_queueElement._7_ "" UBYTE NO_COMPU_METHOD 0 0 0 255 ECU_ADDRESS 0x8008AF6 FORMAT "%.15" /end MEASUREMENT
/begin MEASUREMENT FocDemoClosedLoop.bridgeDrvTLE9563.p_queueElement._7_.data "" UWORD NO_COMPU_METHOD 0 0 0 65535 ECU_ADDRESS 0x8008AF6 FORMAT "%.15" /end MEASUREMENT
/begin MEASUREMENT FocDemoClosedLoop.bridgeDrvTLE9563.p_queueElement._7_.processed "" SBYTE NO_COMPU_METHOD 0 0 -1 0 BIT_MASK 0x1 ECU_ADDRESS 0x8008AF9 FORMAT "%.15" /end MEASUREMENT
/begin MEASUREMENT FocDemoClosedLoop.bridgeDrvTLE9563.p_queueElement._7_.requested "" SBYTE NO_COMPU_METHOD 0 0 -1 0 BIT_MASK 0x1 ECU_ADDRESS 0x8008AF8 FORMAT "%.15" /end MEASUREMENT
/begin MEASUREMENT FocDemoClosedLoop.bridgeDrvTLE9563.p_queueElement._8_ "" UBYTE NO_COMPU_METHOD 0 0 0 255 ECU_ADDRESS 0x8008AFA FORMAT "%.15" /end MEASUREMENT
/begin MEASUREMENT FocDemoClosedLoop.bridgeDrvTLE9563.p_queueElement._8_.data "" UWORD NO_COMPU_METHOD 0 0 0 65535 ECU_ADDRESS 0x8008AFA FORMAT "%.15" /end MEASUREMENT
/begin MEASUREMENT FocDemoClosedLoop.bridgeDrvTLE9563.p_queueElement._8_.processed "" SBYTE NO_COMPU_METHOD 0 0 -1 0 BIT_MASK 0x1 ECU_ADDRESS 0x8008AFD FORMAT "%.15" /end MEASUREMENT
/begin MEASUREMENT FocDemoClosedLoop.bridgeDrvTLE9563.p_queueElement._8_.requested "" SBYTE NO_COMPU_METHOD 0 0 -1 0 BIT_MASK 0x1 ECU_ADDRESS 0x8008AFC FORMAT "%.15" /end MEASUREMENT
/begin MEASUREMENT FocDemoClosedLoop.bridgeDrvTLE9563.p_queueElement._9_ "" UBYTE NO_COMPU_METHOD 0 0 0 255 ECU_ADDRESS 0x8008AFE FORMAT "%.15" /end MEASUREMENT
/begin MEASUREMENT FocDemoClosedLoop.bridgeDrvTLE9563.p_queueElement._9_.data "" UWORD NO_COMPU_METHOD 0 0 0 65535 ECU_ADDRESS 0x8008AFE FORMAT "%.15" /end MEASUREMENT
/begin MEASUREMENT FocDemoClosedLoop.bridgeDrvTLE9563.p_queueElement._9_.processed "" SBYTE NO_COMPU_METHOD 0 0 -1 0 BIT_MASK 0x1 ECU_ADDRESS 0x8008B01 FORMAT "%.15" /end MEASUREMENT
/begin MEASUREMENT FocDemoClosedLoop.bridgeDrvTLE9563.p_queueElement._9_.requested "" SBYTE NO_COMPU_METHOD 0 0 -1 0 BIT_MASK 0x1 ECU_ADDRESS 0x8008B00 FORMAT "%.15" /end MEASUREMENT
/begin MEASUREMENT FocDemoClosedLoop.bridgeDrvTLE9563.p_status "" UBYTE NO_COMPU_METHOD 0 0 0 255 ECU_ADDRESS 0x8008AD2 FORMAT "%.15" /end MEASUREMENT
/begin MEASUREMENT FocDemoClosedLoop.bridgeDrvTLE9563.p_status.TLE9563InitFault "" SBYTE NO_COMPU_METHOD 0 0 -1 0 BIT_MASK 0x1 ECU_ADDRESS 0x8008AD5 FORMAT "%.15" /end MEASUREMENT
/begin MEASUREMENT FocDemoClosedLoop.bridgeDrvTLE9563.p_status.deviceDriverErrorLog "" UBYTE NO_COMPU_METHOD 0 0 0 255 ECU_ADDRESS 0x8008AD3 FORMAT "%.15" /end MEASUREMENT
/begin MEASUREMENT FocDemoClosedLoop.bridgeDrvTLE9563.p_status.overcurrent "" SBYTE NO_COMPU_METHOD 0 0 -1 0 BIT_MASK 0x1 ECU_ADDRESS 0x8008AD6 FORMAT "%.15" /end MEASUREMENT
/begin MEASUREMENT FocDemoClosedLoop.bridgeDrvTLE9563.p_status.overvoltage "" SBYTE NO_COMPU_METHOD 0 0 -1 0 BIT_MASK 0x1 ECU_ADDRESS 0x8008AD7 FORMAT "%.15" /end MEASUREMENT
/begin MEASUREMENT FocDemoClosedLoop.bridgeDrvTLE9563.p_status.spiFault "" SBYTE NO_COMPU_METHOD 0 0 -1 0 BIT_MASK 0x1 ECU_ADDRESS 0x8008AD4 FORMAT "%.15" /end MEASUREMENT
/begin MEASUREMENT FocDemoClosedLoop.bridgeDrvTLE9563.p_status.state "" UBYTE Ifx_MHA_BridgeDrv_TLE9563_State 0 0 0 255 ECU_ADDRESS 0x8008AD2 FORMAT "%6.3" /end MEASUREMENT
/begin MEASUREMENT FocDemoClosedLoop.bridgeDrvTLE9563.p_status.undervoltage "" SBYTE NO_COMPU_METHOD 0 0 -1 0 BIT_MASK 0x1 ECU_ADDRESS 0x8008AD8 FORMAT "%.15" /end MEASUREMENT
/begin MEASUREMENT FocDemoClosedLoop.bridgeDrvTLE9563.p_wdTriggerThreshold "" ULONG NO_COMPU_METHOD 0 0 0 4294967295 ECU_ADDRESS 0x8008B0C FORMAT "%.15" /end MEASUREMENT
/begin MEASUREMENT FocDemoClosedLoop.currentsAlphaBeta "" UBYTE NO_COMPU_METHOD 0 0 0 255 ECU_ADDRESS 0x8008C22 FORMAT "%.15" /end MEASUREMENT
/begin MEASUREMENT FocDemoClosedLoop.currentsUVW "" UBYTE NO_COMPU_METHOD 0 0 0 255 ECU_ADDRESS 0x8008C1C FORMAT "%.15" /end MEASUREMENT
/begin MEASUREMENT FocDemoClosedLoop.dqCommand "" UBYTE NO_COMPU_METHOD 0 0 0 255 ECU_ADDRESS 0x8008C2E FORMAT "%.15" /end MEASUREMENT
/begin MEASUREMENT FocDemoClosedLoop.dqCommand.imag "" SWORD NO_COMPU_METHOD 0 0 -32768 32767 ECU_ADDRESS 0x8008C30 FORMAT "%.15" /end MEASUREMENT
/begin MEASUREMENT FocDemoClosedLoop.dqCommand.real "" SWORD NO_COMPU_METHOD 0 0 -32768 32767 ECU_ADDRESS 0x8008C2E FORMAT "%.15" /end MEASUREMENT
/begin MEASUREMENT FocDemoClosedLoop.fluxEstimator "" UBYTE NO_COMPU_METHOD 0 0 0 255 ECU_ADDRESS 0x8008B3C FORMAT "%.15" /end MEASUREMENT
/begin MEASUREMENT FocDemoClosedLoop.fluxEstimator.p_alphaFilter "" UBYTE NO_COMPU_METHOD 0 0 0 255 ECU_ADDRESS 0x8008B3C FORMAT "%.15" /end MEASUREMENT
/begin MEASUREMENT FocDemoClosedLoop.fluxEstimator.p_alphaFilter.p_gainQ14 "" SWORD NO_COMPU_METHOD 0 0 -32768 32767 ECU_ADDRESS 0x8008B4A FORMAT "%.15" /end MEASUREMENT
/begin MEASUREMENT FocDemoClosedLoop.fluxEstimator.p_alphaFilter.p_previousValue "" SLONG NO_COMPU_METHOD 0 0 -2147483648 2147483647 ECU_ADDRESS 0x8008B3C FORMAT "%.15" /end MEASUREMENT
/begin MEASUREMENT FocDemoClosedLoop.fluxEstimator.p_alphaFilter.p_samplingTime_us "" ULONG NO_COMPU_METHOD 0 0 0 4294967295 ECU_ADDRESS 0x8008B44 FORMAT "%.15" /end MEASUREMENT
/begin MEASUREMENT FocDemoClosedLoop.fluxEstimator.p_alphaFilter.p_timeConstCoeff "" SWORD NO_COMPU_METHOD 0 0 -32768 32767 ECU_ADDRESS 0x8008B48 FORMAT "%.15" /end MEASUREMENT
/begin MEASUREMENT FocDemoClosedLoop.fluxEstimator.p_alphaFilter.p_timeConstant_us "" ULONG NO_COMPU_METHOD 0 0 0 4294967295 ECU_ADDRESS 0x8008B40 FORMAT "%.15" /end MEASUREMENT
/begin MEASUREMENT FocDemoClosedLoop.fluxEstimator.p_betaFilter "" UBYTE NO_COMPU_METHOD 0 0 0 255 ECU_ADDRESS 0x8008B4C FORMAT "%.15" /end MEASUREMENT
/begin MEASUREMENT FocDemoClosedLoop.fluxEstimator.p_betaFilter.p_gainQ14 "" SWORD NO_COMPU_METHOD 0 0 -32768 32767 ECU_ADDRESS 0x8008B5A FORMAT "%.15" /end MEASUREMENT
/begin MEASUREMENT FocDemoClosedLoop.fluxEstimator.p_betaFilter.p_previousValue "" SLONG NO_COMPU_METHOD 0 0 -2147483648 2147483647 ECU_ADDRESS 0x8008B4C FORMAT "%.15" /end MEASUREMENT
/begin MEASUREMENT FocDemoClosedLoop.fluxEstimator.p_betaFilter.p_samplingTime_us "" ULONG NO_COMPU_METHOD 0 0 0 4294967295 ECU_ADDRESS 0x8008B54 FORMAT "%.15" /end MEASUREMENT
/begin MEASUREMENT FocDemoClosedLoop.fluxEstimator.p_betaFilter.p_timeConstCoeff "" SWORD NO_COMPU_METHOD 0 0 -32768 32767 ECU_ADDRESS 0x8008B58 FORMAT "%.15" /end MEASUREMENT
/begin MEASUREMENT FocDemoClosedLoop.fluxEstimator.p_betaFilter.p_timeConstant_us "" ULONG NO_COMPU_METHOD 0 0 0 4294967295 ECU_ADDRESS 0x8008B50 FORMAT "%.15" /end MEASUREMENT
/begin MEASUREMENT FocDemoClosedLoop.fluxEstimator.p_output "" UBYTE NO_COMPU_METHOD 0 0 0 255 ECU_ADDRESS 0x8008B9C FORMAT "%.15" /end MEASUREMENT
/begin MEASUREMENT FocDemoClosedLoop.fluxEstimator.p_pllFilter "" UBYTE NO_COMPU_METHOD 0 0 0 255 ECU_ADDRESS 0x8008B6C FORMAT "%.15" /end MEASUREMENT
/begin MEASUREMENT FocDemoClosedLoop.fluxEstimator.p_pllFilter.p_buffer "" UBYTE NO_COMPU_METHOD 0 0 0 255 ECU_ADDRESS 0x8008B6C FORMAT "%.15" /end MEASUREMENT
/begin MEASUREMENT FocDemoClosedLoop.fluxEstimator.p_pllFilter.p_buffer._0_ "" ULONG NO_COMPU_METHOD 0 0 0 4294967295 ECU_ADDRESS 0x8008B6C FORMAT "%.15" /end MEASUREMENT
/begin MEASUREMENT FocDemoClosedLoop.fluxEstimator.p_pllFilter.p_buffer._1_ "" ULONG NO_COMPU_METHOD 0 0 0 4294967295 ECU_ADDRESS 0x8008B70 FORMAT "%.15" /end MEASUREMENT
/begin MEASUREMENT FocDemoClosedLoop.fluxEstimator.p_pllFilter.p_buffer._2_ "" ULONG NO_COMPU_METHOD 0 0 0 4294967295 ECU_ADDRESS 0x8008B74 FORMAT "%.15" /end MEASUREMENT
/begin MEASUREMENT FocDemoClosedLoop.fluxEstimator.p_pllFilter.p_buffer._3_ "" ULONG NO_COMPU_METHOD 0 0 0 4294967295 ECU_ADDRESS 0x8008B78 FORMAT "%.15" /end MEASUREMENT
/begin MEASUREMENT FocDemoClosedLoop.fluxEstimator.p_pllFilter.p_buffer._4_ "" ULONG NO_COMPU_METHOD 0 0 0 4294967295 ECU_ADDRESS 0x8008B7C FORMAT "%.15" /end MEASUREMENT
/begin MEASUREMENT FocDemoClosedLoop.fluxEstimator.p_pllFilter.p_buffer._5_ "" ULONG NO_COMPU_METHOD 0 0 0 4294967295 ECU_ADDRESS 0x8008B80 FORMAT "%.15" /end MEASUREMENT
/begin MEASUREMENT FocDemoClosedLoop.fluxEstimator.p_pllFilter.p_buffer._6_ "" ULONG NO_COMPU_METHOD 0 0 0 4294967295 ECU_ADDRESS 0x8008B84 FORMAT "%.15" /end MEASUREMENT
/begin MEASUREMENT FocDemoClosedLoop.fluxEstimator.p_pllFilter.p_buffer._7_ "" ULONG NO_COMPU_METHOD 0 0 0 4294967295 ECU_ADDRESS 0x8008B88 FORMAT "%.15" /end MEASUREMENT
/begin MEASUREMENT FocDemoClosedLoop.fluxEstimator.p_pllFilter.p_bufferIndex "" UBYTE NO_COMPU_METHOD 0 0 0 255 ECU_ADDRESS 0x8008B9A FORMAT "%.15" /end MEASUREMENT
/begin MEASUREMENT FocDemoClosedLoop.fluxEstimator.p_pllFilter.p_previousValue "" ULONG NO_COMPU_METHOD 0 0 0 4294967295 ECU_ADDRESS 0x8008B94 FORMAT "%.15" /end MEASUREMENT
/begin MEASUREMENT FocDemoClosedLoop.fluxEstimator.p_pllFilter.p_propGain "" UBYTE NO_COMPU_METHOD 0 0 0 255 ECU_ADDRESS 0x8008B8C FORMAT "%.15" /end MEASUREMENT
/begin MEASUREMENT FocDemoClosedLoop.fluxEstimator.p_pllFilter.p_propGain.value "" SWORD NO_COMPU_METHOD 0 0 -32768 32767 ECU_ADDRESS 0x8008B8C FORMAT "%.15" /end MEASUREMENT
/begin MEASUREMENT FocDemoClosedLoop.fluxEstimator.p_pllFilter.p_propGainSamplingTime "" SWORD NO_COMPU_METHOD 0 0 -32768 32767 ECU_ADDRESS 0x8008B98 FORMAT "%.15" /end MEASUREMENT
/begin MEASUREMENT FocDemoClosedLoop.fluxEstimator.p_pllFilter.p_samplingTime_us "" ULONG NO_COMPU_METHOD 0 0 0 4294967295 ECU_ADDRESS 0x8008B90 FORMAT "%.15" /end MEASUREMENT
/begin MEASUREMENT FocDemoClosedLoop.fluxEstimator.p_radToRadPerSecondQ7 "" SWORD NO_COMPU_METHOD 0 0 -32768 32767 ECU_ADDRESS 0x8008BA8 FORMAT "%.15" /end MEASUREMENT
/begin MEASUREMENT FocDemoClosedLoop.fluxEstimator.p_samplingTime_us "" ULONG NO_COMPU_METHOD 0 0 0 4294967295 ECU_ADDRESS 0x8008BA4 FORMAT "%.15" /end MEASUREMENT
/begin MEASUREMENT FocDemoClosedLoop.fluxEstimator.p_speedFilter "" UBYTE NO_COMPU_METHOD 0 0 0 255 ECU_ADDRESS 0x8008B5C FORMAT "%.15" /end MEASUREMENT
/begin MEASUREMENT FocDemoClosedLoop.fluxEstimator.p_speedFilter.p_gainQ14 "" SWORD NO_COMPU_METHOD 0 0 -32768 32767 ECU_ADDRESS 0x8008B6A FORMAT "%.15" /end MEASUREMENT
/begin MEASUREMENT FocDemoClosedLoop.fluxEstimator.p_speedFilter.p_previousValue "" SLONG NO_COMPU_METHOD 0 0 -2147483648 2147483647 ECU_ADDRESS 0x8008B5C FORMAT "%.15" /end MEASUREMENT
/begin MEASUREMENT FocDemoClosedLoop.fluxEstimator.p_speedFilter.p_samplingTime_us "" ULONG NO_COMPU_METHOD 0 0 0 4294967295 ECU_ADDRESS 0x8008B64 FORMAT "%.15" /end MEASUREMENT
/begin MEASUREMENT FocDemoClosedLoop.fluxEstimator.p_speedFilter.p_timeConstCoeff "" SWORD NO_COMPU_METHOD 0 0 -32768 32767 ECU_ADDRESS 0x8008B68 FORMAT "%.15" /end MEASUREMENT
/begin MEASUREMENT FocDemoClosedLoop.fluxEstimator.p_speedFilter.p_timeConstant_us "" ULONG NO_COMPU_METHOD 0 0 0 4294967295 ECU_ADDRESS 0x8008B60 FORMAT "%.15" /end MEASUREMENT
/begin MEASUREMENT FocDemoClosedLoop.focController "" UBYTE NO_COMPU_METHOD 0 0 0 255 ECU_ADDRESS 0x8008A24 FORMAT "%.15" /end MEASUREMENT
/begin MEASUREMENT FocDemoClosedLoop.focController.currentDPi "" UBYTE NO_COMPU_METHOD 0 0 0 255 ECU_ADDRESS 0x8008A24 FORMAT "%.15" /end MEASUREMENT
/begin MEASUREMENT FocDemoClosedLoop.focController.currentDPi.p_antiWindupGainSamplingTime "" UBYTE NO_COMPU_METHOD 0 0 0 255 ECU_ADDRESS 0x8008A2C FORMAT "%.15" /end MEASUREMENT
/begin MEASUREMENT FocDemoClosedLoop.focController.currentDPi.p_integGainSamplingTime "" UBYTE NO_COMPU_METHOD 0 0 0 255 ECU_ADDRESS 0x8008A28 FORMAT "%.15" /end MEASUREMENT
/begin MEASUREMENT FocDemoClosedLoop.focController.currentDPi.p_integPreviousValue "" SLONG NO_COMPU_METHOD 0 0 -2147483648 2147483647 ECU_ADDRESS 0x8008A24 FORMAT "%.15" /end MEASUREMENT
/begin MEASUREMENT FocDemoClosedLoop.focController.currentDPi.p_propGain "" UBYTE NO_COMPU_METHOD 0 0 0 255 ECU_ADDRESS 0x8008A30 FORMAT "%.15" /end MEASUREMENT
/begin MEASUREMENT FocDemoClosedLoop.focController.currentDPi.p_qFormatAntiWindupGain "" UBYTE NO_COMPU_METHOD 0 0 0 255 ECU_ADDRESS 0x8008A3C FORMAT "%.15" /end MEASUREMENT
/begin MEASUREMENT FocDemoClosedLoop.focController.currentDPi.p_qFormatIntegGain "" UBYTE NO_COMPU_METHOD 0 0 0 255 ECU_ADDRESS 0x8008A3B FORMAT "%.15" /end MEASUREMENT
/begin MEASUREMENT FocDemoClosedLoop.focController.currentDPi.p_qFormatPropGain "" UBYTE NO_COMPU_METHOD 0 0 0 255 ECU_ADDRESS 0x8008A3A FORMAT "%.15" /end MEASUREMENT
/begin MEASUREMENT FocDemoClosedLoop.focController.currentDQ "" UBYTE NO_COMPU_METHOD 0 0 0 255 ECU_ADDRESS 0x8008A64 FORMAT "%.15" /end MEASUREMENT
/begin MEASUREMENT FocDemoClosedLoop.focController.currentQPi "" UBYTE NO_COMPU_METHOD 0 0 0 255 ECU_ADDRESS 0x8008A40 FORMAT "%.15" /end MEASUREMENT
/begin MEASUREMENT FocDemoClosedLoop.focController.currentQPi.p_antiWindupGainSamplingTime "" UBYTE NO_COMPU_METHOD 0 0 0 255 ECU_ADDRESS 0x8008A48 FORMAT "%.15" /end MEASUREMENT
/begin MEASUREMENT FocDemoClosedLoop.focController.currentQPi.p_integGainSamplingTime "" UBYTE NO_COMPU_METHOD 0 0 0 255 ECU_ADDRESS 0x8008A44 FORMAT "%.15" /end MEASUREMENT
/begin MEASUREMENT FocDemoClosedLoop.focController.currentQPi.p_integPreviousValue "" SLONG NO_COMPU_METHOD 0 0 -2147483648 2147483647 ECU_ADDRESS 0x8008A40 FORMAT "%.15" /end MEASUREMENT
/begin MEASUREMENT FocDemoClosedLoop.focController.currentQPi.p_propGain "" UBYTE NO_COMPU_METHOD 0 0 0 255 ECU_ADDRESS 0x8008A4C FORMAT "%.15" /end MEASUREMENT
/begin MEASUREMENT FocDemoClosedLoop.focController.currentQPi.p_qFormatAntiWindupGain "" UBYTE NO_COMPU_METHOD 0 0 0 255 ECU_ADDRESS 0x8008A58 FORMAT "%.15" /end MEASUREMENT
/begin MEASUREMENT FocDemoClosedLoop.focController.currentQPi.p_qFormatIntegGain "" UBYTE NO_COMPU_METHOD 0 0 0 255 ECU_ADDRESS 0x8008A57 FORMAT "%.15" /end MEASUREMENT
/begin MEASUREMENT FocDemoClosedLoop.focController.currentQPi.p_qFormatPropGain "" UBYTE NO_COMPU_METHOD 0 0 0 255 ECU_ADDRESS 0x8008A56 FORMAT "%.15" /end MEASUREMENT
/begin MEASUREMENT FocDemoClosedLoop.focController.dqDecoupling "" UBYTE NO_COMPU_METHOD 0 0 0 255 ECU_ADDRESS 0x8008A6C FORMAT "%.15" /end MEASUREMENT
/begin MEASUREMENT FocDemoClosedLoop.focController.dqDecoupling.p_inductanceDQ "" UBYTE NO_COMPU_METHOD 0 0 0 255 ECU_ADDRESS 0x8008A6C FORMAT "%.15" /end MEASUREMENT
/begin MEASUREMENT FocDemoClosedLoop.focController.dqDecoupling.p_inductanceDQ.imag "" SWORD NO_COMPU_METHOD 0 0 -32768 32767 ECU_ADDRESS 0x8008A6E FORMAT "%.15" /end MEASUREMENT
/begin MEASUREMENT FocDemoClosedLoop.focController.dqDecoupling.p_inductanceDQ.real "" SWORD NO_COMPU_METHOD 0 0 -32768 32767 ECU_ADDRESS 0x8008A6C FORMAT "%.15" /end MEASUREMENT
/begin MEASUREMENT FocDemoClosedLoop.focController.p_output "" UBYTE NO_COMPU_METHOD 0 0 0 255 ECU_ADDRESS 0x8008A5C FORMAT "%.15" /end MEASUREMENT
/begin MEASUREMENT FocDemoClosedLoop.focController.p_output.voltageCommandPolar "" UBYTE NO_COMPU_METHOD 0 0 0 255 ECU_ADDRESS 0x8008A5C FORMAT "%.15" /end MEASUREMENT
/begin MEASUREMENT FocDemoClosedLoop.focController.voltageDQ "" UBYTE NO_COMPU_METHOD 0 0 0 255 ECU_ADDRESS 0x8008A68 FORMAT "%.15" /end MEASUREMENT
/begin MEASUREMENT FocDemoClosedLoop.focController.voltageDQ.imag "" SWORD Foc_Q15_to_V 0 0 -32768 32767 ECU_ADDRESS 0x8008A6A /end MEASUREMENT
/begin MEASUREMENT FocDemoClosedLoop.focController.voltageDQ.real "" SWORD Foc_Q15_to_V 0 0 -32768 32767 ECU_ADDRESS 0x8008A68 /end MEASUREMENT
/begin MEASUREMENT FocDemoClosedLoop.iToF "" UBYTE NO_COMPU_METHOD 0 0 0 255 ECU_ADDRESS 0x8008BB4 FORMAT "%.15" /end MEASUREMENT
/begin CHARACTERISTIC FocDemoClosedLoop.iToF.p_angleIncrementQ14 "" VALUE 0x8008BC0 __SWORD_S 0 NO_COMPU_METHOD -32768 32767 FORMAT "%.15" /end CHARACTERISTIC
/begin MEASUREMENT FocDemoClosedLoop.iToF.p_anglePreviousValue "" ULONG NO_COMPU_METHOD 0 0 0 4294967295 ECU_ADDRESS 0x8008BBC FORMAT "%.15" /end MEASUREMENT
/begin MEASUREMENT FocDemoClosedLoop.iToF.p_output "" UBYTE NO_COMPU_METHOD 0 0 0 255 ECU_ADDRESS 0x8008BB4 FORMAT "%.15" /end MEASUREMENT
/begin MEASUREMENT FocDemoClosedLoop.iToF.p_output.refCurrent "" UBYTE NO_COMPU_METHOD 0 0 0 255 ECU_ADDRESS 0x8008BB4 FORMAT "%.15" /end MEASUREMENT
/begin MEASUREMENT FocDemoClosedLoop.measurementADCCYT2B7 "" UBYTE NO_COMPU_METHOD 0 0 0 255 ECU_ADDRESS 0x8008B14 FORMAT "%.15" /end MEASUREMENT
/begin MEASUREMENT FocDemoClosedLoop.measurementADCCYT2B7._Super_Ifx_MHA_MeasurementADC "" UBYTE NO_COMPU_METHOD 0 0 0 255 ECU_ADDRESS 0x8008B14 FORMAT "%.15" /end MEASUREMENT
/begin MEASUREMENT FocDemoClosedLoop.measurementADCCYT2B7._Super_Ifx_MHA_MeasurementADC.p_enable "" SBYTE NO_COMPU_METHOD 0 0 -1 0 BIT_MASK 0x1 ECU_ADDRESS 0x8008B14 FORMAT "%.15" /end MEASUREMENT
/begin MEASUREMENT FocDemoClosedLoop.measurementADCCYT2B7.p_currentAccumulator "" UBYTE NO_COMPU_METHOD 0 0 0 255 ECU_ADDRESS 0x8008B2C FORMAT "%.15" /end MEASUREMENT
/begin MEASUREMENT FocDemoClosedLoop.measurementADCCYT2B7.p_currentAccumulator._0_ "" ULONG NO_COMPU_METHOD 0 0 0 4294967295 ECU_ADDRESS 0x8008B2C FORMAT "%.15" /end MEASUREMENT
/begin MEASUREMENT FocDemoClosedLoop.measurementADCCYT2B7.p_currentAccumulator._1_ "" ULONG NO_COMPU_METHOD 0 0 0 4294967295 ECU_ADDRESS 0x8008B30 FORMAT "%.15" /end MEASUREMENT
/begin MEASUREMENT FocDemoClosedLoop.measurementADCCYT2B7.p_currentGain "" UBYTE NO_COMPU_METHOD 0 0 0 255 ECU_ADDRESS 0x8008B24 FORMAT "%.15" /end MEASUREMENT
/begin MEASUREMENT FocDemoClosedLoop.measurementADCCYT2B7.p_currentGain.value "" SWORD NO_COMPU_METHOD 0 0 -32768 32767 ECU_ADDRESS 0x8008B24 FORMAT "%.15" /end MEASUREMENT
/begin MEASUREMENT FocDemoClosedLoop.measurementADCCYT2B7.p_currentGainOption "" UBYTE Ifx_MHA_MeasurementADC_CYT2B7_optionCsaGain 0 0 0 255 ECU_ADDRESS 0x8008B28 FORMAT "%6.3" /end MEASUREMENT
/begin MEASUREMENT FocDemoClosedLoop.measurementADCCYT2B7.p_cycleCounter "" UWORD NO_COMPU_METHOD 0 0 0 65535 ECU_ADDRESS 0x8008B34 FORMAT "%.15" /end MEASUREMENT
/begin MEASUREMENT FocDemoClosedLoop.measurementADCCYT2B7.p_offset "" UBYTE NO_COMPU_METHOD 0 0 0 255 ECU_ADDRESS 0x8008B36 FORMAT "%.15" /end MEASUREMENT
/begin MEASUREMENT FocDemoClosedLoop.measurementADCCYT2B7.p_offset._0_ "" UWORD NO_COMPU_METHOD 0 0 0 65535 ECU_ADDRESS 0x8008B36 FORMAT "%.15" /end MEASUREMENT
/begin MEASUREMENT FocDemoClosedLoop.measurementADCCYT2B7.p_offset._1_ "" UWORD NO_COMPU_METHOD 0 0 0 65535 ECU_ADDRESS 0x8008B38 FORMAT "%.15" /end MEASUREMENT
/begin MEASUREMENT FocDemoClosedLoop.measurementADCCYT2B7.p_output "" UBYTE NO_COMPU_METHOD 0 0 0 255 ECU_ADDRESS 0x8008B16 FORMAT "%.15" /end MEASUREMENT
/begin MEASUREMENT FocDemoClosedLoop.measurementADCCYT2B7.p_output.dcLinkVoltageQ15 "" SWORD Foc_Q15_to_V 0 0 -32768 32767 ECU_ADDRESS 0x8008B16 FORMAT "%.15" /end MEASUREMENT
/begin MEASUREMENT FocDemoClosedLoop.measurementADCCYT2B7.p_output.shuntCurrentsQ15 "" UBYTE NO_COMPU_METHOD 0 0 0 255 ECU_ADDRESS 0x8008B18 FORMAT "%.15" /end MEASUREMENT
/begin MEASUREMENT FocDemoClosedLoop.measurementADCCYT2B7.p_rawCurrentMeasurements "" UBYTE NO_COMPU_METHOD 0 0 0 255 ECU_ADDRESS 0x8008B1E FORMAT "%.15" /end MEASUREMENT
/begin MEASUREMENT FocDemoClosedLoop.measurementADCCYT2B7.p_rawCurrentMeasurements._0_ "" UWORD NO_COMPU_METHOD 0 0 0 65535 ECU_ADDRESS 0x8008B1E FORMAT "%.15" /end MEASUREMENT
/begin MEASUREMENT FocDemoClosedLoop.measurementADCCYT2B7.p_rawCurrentMeasurements._1_ "" UWORD NO_COMPU_METHOD 0 0 0 65535 ECU_ADDRESS 0x8008B20 FORMAT "%.15" /end MEASUREMENT
/begin MEASUREMENT FocDemoClosedLoop.measurementADCCYT2B7.p_status "" UBYTE NO_COMPU_METHOD 0 0 0 255 ECU_ADDRESS 0x8008B22 FORMAT "%.15" /end MEASUREMENT
/begin MEASUREMENT FocDemoClosedLoop.measurementADCCYT2B7.p_status.state "" UBYTE Ifx_MHA_MeasurementADC_CYT2B7_State 0 0 0 255 ECU_ADDRESS 0x8008B22 FORMAT "%6.3" /end MEASUREMENT
/begin MEASUREMENT FocDemoClosedLoop.modulator "" UBYTE NO_COMPU_METHOD 0 0 0 255 ECU_ADDRESS 0x8008A70 FORMAT "%.15" /end MEASUREMENT
/begin MEASUREMENT FocDemoClosedLoop.modulator.p_clearFault "" SBYTE NO_COMPU_METHOD 0 0 -1 0 BIT_MASK 0x1 ECU_ADDRESS 0x8008A70 FORMAT "%.15" /end MEASUREMENT
/begin MEASUREMENT FocDemoClosedLoop.modulator.p_currentMeasurement "" UBYTE NO_COMPU_METHOD 0 0 0 255 ECU_ADDRESS 0x8008A72 FORMAT "%.15" /end MEASUREMENT
/begin MEASUREMENT FocDemoClosedLoop.modulator.p_currentMeasurement.p_deltaBegin_tick "" SWORD NO_COMPU_METHOD 0 0 -32768 32767 ECU_ADDRESS 0x8008A78 FORMAT "%.15" /end MEASUREMENT
/begin MEASUREMENT FocDemoClosedLoop.modulator.p_enable "" SBYTE NO_COMPU_METHOD 0 0 -1 0 BIT_MASK 0x1 ECU_ADDRESS 0x8008A7C FORMAT "%.15" /end MEASUREMENT
/begin MEASUREMENT FocDemoClosedLoop.modulator.p_forceSampleEnable "" SBYTE NO_COMPU_METHOD 0 0 -1 0 BIT_MASK 0x1 ECU_ADDRESS 0x8008A84 FORMAT "%.15" /end MEASUREMENT
/begin MEASUREMENT FocDemoClosedLoop.modulator.p_forceSampleTick1 "" UWORD NO_COMPU_METHOD 0 0 0 65535 ECU_ADDRESS 0x8008A86 FORMAT "%.15" /end MEASUREMENT
/begin MEASUREMENT FocDemoClosedLoop.modulator.p_forceSampleTick2 "" UWORD NO_COMPU_METHOD 0 0 0 65535 ECU_ADDRESS 0x8008A88 FORMAT "%.15" /end MEASUREMENT
/begin MEASUREMENT FocDemoClosedLoop.modulator.p_output "" UBYTE NO_COMPU_METHOD 0 0 0 255 ECU_ADDRESS 0x8008A90 FORMAT "%.15" /end MEASUREMENT
/begin MEASUREMENT FocDemoClosedLoop.modulator.p_output.actualVoltage "" UBYTE NO_COMPU_METHOD 0 0 0 255 ECU_ADDRESS 0x8008AA0 FORMAT "%.15" /end MEASUREMENT
/begin MEASUREMENT FocDemoClosedLoop.modulator.p_output.compareValues_tick "" UBYTE NO_COMPU_METHOD 0 0 0 255 ECU_ADDRESS 0x8008A90 FORMAT "%.15" /end MEASUREMENT
/begin MEASUREMENT FocDemoClosedLoop.modulator.p_output.currentReconstructionInfo "" UBYTE NO_COMPU_METHOD 0 0 0 255 ECU_ADDRESS 0x8008AA8 FORMAT "%.15" /end MEASUREMENT
/begin MEASUREMENT FocDemoClosedLoop.modulator.p_output.currentReconstructionInfo.sector "" UBYTE NO_COMPU_METHOD 0 0 0 255 ECU_ADDRESS 0x8008AA8 FORMAT "%.15" /end MEASUREMENT
/begin MEASUREMENT FocDemoClosedLoop.modulator.p_output.triggerTime_tick "" UBYTE NO_COMPU_METHOD 0 0 0 255 ECU_ADDRESS 0x8008A9C FORMAT "%.15" /end MEASUREMENT
/begin MEASUREMENT FocDemoClosedLoop.modulator.p_period_tick "" SWORD NO_COMPU_METHOD 0 0 -32768 32767 ECU_ADDRESS 0x8008AAC FORMAT "%.15" /end MEASUREMENT
/begin MEASUREMENT FocDemoClosedLoop.modulator.p_status "" UBYTE NO_COMPU_METHOD 0 0 0 255 ECU_ADDRESS 0x8008AAE FORMAT "%.15" /end MEASUREMENT
/begin MEASUREMENT FocDemoClosedLoop.p_clearFault "" SBYTE NO_COMPU_METHOD 0 0 -1 0 BIT_MASK 0x1 ECU_ADDRESS 0x8008C59 FORMAT "%.15" /end MEASUREMENT
/begin CHARACTERISTIC FocDemoClosedLoop.p_clearFaultIsRequested "" VALUE 0x8008C5B __SBYTE_S 0 NO_COMPU_METHOD -1 0 BIT_MASK 0x1 EXTENDED_LIMITS -128 127 FORMAT "%.15" /end CHARACTERISTIC
/begin MEASUREMENT FocDemoClosedLoop.p_controlMode "" UBYTE Ifx_MS_FocSolutionF16_ControlMode 0 0 0 255 ECU_ADDRESS 0x8008C54 FORMAT "%6.3" /end MEASUREMENT
/begin MEASUREMENT FocDemoClosedLoop.p_currentReconstructionInfo "" UBYTE NO_COMPU_METHOD 0 0 0 255 ECU_ADDRESS 0x8008C55 FORMAT "%.15" /end MEASUREMENT
/begin MEASUREMENT FocDemoClosedLoop.p_currentReconstructionInfo.sector "" UBYTE NO_COMPU_METHOD 0 0 0 255 ECU_ADDRESS 0x8008C55 FORMAT "%.15" /end MEASUREMENT
/begin MEASUREMENT FocDemoClosedLoop.p_enableControl "" SBYTE NO_COMPU_METHOD 0 0 -1 0 BIT_MASK 0x1 ECU_ADDRESS 0x8008C58 FORMAT "%.15" /end MEASUREMENT
/begin MEASUREMENT FocDemoClosedLoop.p_enableDirectInterface "" SBYTE NO_COMPU_METHOD 0 0 -1 0 BIT_MASK 0x1 ECU_ADDRESS 0x8008C5A FORMAT "%.15" /end MEASUREMENT
/begin MEASUREMENT FocDemoClosedLoop.p_enablePowerStage "" SBYTE NO_COMPU_METHOD 0 0 -1 0 BIT_MASK 0x1 ECU_ADDRESS 0x8008C57 FORMAT "%.15" /end MEASUREMENT
/begin MEASUREMENT FocDemoClosedLoop.p_output "" UBYTE NO_COMPU_METHOD 0 0 0 255 ECU_ADDRESS 0x8008C48 FORMAT "%.15" /end MEASUREMENT
/begin MEASUREMENT FocDemoClosedLoop.p_previousQCommand "" SWORD NO_COMPU_METHOD 0 0 -32768 32767 ECU_ADDRESS 0x8008C50 FORMAT "%.15" /end MEASUREMENT
/begin MEASUREMENT FocDemoClosedLoop.p_qCommandZeroCrossing "" SBYTE NO_COMPU_METHOD 0 0 -1 0 BIT_MASK 0x1 ECU_ADDRESS 0x8008C5C FORMAT "%.15" /end MEASUREMENT
/begin MEASUREMENT FocDemoClosedLoop.p_status "" UBYTE NO_COMPU_METHOD 0 0 0 255 ECU_ADDRESS 0x8008BC4 FORMAT "%.15" /end MEASUREMENT
/begin MEASUREMENT FocDemoClosedLoop.patternGenCYT2B7 "" UBYTE NO_COMPU_METHOD 0 0 0 255 ECU_ADDRESS 0x8008AB4 FORMAT "%.15" /end MEASUREMENT
/begin MEASUREMENT FocDemoClosedLoop.patternGenCYT2B7._Super_Ifx_MHA_PatternGen "" UBYTE NO_COMPU_METHOD 0 0 0 255 ECU_ADDRESS 0x8008AB4 FORMAT "%.15" /end MEASUREMENT
/begin MEASUREMENT FocDemoClosedLoop.patternGenCYT2B7._Super_Ifx_MHA_PatternGen.p_clearFault "" SBYTE NO_COMPU_METHOD 0 0 -1 0 BIT_MASK 0x1 ECU_ADDRESS 0x8008AB5 FORMAT "%.15" /end MEASUREMENT
/begin MEASUREMENT FocDemoClosedLoop.patternGenCYT2B7._Super_Ifx_MHA_PatternGen.p_deadTimeMin_ns "" ULONG NO_COMPU_METHOD 0 0 0 4294967295 ECU_ADDRESS 0x8008AB8 FORMAT "%.15" /end MEASUREMENT
/begin MEASUREMENT FocDemoClosedLoop.patternGenCYT2B7._Super_Ifx_MHA_PatternGen.p_enable "" SBYTE NO_COMPU_METHOD 0 0 -1 0 BIT_MASK 0x1 ECU_ADDRESS 0x8008AB4 FORMAT "%.15" /end MEASUREMENT
/begin MEASUREMENT FocDemoClosedLoop.patternGenCYT2B7.p_compareValues_tick "" UBYTE NO_COMPU_METHOD 0 0 0 255 ECU_ADDRESS 0x8008ABC FORMAT "%.15" /end MEASUREMENT
/begin MEASUREMENT FocDemoClosedLoop.patternGenCYT2B7.p_compareValues_tick._0_ "" UWORD NO_COMPU_METHOD 0 0 0 65535 ECU_ADDRESS 0x8008ABC FORMAT "%.15" /end MEASUREMENT
/begin MEASUREMENT FocDemoClosedLoop.patternGenCYT2B7.p_compareValues_tick._1_ "" UWORD NO_COMPU_METHOD 0 0 0 65535 ECU_ADDRESS 0x8008ABE FORMAT "%.15" /end MEASUREMENT
/begin MEASUREMENT FocDemoClosedLoop.patternGenCYT2B7.p_compareValues_tick._2_ "" UWORD NO_COMPU_METHOD 0 0 0 65535 ECU_ADDRESS 0x8008AC0 FORMAT "%.15" /end MEASUREMENT
/begin MEASUREMENT FocDemoClosedLoop.patternGenCYT2B7.p_compareValues_tick._3_ "" UWORD NO_COMPU_METHOD 0 0 0 65535 ECU_ADDRESS 0x8008AC2 FORMAT "%.15" /end MEASUREMENT
/begin MEASUREMENT FocDemoClosedLoop.patternGenCYT2B7.p_compareValues_tick._4_ "" UWORD NO_COMPU_METHOD 0 0 0 65535 ECU_ADDRESS 0x8008AC4 FORMAT "%.15" /end MEASUREMENT
/begin MEASUREMENT FocDemoClosedLoop.patternGenCYT2B7.p_compareValues_tick._5_ "" UWORD NO_COMPU_METHOD 0 0 0 65535 ECU_ADDRESS 0x8008AC6 FORMAT "%.15" /end MEASUREMENT
/begin MEASUREMENT FocDemoClosedLoop.patternGenCYT2B7.p_status "" UBYTE NO_COMPU_METHOD 0 0 0 255 ECU_ADDRESS 0x8008ACC FORMAT "%.15" /end MEASUREMENT
/begin MEASUREMENT FocDemoClosedLoop.patternGenCYT2B7.p_status.state "" UBYTE Ifx_MHA_PatternGen_CYT2B7_State 0 0 0 255 ECU_ADDRESS 0x8008ACC FORMAT "%6.3" /end MEASUREMENT
/begin MEASUREMENT FocDemoClosedLoop.patternGenCYT2B7.p_triggerTime_tick "" UBYTE NO_COMPU_METHOD 0 0 0 255 ECU_ADDRESS 0x8008AC8 FORMAT "%.15" /end MEASUREMENT
/begin MEASUREMENT FocDemoClosedLoop.patternGenCYT2B7.p_triggerTime_tick._0_ "" UWORD NO_COMPU_METHOD 0 0 0 65535 ECU_ADDRESS 0x8008AC8 FORMAT "%.15" /end MEASUREMENT
/begin MEASUREMENT FocDemoClosedLoop.patternGenCYT2B7.p_triggerTime_tick._1_ "" UWORD NO_COMPU_METHOD 0 0 0 65535 ECU_ADDRESS 0x8008ACA FORMAT "%.15" /end MEASUREMENT
/begin MEASUREMENT FocDemoClosedLoop.previousCurrentReconstructionInfo "" UBYTE NO_COMPU_METHOD 0 0 0 255 ECU_ADDRESS 0x8008C56 FORMAT "%.15" /end MEASUREMENT
/begin MEASUREMENT FocDemoClosedLoop.previousCurrentReconstructionInfo.sector "" UBYTE NO_COMPU_METHOD 0 0 0 255 ECU_ADDRESS 0x8008C56 FORMAT "%.15" /end MEASUREMENT
/begin MEASUREMENT FocDemoClosedLoop.previousVoltageAlphaBeta "" UBYTE NO_COMPU_METHOD 0 0 0 255 ECU_ADDRESS 0x8008C2A FORMAT "%.15" /end MEASUREMENT
/begin MEASUREMENT FocDemoClosedLoop.previousVoltageAlphaBeta.imag "" SWORD NO_COMPU_METHOD 0 0 -32768 32767 ECU_ADDRESS 0x8008C2C FORMAT "%.15" /end MEASUREMENT
/begin MEASUREMENT FocDemoClosedLoop.previousVoltageAlphaBeta.real "" SWORD NO_COMPU_METHOD 0 0 -32768 32767 ECU_ADDRESS 0x8008C2A FORMAT "%.15" /end MEASUREMENT
/begin MEASUREMENT FocDemoClosedLoop.speedLimit "" UBYTE NO_COMPU_METHOD 0 0 0 255 ECU_ADDRESS 0x8008BC8 FORMAT "%.15" /end MEASUREMENT
/begin MEASUREMENT FocDemoClosedLoop.speedPi "" UBYTE NO_COMPU_METHOD 0 0 0 255 ECU_ADDRESS 0x8008BD8 FORMAT "%.15" /end MEASUREMENT
/begin MEASUREMENT FocDemoClosedLoop.speedPi.p_antiWindupGainSamplingTime "" UBYTE NO_COMPU_METHOD 0 0 0 255 ECU_ADDRESS 0x8008BE0 FORMAT "%.15" /end MEASUREMENT
/begin MEASUREMENT FocDemoClosedLoop.speedPi.p_integGainSamplingTime "" UBYTE NO_COMPU_METHOD 0 0 0 255 ECU_ADDRESS 0x8008BDC FORMAT "%.15" /end MEASUREMENT
/begin MEASUREMENT FocDemoClosedLoop.speedPi.p_integPreviousValue "" SLONG NO_COMPU_METHOD 0 0 -2147483648 2147483647 ECU_ADDRESS 0x8008BD8 FORMAT "%.15" /end MEASUREMENT
/begin MEASUREMENT FocDemoClosedLoop.speedPi.p_propGain "" UBYTE NO_COMPU_METHOD 0 0 0 255 ECU_ADDRESS 0x8008BE4 FORMAT "%.15" /end MEASUREMENT
/begin MEASUREMENT FocDemoClosedLoop.speedPi.p_qFormatAntiWindupGain "" UBYTE NO_COMPU_METHOD 0 0 0 255 ECU_ADDRESS 0x8008BF0 FORMAT "%.15" /end MEASUREMENT
/begin MEASUREMENT FocDemoClosedLoop.speedPi.p_qFormatIntegGain "" UBYTE NO_COMPU_METHOD 0 0 0 255 ECU_ADDRESS 0x8008BEF FORMAT "%.15" /end MEASUREMENT
/begin MEASUREMENT FocDemoClosedLoop.speedPi.p_qFormatPropGain "" UBYTE NO_COMPU_METHOD 0 0 0 255 ECU_ADDRESS 0x8008BEE FORMAT "%.15" /end MEASUREMENT
/begin MEASUREMENT FocDemoClosedLoop.vToF "" UBYTE NO_COMPU_METHOD 0 0 0 255 ECU_ADDRESS 0x8008C00 FORMAT "%.15" /end MEASUREMENT
/begin MEASUREMENT FocDemoClosedLoop.vToF.p_VToFLUTnorm "" UBYTE NO_COMPU_METHOD 0 0 0 255 ECU_ADDRESS 0x8008C00 FORMAT "%.15" /end MEASUREMENT
/begin MEASUREMENT FocDemoClosedLoop.vToF.p_VToFLUTnorm.p_cornerSpeedQ15 "" SWORD NO_COMPU_METHOD 0 0 -32768 32767 ECU_ADDRESS 0x8008C02 FORMAT "%.15" /end MEASUREMENT
/begin MEASUREMENT FocDemoClosedLoop.vToF.p_VToFLUTnorm.p_cornerVoltQ15 "" SWORD NO_COMPU_METHOD 0 0 -32768 32767 ECU_ADDRESS 0x8008C06 FORMAT "%.15" /end MEASUREMENT
/begin MEASUREMENT FocDemoClosedLoop.vToF.p_VToFLUTnorm.p_minVoltQ15 "" SWORD NO_COMPU_METHOD 0 0 -32768 32767 ECU_ADDRESS 0x8008C04 FORMAT "%.15" /end MEASUREMENT
/begin MEASUREMENT FocDemoClosedLoop.vToF.p_VToFLUTnorm.p_ratedSpeedQ15 "" SWORD NO_COMPU_METHOD 0 0 -32768 32767 ECU_ADDRESS 0x8008C00 FORMAT "%.15" /end MEASUREMENT
/begin MEASUREMENT FocDemoClosedLoop.vToF.p_VToFLUTnorm.p_ratedVoltQ15 "" SWORD NO_COMPU_METHOD 0 0 -32768 32767 ECU_ADDRESS 0x8008C08 FORMAT "%.15" /end MEASUREMENT
/begin MEASUREMENT FocDemoClosedLoop.vToF.p_angleIncrementQ14 "" SWORD NO_COMPU_METHOD 0 0 -32768 32767 ECU_ADDRESS 0x8008C18 FORMAT "%.15" /end MEASUREMENT
/begin MEASUREMENT FocDemoClosedLoop.vToF.p_anglePreviousValue "" ULONG NO_COMPU_METHOD 0 0 0 4294967295 ECU_ADDRESS 0x8008C14 FORMAT "%.15" /end MEASUREMENT
/begin MEASUREMENT FocDemoClosedLoop.vToF.p_output "" UBYTE NO_COMPU_METHOD 0 0 0 255 ECU_ADDRESS 0x8008C0C FORMAT "%.15" /end MEASUREMENT
/begin MEASUREMENT FocDemoClosedLoop.vToF.p_output.voltageVector "" UBYTE NO_COMPU_METHOD 0 0 0 255 ECU_ADDRESS 0x8008C0C FORMAT "%.15" /end MEASUREMENT
/begin MEASUREMENT FocDemoClosedLoop.vToF.p_output.voltageVector.amplitude "" SWORD NO_COMPU_METHOD 0 0 -32768 32767 ECU_ADDRESS 0x8008C0C FORMAT "%.15" /end MEASUREMENT
/begin MEASUREMENT FocDemoClosedLoop.vToF.p_output.voltageVector.angle "" ULONG NO_COMPU_METHOD 0 0 0 4294967295 ECU_ADDRESS 0x8008C10 FORMAT "%.15" /end MEASUREMENT
/begin MEASUREMENT FocDemoClosedLoop.voltageAlphaBeta "" UBYTE NO_COMPU_METHOD 0 0 0 255 ECU_ADDRESS 0x8008C26 FORMAT "%.15" /end MEASUREMENT
/begin CHARACTERISTIC HEAT__R "" VALUE 0x8001178 __FLOAT32_IEEE_S 0 NO_COMPU_METHOD -3.40282346639E+38 3.40282346639E+38 FORMAT "%.15" /end CHARACTERISTIC
/begin MEASUREMENT IPMFAULT_STATE "" UBYTE NO_COMPU_METHOD 0 0 0 255 ECU_ADDRESS 0x80093D4 FORMAT "%.15" /end MEASUREMENT
/begin MEASUREMENT M4_ControlMode "0: VToF, 1: IToF or FOC" UBYTE NO_COMPU_METHOD 0 0 0 1 ECU_ADDRESS 0x80085CD FORMAT "%1.0" /end MEASUREMENT
/begin MEASUREMENT M4_EnableControl "FOC control enable request" UBYTE NO_COMPU_METHOD 0 0 0 1 ECU_ADDRESS 0x80085CC FORMAT "%1.0" /end MEASUREMENT
/begin MEASUREMENT M4_EnableDirectInterface "FOC direct interface enable request" UBYTE NO_COMPU_METHOD 0 0 0 1 ECU_ADDRESS 0x80085CE FORMAT "%1.0" /end MEASUREMENT
/begin MEASUREMENT M4_EnablePowerStage "FOC power stage enable request" UBYTE NO_COMPU_METHOD 0 0 0 1 ECU_ADDRESS 0x80085CB FORMAT "%1.0" /end MEASUREMENT
/begin MEASUREMENT M4_ReferenceSpeedQ0 "FOC reference speed in rpm" SWORD NO_COMPU_METHOD 0 0 -32768 32767 ECU_ADDRESS 0x80085D0 FORMAT "%6.0"
 /begin IF_DATA XCP
  /begin DAQ_EVENT VARIABLE /end DAQ_EVENT
 /end IF_DATA
/end MEASUREMENT
/begin MEASUREMENT M4_RotorAlignCounter "Remaining rotor alignment steps" UWORD NO_COMPU_METHOD 0 0 0 666 ECU_ADDRESS 0x80085D2 FORMAT "%6.0" /end MEASUREMENT
/begin MEASUREMENT Meas_ADRC_Speed_Active_u8 "" UBYTE NO_COMPU_METHOD 0 0 0 255 ECU_ADDRESS 0x800D28E FORMAT "%.15" /end MEASUREMENT
/begin MEASUREMENT Meas_ADRC_Speed_EstimatedAcceleration_PU_per_s_f32 "" FLOAT32_IEEE NO_COMPU_METHOD 0 0 -3.40282346639E+38 3.40282346639E+38 ECU_ADDRESS 0x800D2B0 FORMAT "%.15" /end MEASUREMENT
/begin MEASUREMENT Meas_ADRC_Speed_EstimatedDisturbance_PU_per_s2_f32 "" FLOAT32_IEEE NO_COMPU_METHOD 0 0 -3.40282346639E+38 3.40282346639E+38 ECU_ADDRESS 0x800D2B4 FORMAT "%.15" /end MEASUREMENT
/begin MEASUREMENT Meas_ADRC_Speed_EstimatedSpeed_PU_f32 "" FLOAT32_IEEE NO_COMPU_METHOD 0 0 -3.40282346639E+38 3.40282346639E+38 ECU_ADDRESS 0x800D2AC FORMAT "%.15" /end MEASUREMENT
/begin MEASUREMENT Meas_ADRC_Speed_IqRef_Q15_s16 "" SWORD Foc_Q15_to_A 0 0 -32768 32767 ECU_ADDRESS 0x800D292 /end MEASUREMENT
/begin MEASUREMENT Meas_ADRC_Speed_Output_PU_f32 "" FLOAT32_IEEE NO_COMPU_METHOD 0 0 -3.40282346639E+38 3.40282346639E+38 ECU_ADDRESS 0x800D2A8 FORMAT "%.15" /end MEASUREMENT
/begin MEASUREMENT Meas_ADRC_Speed_ReferenceFiltered_PU_f32 "" FLOAT32_IEEE NO_COMPU_METHOD 0 0 -3.40282346639E+38 3.40282346639E+38 ECU_ADDRESS 0x800D2A4 FORMAT "%.15" /end MEASUREMENT
/begin MEASUREMENT Meas_ADRC_Speed_Status_u8 "" UBYTE NO_COMPU_METHOD 0 0 0 255 ECU_ADDRESS 0x800D290 FORMAT "%.15" /end MEASUREMENT
/begin MEASUREMENT Meas_ADRC_Speed_Valid_u8 "" UBYTE NO_COMPU_METHOD 0 0 0 255 ECU_ADDRESS 0x800D28F FORMAT "%.15" /end MEASUREMENT
/begin MEASUREMENT Meas_FWC_Act_u8 "" UBYTE NO_COMPU_METHOD 0 0 0 255 ECU_ADDRESS 0x800D002 FORMAT "%.15" /end MEASUREMENT
/begin MEASUREMENT Meas_FWC_CurAw_Act_u8 "" UBYTE NO_COMPU_METHOD 0 0 0 255 ECU_ADDRESS 0x800D007 FORMAT "%.15" /end MEASUREMENT
/begin MEASUREMENT Meas_FWC_IdBase_Q15_s16 "" SWORD Foc_Q15_to_A 0 0 -32768 32767 ECU_ADDRESS 0x800D010 FORMAT "%.15" /end MEASUREMENT
/begin MEASUREMENT Meas_FWC_IdFw_Q15_s16 "" SWORD Foc_Q15_to_A 0 0 -32768 32767 ECU_ADDRESS 0x800D00C FORMAT "%.15" /end MEASUREMENT
/begin MEASUREMENT Meas_FWC_IdRef_Q15_s16 "" SWORD Foc_Q15_to_A 0 0 -32768 32767 ECU_ADDRESS 0x800D012 FORMAT "%.15" /end MEASUREMENT
/begin MEASUREMENT Meas_FWC_IqRef_Q15_s16 "" SWORD Foc_Q15_to_A 0 0 -32768 32767 ECU_ADDRESS 0x800D014 FORMAT "%.15" /end MEASUREMENT
/begin MEASUREMENT Meas_FWC_RecoveryCnt_u32 "" ULONG NO_COMPU_METHOD 0 0 0 4294967295 ECU_ADDRESS 0x800D04C FORMAT "%.15" /end MEASUREMENT
/begin MEASUREMENT Meas_FWC_RefGov_Act_u8 "" UBYTE NO_COMPU_METHOD 0 0 0 255 ECU_ADDRESS 0x800D006 FORMAT "%.15" /end MEASUREMENT
/begin MEASUREMENT Meas_FWC_Sat_u8 "" UBYTE NO_COMPU_METHOD 0 0 0 255 ECU_ADDRESS 0x800D005 FORMAT "%.15" /end MEASUREMENT
/begin MEASUREMENT Meas_FWC_Stat_u8 "" UBYTE NO_COMPU_METHOD 0 0 0 255 ECU_ADDRESS 0x800D004 FORMAT "%.15" /end MEASUREMENT
/begin MEASUREMENT Meas_FWC_VactFlt_PU_f32 "" FLOAT32_IEEE NO_COMPU_METHOD 0 0 -3.40282346639E+38 3.40282346639E+38 ECU_ADDRESS 0x800D040 FORMAT "%.15" /end MEASUREMENT
/begin MEASUREMENT Meas_FWC_Valid_u8 "" UBYTE NO_COMPU_METHOD 0 0 0 255 ECU_ADDRESS 0x800D003 FORMAT "%.15" /end MEASUREMENT
/begin MEASUREMENT Meas_FWC_Vdc_Q15_s16 "" SWORD Foc_Q15_to_V 0 0 -32768 32767 ECU_ADDRESS 0x800D00E FORMAT "%.15" /end MEASUREMENT
/begin MEASUREMENT Meas_FWC_VreqFlt_PU_f32 "" FLOAT32_IEEE NO_COMPU_METHOD 0 0 -3.40282346639E+38 3.40282346639E+38 ECU_ADDRESS 0x800D03C FORMAT "%.15" /end MEASUREMENT
/begin MEASUREMENT Meas_FWC_VutilAct_PU_f32 "" FLOAT32_IEEE NO_COMPU_METHOD 0 0 -3.40282346639E+38 3.40282346639E+38 ECU_ADDRESS 0x800D048 FORMAT "%.15" /end MEASUREMENT
/begin MEASUREMENT Meas_FWC_VutilReq_PU_f32 "" FLOAT32_IEEE NO_COMPU_METHOD 0 0 -3.40282346639E+38 3.40282346639E+38 ECU_ADDRESS 0x800D044 FORMAT "%.15" /end MEASUREMENT
/begin MEASUREMENT Meas_FWC_WeakAct_u8 "" UBYTE NO_COMPU_METHOD 0 0 0 255 ECU_ADDRESS 0x800D001 FORMAT "%.15" /end MEASUREMENT
/begin MEASUREMENT Meas_FocActualControlMode "FOC actual control mode, read-only" UBYTE Ifx_MS_FocSolutionF16_ControlMode 0 0 0 255 ECU_ADDRESS 0x8008BC6 FORMAT "%3.0" SYMBOL_LINK "FocDemoClosedLoop.p_status.actualControlMode" 0 /end MEASUREMENT
/begin MEASUREMENT Meas_FocAdcTriggerTime1_tick_u16 "FOC ADC trigger time 1, timer ticks, read-only" UWORD NO_COMPU_METHOD 0 0 0 65535 ECU_ADDRESS 0x8008A9C FORMAT "%6.0" SYMBOL_LINK "FocDemoClosedLoop.modulator.p_output.triggerTime_tick._0_" 0 /end MEASUREMENT
/begin MEASUREMENT Meas_FocAdcTriggerTime2_tick_u16 "FOC ADC trigger time 2, timer ticks, read-only" UWORD NO_COMPU_METHOD 0 0 0 65535 ECU_ADDRESS 0x8008A9E FORMAT "%6.0" SYMBOL_LINK "FocDemoClosedLoop.modulator.p_output.triggerTime_tick._1_" 0 /end MEASUREMENT
/begin MEASUREMENT Meas_FocCurrentCommandD_A_s16 "FOC D-axis current command, A, observation" SWORD Foc_Q15_to_A 0 0 -32768 32767 ECU_ADDRESS 0x8008C2E SYMBOL_LINK "FocDemoClosedLoop.dqCommand.real" 0 /end MEASUREMENT
/begin MEASUREMENT Meas_FocCurrentCommandQ_A_s16 "FOC Q-axis current command, A, observation" SWORD Foc_Q15_to_A 0 0 -32768 32767 ECU_ADDRESS 0x8008C30 SYMBOL_LINK "FocDemoClosedLoop.dqCommand.imag" 0 /end MEASUREMENT
/begin MEASUREMENT Meas_FocCurrentFeedbackAlpha_A_s16 "FOC alpha-axis measured current feedback, A, observation" SWORD Foc_Q15_to_A 0 0 -32768 32767 ECU_ADDRESS 0x8008C22 SYMBOL_LINK "FocDemoClosedLoop.currentsAlphaBeta.real" 0 /end MEASUREMENT
/begin MEASUREMENT Meas_FocCurrentFeedbackBeta_A_s16 "FOC beta-axis measured current feedback, A, observation" SWORD Foc_Q15_to_A 0 0 -32768 32767 ECU_ADDRESS 0x8008C24 SYMBOL_LINK "FocDemoClosedLoop.currentsAlphaBeta.imag" 0 /end MEASUREMENT
/begin MEASUREMENT Meas_FocCurrentFeedbackDQ_D_A_s16 "FOC D-axis current feedback, A, observation" SWORD Foc_Q15_to_A 0 0 -32768 32767 ECU_ADDRESS 0x8008A64 SYMBOL_LINK "FocDemoClosedLoop.focController.currentDQ.real" 0 /end MEASUREMENT
/begin MEASUREMENT Meas_FocCurrentFeedbackDQ_Q_A_s16 "FOC Q-axis current feedback, A, observation" SWORD Foc_Q15_to_A 0 0 -32768 32767 ECU_ADDRESS 0x8008A66 SYMBOL_LINK "FocDemoClosedLoop.focController.currentDQ.imag" 0 /end MEASUREMENT
/begin MEASUREMENT Meas_FocCurrentFeedbackShunt1_A_s16 "FOC shunt current 1 feedback, A, observation" SWORD Foc_Q15_to_A 0 0 -32768 32767 ECU_ADDRESS 0x8008B18 SYMBOL_LINK "FocDemoClosedLoop.measurementADCCYT2B7.p_output.shuntCurrentsQ15._0_" 0 /end MEASUREMENT
/begin MEASUREMENT Meas_FocCurrentFeedbackShunt2_A_s16 "FOC shunt current 2 feedback, A, observation" SWORD Foc_Q15_to_A 0 0 -32768 32767 ECU_ADDRESS 0x8008B1A SYMBOL_LINK "FocDemoClosedLoop.measurementADCCYT2B7.p_output.shuntCurrentsQ15._1_" 0 /end MEASUREMENT
/begin MEASUREMENT Meas_FocCurrentFeedbackU_A_s16 "FOC U-phase measured current feedback, A, observation" SWORD Foc_Q15_to_A 0 0 -32768 32767 ECU_ADDRESS 0x8008C1C SYMBOL_LINK "FocDemoClosedLoop.currentsUVW.u" 0 /end MEASUREMENT
/begin MEASUREMENT Meas_FocCurrentFeedbackV_A_s16 "FOC V-phase measured current feedback, A, observation" SWORD Foc_Q15_to_A 0 0 -32768 32767 ECU_ADDRESS 0x8008C1E SYMBOL_LINK "FocDemoClosedLoop.currentsUVW.v" 0 /end MEASUREMENT
/begin MEASUREMENT Meas_FocCurrentFeedbackW_A_s16 "FOC W-phase measured current feedback, A, observation" SWORD Foc_Q15_to_A 0 0 -32768 32767 ECU_ADDRESS 0x8008C20 SYMBOL_LINK "FocDemoClosedLoop.currentsUVW.w" 0 /end MEASUREMENT
/begin MEASUREMENT Meas_FocDcLinkVoltageFeedback_V_s16 "FOC DC-link voltage feedback, V, observation" SWORD Foc_Q15_to_V 0 0 -32768 32767 ECU_ADDRESS 0x8008B16 SYMBOL_LINK "FocDemoClosedLoop.measurementADCCYT2B7.p_output.dcLinkVoltageQ15" 0 /end MEASUREMENT
/begin MEASUREMENT Meas_FocElectricalAngleEstimate_rad_u32 "FOC estimated electrical angle, rad, observation" ULONG Foc_Q32_to_rad 0 0 0 4294967295 ECU_ADDRESS 0x8008C34 SYMBOL_LINK "FocDemoClosedLoop.angle" 0 /end MEASUREMENT
/begin MEASUREMENT Meas_FocFluxAngleEstimate_rad_u32 "FOC flux-estimator angle estimate, rad, observation" ULONG Foc_Q32_to_rad 0 0 0 4294967295 ECU_ADDRESS 0x8008BA0 SYMBOL_LINK "FocDemoClosedLoop.fluxEstimator.p_output.anglePLL" 0 /end MEASUREMENT
/begin MEASUREMENT Meas_FocIToFAngleCommand_rad_u32 "FOC IToF current-vector angle command, rad, observation" ULONG Foc_Q32_to_rad 0 0 0 4294967295 ECU_ADDRESS 0x8008BB8 SYMBOL_LINK "FocDemoClosedLoop.iToF.p_output.currentVecAngle_rad" 0 /end MEASUREMENT
/begin MEASUREMENT Meas_FocM0FaultStatus_u32 "M0 fault status word received by FOC, read-only" ULONG NO_COMPU_METHOD 0 0 0 4294967295 ECU_ADDRESS 0x8008C60 FORMAT "%10.0" SYMBOL_LINK "FocDemoClosedLoop.p_m0FaultStatus" 0 /end MEASUREMENT
/begin MEASUREMENT Meas_FocMaxAmplitudeActive_u8 "FOC maximum amplitude active flag, read-only" SBYTE NO_COMPU_METHOD 0 0 -1 0 BIT_MASK 0x1 ECU_ADDRESS 0x8008AAF FORMAT "%3.0" SYMBOL_LINK "FocDemoClosedLoop.modulator.p_status.maxAmplitudeFlag" 0 /end MEASUREMENT
/begin MEASUREMENT Meas_FocModulatorState "FOC modulator state, read-only" UBYTE Ifx_MAS_ModulatorF16_State 0 0 0 255 ECU_ADDRESS 0x8008AAE FORMAT "%3.0" SYMBOL_LINK "FocDemoClosedLoop.modulator.p_status.state" 0 /end MEASUREMENT
/begin MEASUREMENT Meas_FocOvermodulationActive_u8 "FOC overmodulation active flag, read-only" SBYTE NO_COMPU_METHOD 0 0 -1 0 BIT_MASK 0x1 ECU_ADDRESS 0x8008AB0 FORMAT "%3.0" SYMBOL_LINK "FocDemoClosedLoop.modulator.p_status.overmodulationFlag" 0 /end MEASUREMENT
/begin MEASUREMENT Meas_FocPwmCompareUDown_tick_u16 "FOC PWM U down-count compare value, timer ticks, read-only" UWORD NO_COMPU_METHOD 0 0 0 65535 ECU_ADDRESS 0x8008A96 FORMAT "%6.0" SYMBOL_LINK "FocDemoClosedLoop.modulator.p_output.compareValues_tick._3_" 0 /end MEASUREMENT
/begin MEASUREMENT Meas_FocPwmCompareUUp_tick_u16 "FOC PWM U up-count compare value, timer ticks, read-only" UWORD NO_COMPU_METHOD 0 0 0 65535 ECU_ADDRESS 0x8008A90 FORMAT "%6.0" SYMBOL_LINK "FocDemoClosedLoop.modulator.p_output.compareValues_tick._0_" 0 /end MEASUREMENT
/begin MEASUREMENT Meas_FocPwmCompareVDown_tick_u16 "FOC PWM V down-count compare value, timer ticks, read-only" UWORD NO_COMPU_METHOD 0 0 0 65535 ECU_ADDRESS 0x8008A98 FORMAT "%6.0" SYMBOL_LINK "FocDemoClosedLoop.modulator.p_output.compareValues_tick._4_" 0 /end MEASUREMENT
/begin MEASUREMENT Meas_FocPwmCompareVUp_tick_u16 "FOC PWM V up-count compare value, timer ticks, read-only" UWORD NO_COMPU_METHOD 0 0 0 65535 ECU_ADDRESS 0x8008A92 FORMAT "%6.0" SYMBOL_LINK "FocDemoClosedLoop.modulator.p_output.compareValues_tick._1_" 0 /end MEASUREMENT
/begin MEASUREMENT Meas_FocPwmCompareWDown_tick_u16 "FOC PWM W down-count compare value, timer ticks, read-only" UWORD NO_COMPU_METHOD 0 0 0 65535 ECU_ADDRESS 0x8008A9A FORMAT "%6.0" SYMBOL_LINK "FocDemoClosedLoop.modulator.p_output.compareValues_tick._5_" 0 /end MEASUREMENT
/begin MEASUREMENT Meas_FocPwmCompareWUp_tick_u16 "FOC PWM W up-count compare value, timer ticks, read-only" UWORD NO_COMPU_METHOD 0 0 0 65535 ECU_ADDRESS 0x8008A94 FORMAT "%6.0" SYMBOL_LINK "FocDemoClosedLoop.modulator.p_output.compareValues_tick._2_" 0 /end MEASUREMENT
/begin MEASUREMENT Meas_FocSpeedCommandRateLimited_rpm_s16 "FOC speed command after limiting and ramp, rpm, observation" SWORD Foc_Q15_to_rpm 0 0 -32768 32767 ECU_ADDRESS 0x8008C4A SYMBOL_LINK "FocDemoClosedLoop.rateLimitInSpeedQ15" 0 /end MEASUREMENT
/begin MEASUREMENT Meas_FocSpeedFeedbackEstimated_rpm_s16 "FOC estimated mechanical speed feedback, rpm, observation" SWORD Foc_Q15_to_rpm 0 0 -32768 32767 ECU_ADDRESS 0x8008C48 SYMBOL_LINK "FocDemoClosedLoop.p_output.estimatedSpeedQ15" 0 /end MEASUREMENT
/begin MEASUREMENT Meas_FocSpeedFeedbackFluxEstimate_radps_s16 "FOC flux-estimator speed feedback, rad/s, observation" SWORD Foc_Q15_to_radps 0 0 -32768 32767 ECU_ADDRESS 0x8008B9C SYMBOL_LINK "FocDemoClosedLoop.fluxEstimator.p_output.speedQ15" 0 /end MEASUREMENT
/begin MEASUREMENT Meas_FocState "FOC main state, read-only" UBYTE Ifx_MS_FocSolutionF16_State 0 0 0 255 ECU_ADDRESS 0x8008BC4 FORMAT "%3.0" SYMBOL_LINK "FocDemoClosedLoop.p_status.state" 0 /end MEASUREMENT
/begin MEASUREMENT Meas_FocSubState "FOC sub-state, read-only" UBYTE Ifx_MS_FocSolutionF16_SubState 0 0 0 255 ECU_ADDRESS 0x8008BC5 FORMAT "%3.0" SYMBOL_LINK "FocDemoClosedLoop.p_status.subState" 0 /end MEASUREMENT
/begin MEASUREMENT Meas_FocVoltageCommandAmplitude_V_s16 "FOC voltage command amplitude, V, observation" SWORD Foc_Q15_to_V 0 0 -32768 32767 ECU_ADDRESS 0x8008A5C SYMBOL_LINK "FocDemoClosedLoop.focController.p_output.voltageCommandPolar.amplitude" 0 /end MEASUREMENT
/begin MEASUREMENT Meas_FocVoltageCommandAngle_rad_u32 "FOC voltage command angle, rad, observation" ULONG Foc_Q32_to_rad 0 0 0 4294967295 ECU_ADDRESS 0x8008A60 SYMBOL_LINK "FocDemoClosedLoop.focController.p_output.voltageCommandPolar.angle" 0 /end MEASUREMENT
/begin MEASUREMENT Meas_FocVoltageCommandDQ_D_V_s16 "FOC D-axis voltage command, V, observation" SWORD Foc_Q15_to_V 0 0 -32768 32767 ECU_ADDRESS 0x8008A68 READ_WRITE SYMBOL_LINK "FocDemoClosedLoop.focController.voltageDQ.real" 0 /end MEASUREMENT
/begin MEASUREMENT Meas_FocVoltageCommandDQ_Q_V_s16 "FOC Q-axis voltage command, V, observation" SWORD Foc_Q15_to_V 0 0 -32768 32767 ECU_ADDRESS 0x8008A6A SYMBOL_LINK "FocDemoClosedLoop.focController.voltageDQ.imag" 0 /end MEASUREMENT
/begin MEASUREMENT Meas_FocVoltageCommandVToFAmplitude_V_s16 "FOC VToF voltage command amplitude, V, observation" SWORD Foc_Q15_to_V 0 0 -32768 32767 ECU_ADDRESS 0x8008C0C SYMBOL_LINK "FocDemoClosedLoop.vToF.p_output.voltageVector.amplitude" 0 /end MEASUREMENT
/begin MEASUREMENT Meas_FocVoltageCommandVToFAngle_rad_u32 "FOC VToF voltage command angle, rad, observation" ULONG Foc_Q32_to_rad 0 0 0 4294967295 ECU_ADDRESS 0x8008C10 SYMBOL_LINK "FocDemoClosedLoop.vToF.p_output.voltageVector.angle" 0 /end MEASUREMENT
/begin MEASUREMENT Meas_FocVoltageOutputAlpha_V_s16 "FOC applied alpha-axis voltage output, V, observation" SWORD Foc_Q15_to_V 0 0 -32768 32767 ECU_ADDRESS 0x8008C26 SYMBOL_LINK "FocDemoClosedLoop.voltageAlphaBeta.real" 0 /end MEASUREMENT
/begin MEASUREMENT Meas_FocVoltageOutputAmplitude_V_s16 "FOC modulator applied voltage amplitude, V, observation" SWORD Foc_Q15_to_V 0 0 -32768 32767 ECU_ADDRESS 0x8008AA0 SYMBOL_LINK "FocDemoClosedLoop.modulator.p_output.actualVoltage.amplitude" 0 /end MEASUREMENT
/begin MEASUREMENT Meas_FocVoltageOutputAngle_rad_u32 "FOC modulator applied voltage angle, rad, observation" ULONG Foc_Q32_to_rad 0 0 0 4294967295 ECU_ADDRESS 0x8008AA4 SYMBOL_LINK "FocDemoClosedLoop.modulator.p_output.actualVoltage.angle" 0 /end MEASUREMENT
/begin MEASUREMENT Meas_FocVoltageOutputBeta_V_s16 "FOC applied beta-axis voltage output, V, observation" SWORD Foc_Q15_to_V 0 0 -32768 32767 ECU_ADDRESS 0x8008C28 SYMBOL_LINK "FocDemoClosedLoop.voltageAlphaBeta.imag" 0 /end MEASUREMENT
/begin MEASUREMENT Meas_FocVoltageOutputPreviousAlpha_V_s16 "FOC previous applied alpha-axis voltage output, V, observation" SWORD Foc_Q15_to_V 0 0 -32768 32767 ECU_ADDRESS 0x8008C2A SYMBOL_LINK "FocDemoClosedLoop.previousVoltageAlphaBeta.real" 0 /end MEASUREMENT
/begin MEASUREMENT Meas_FocVoltageOutputPreviousBeta_V_s16 "FOC previous applied beta-axis voltage output, V, observation" SWORD Foc_Q15_to_V 0 0 -32768 32767 ECU_ADDRESS 0x8008C2C SYMBOL_LINK "FocDemoClosedLoop.previousVoltageAlphaBeta.imag" 0 /end MEASUREMENT
/begin MEASUREMENT Meas_Foc_FastLoopOverrunCount_u32 "" ULONG NO_COMPU_METHOD 0 0 0 4294967295 ECU_ADDRESS 0x800D2D0 FORMAT "%.15" /end MEASUREMENT
/begin MEASUREMENT Meas_Foc_IdleSvcCount_u32 "" ULONG NO_COMPU_METHOD 0 0 0 4294967295 ECU_ADDRESS 0x800D2E4 FORMAT "%.15" /end MEASUREMENT
/begin MEASUREMENT Meas_IdMap_Act_u8 "" UBYTE NO_COMPU_METHOD 0 0 0 255 ECU_ADDRESS 0x800D396 FORMAT "%.15" /end MEASUREMENT
/begin MEASUREMENT Meas_IdMap_Id_A_f32 "" FLOAT32_IEEE NO_COMPU_METHOD 0 0 -3.40282346639E+38 3.40282346639E+38 ECU_ADDRESS 0x800D1B0 FORMAT "%.15" /end MEASUREMENT
/begin MEASUREMENT Meas_IdMap_Id_Q15_s16 "" SWORD NO_COMPU_METHOD 0 0 -32768 32767 ECU_ADDRESS 0x800D1A4 FORMAT "%.15" /end MEASUREMENT
/begin MEASUREMENT Meas_IdMap_Iq_A_f32 "" FLOAT32_IEEE NO_COMPU_METHOD 0 0 -3.40282346639E+38 3.40282346639E+38 ECU_ADDRESS 0x800D1AC FORMAT "%.15" /end MEASUREMENT
/begin MEASUREMENT Meas_IdMap_IsFbkFlt_Q15_s16 "" SWORD Foc_Q15_to_A 0 0 -32768 32767 ECU_ADDRESS 0x800D1A6 /end MEASUREMENT
/begin MEASUREMENT Meas_IdMap_Spd_rpm_f32 "" FLOAT32_IEEE NO_COMPU_METHOD 0 0 -3.40282346639E+38 3.40282346639E+38 ECU_ADDRESS 0x800D1A8 FORMAT "%.15" /end MEASUREMENT
/begin MEASUREMENT Meas_IdMap_Stat_u8 "" UBYTE NO_COMPU_METHOD 0 0 0 255 ECU_ADDRESS 0x800D19C FORMAT "%.15" /end MEASUREMENT
/begin MEASUREMENT Meas_IdMap_Valid_u8 "" UBYTE NO_COMPU_METHOD 0 0 0 255 ECU_ADDRESS 0x800D19D FORMAT "%.15" /end MEASUREMENT
/begin MEASUREMENT Meas_KRE_ActFluxA_Wb_f32 "" FLOAT32_IEEE NO_COMPU_METHOD 0 0 -3.40282346639E+38 3.40282346639E+38 ECU_ADDRESS 0x800D1F0 FORMAT "%.15" /end MEASUREMENT
/begin MEASUREMENT Meas_KRE_ActFluxB_Wb_f32 "" FLOAT32_IEEE NO_COMPU_METHOD 0 0 -3.40282346639E+38 3.40282346639E+38 ECU_ADDRESS 0x800D1F4 FORMAT "%.15" /end MEASUREMENT
/begin MEASUREMENT Meas_Kre_ElecAngle_rad_f32 "" FLOAT32_IEEE NO_COMPU_METHOD 0 0 -3.40282346639E+38 3.40282346639E+38 ECU_ADDRESS 0x800D1E0 FORMAT "%.15" /end MEASUREMENT
/begin MEASUREMENT Meas_Kre_MechSpeed_rpm_f32 "" FLOAT32_IEEE NO_COMPU_METHOD 0 0 -3.40282346639E+38 3.40282346639E+38 ECU_ADDRESS 0x800D1E4 FORMAT "%.15" /end MEASUREMENT
/begin MEASUREMENT Meas_Kre_RotorFluxMag_Wb_f32 "" FLOAT32_IEEE NO_COMPU_METHOD 0 0 -3.40282346639E+38 3.40282346639E+38 ECU_ADDRESS 0x800D1E8 FORMAT "%.15" /end MEASUREMENT
/begin MEASUREMENT Meas_Kre_Status_u8 "" UBYTE NO_COMPU_METHOD 0 0 0 255 ECU_ADDRESS 0x800D1D9 FORMAT "%.15" /end MEASUREMENT
/begin MEASUREMENT Meas_Kre_Valid_u8 "" UBYTE NO_COMPU_METHOD 0 0 0 255 ECU_ADDRESS 0x800D1D8 FORMAT "%.15" /end MEASUREMENT
/begin MEASUREMENT Meas_MCU_FastAdc_pct_f32 "" FLOAT32_IEEE NO_COMPU_METHOD 0 0 -3.40282346639E+38 3.40282346639E+38 ECU_ADDRESS 0x800D350 FORMAT "%.15" /end MEASUREMENT
/begin MEASUREMENT Meas_MCU_FastCtrl_pct_f32 "" FLOAT32_IEEE NO_COMPU_METHOD 0 0 -3.40282346639E+38 3.40282346639E+38 ECU_ADDRESS 0x800D358 FORMAT "%.15" /end MEASUREMENT
/begin MEASUREMENT Meas_MCU_FastMod_pct_f32 "" FLOAT32_IEEE NO_COMPU_METHOD 0 0 -3.40282346639E+38 3.40282346639E+38 ECU_ADDRESS 0x800D360 FORMAT "%.15" /end MEASUREMENT
/begin MEASUREMENT Meas_MCU_FastObs_pct_f32 "" FLOAT32_IEEE NO_COMPU_METHOD 0 0 -3.40282346639E+38 3.40282346639E+38 ECU_ADDRESS 0x800D354 FORMAT "%.15" /end MEASUREMENT
/begin MEASUREMENT Meas_MCU_FastOther_pct_f32 "" FLOAT32_IEEE NO_COMPU_METHOD 0 0 -3.40282346639E+38 3.40282346639E+38 ECU_ADDRESS 0x800D36C FORMAT "%.15" /end MEASUREMENT
/begin MEASUREMENT Meas_MCU_FastPwm_pct_f32 "" FLOAT32_IEEE NO_COMPU_METHOD 0 0 -3.40282346639E+38 3.40282346639E+38 ECU_ADDRESS 0x800D368 FORMAT "%.15" /end MEASUREMENT
/begin MEASUREMENT Meas_MCU_FastSamples_u32 "" ULONG NO_COMPU_METHOD 0 0 0 4294967295 ECU_ADDRESS 0x800D370 FORMAT "%.15" /end MEASUREMENT
/begin MEASUREMENT Meas_MCU_FastVPost_pct_f32 "" FLOAT32_IEEE NO_COMPU_METHOD 0 0 -3.40282346639E+38 3.40282346639E+38 ECU_ADDRESS 0x800D364 FORMAT "%.15" /end MEASUREMENT
/begin MEASUREMENT Meas_MCU_FastVPre_pct_f32 "" FLOAT32_IEEE NO_COMPU_METHOD 0 0 -3.40282346639E+38 3.40282346639E+38 ECU_ADDRESS 0x800D35C FORMAT "%.15" /end MEASUREMENT
/begin MEASUREMENT Meas_MCU_FocFastLastCycles_u32 "" ULONG NO_COMPU_METHOD 0 0 0 4294967295 ECU_ADDRESS 0x800D2F0 FORMAT "%.15" /end MEASUREMENT
/begin MEASUREMENT Meas_MCU_FocFastLoad_pct_f32 "" FLOAT32_IEEE NO_COMPU_METHOD 0 0 -3.40282346639E+38 3.40282346639E+38 ECU_ADDRESS 0x800D2EC FORMAT "%.15" /end MEASUREMENT
/begin MEASUREMENT Meas_MCU_FocFastMaxCycles_u32 "" ULONG NO_COMPU_METHOD 0 0 0 4294967295 ECU_ADDRESS 0x800D2F4 FORMAT "%.15" /end MEASUREMENT
/begin MEASUREMENT Meas_MCU_FocSpdLastCycles_u32 "" ULONG NO_COMPU_METHOD 0 0 0 4294967295 ECU_ADDRESS 0x800D2FC FORMAT "%.15" /end MEASUREMENT
/begin MEASUREMENT Meas_MCU_FocSpdLoad_pct_f32 "" FLOAT32_IEEE NO_COMPU_METHOD 0 0 -3.40282346639E+38 3.40282346639E+38 ECU_ADDRESS 0x800D2F8 FORMAT "%.15" /end MEASUREMENT
/begin MEASUREMENT Meas_MCU_FocSpdMaxCycles_u32 "" ULONG NO_COMPU_METHOD 0 0 0 4294967295 ECU_ADDRESS 0x800D300 FORMAT "%.15" /end MEASUREMENT
/begin MEASUREMENT Meas_MCU_GpioIrqLastCycles_u32 "" ULONG NO_COMPU_METHOD 0 0 0 4294967295 ECU_ADDRESS 0x800D314 FORMAT "%.15" /end MEASUREMENT
/begin MEASUREMENT Meas_MCU_GpioIrqLoad_pct_f32 "" FLOAT32_IEEE NO_COMPU_METHOD 0 0 -3.40282346639E+38 3.40282346639E+38 ECU_ADDRESS 0x800D310 FORMAT "%.15" /end MEASUREMENT
/begin MEASUREMENT Meas_MCU_GpioIrqMaxCycles_u32 "" ULONG NO_COMPU_METHOD 0 0 0 4294967295 ECU_ADDRESS 0x800D318 FORMAT "%.15" /end MEASUREMENT
/begin MEASUREMENT Meas_MCU_IpcIrqLastCycles_u32 "" ULONG NO_COMPU_METHOD 0 0 0 4294967295 ECU_ADDRESS 0x800D320 FORMAT "%.15" /end MEASUREMENT
/begin MEASUREMENT Meas_MCU_IpcIrqLoad_pct_f32 "" FLOAT32_IEEE NO_COMPU_METHOD 0 0 -3.40282346639E+38 3.40282346639E+38 ECU_ADDRESS 0x800D31C FORMAT "%.15" /end MEASUREMENT
/begin MEASUREMENT Meas_MCU_IpcIrqMaxCycles_u32 "" ULONG NO_COMPU_METHOD 0 0 0 4294967295 ECU_ADDRESS 0x800D324 FORMAT "%.15" /end MEASUREMENT
/begin MEASUREMENT Meas_MCU_Reserve_pct_f32 "" FLOAT32_IEEE NO_COMPU_METHOD 0 0 -3.40282346639E+38 3.40282346639E+38 ECU_ADDRESS 0x800D344 FORMAT "%.15" /end MEASUREMENT
/begin MEASUREMENT Meas_MCU_RteTaskLastCycles_u32 "" ULONG NO_COMPU_METHOD 0 0 0 4294967295 ECU_ADDRESS 0x800D32C FORMAT "%.15" /end MEASUREMENT
/begin MEASUREMENT Meas_MCU_RteTaskLoad_pct_f32 "" FLOAT32_IEEE NO_COMPU_METHOD 0 0 -3.40282346639E+38 3.40282346639E+38 ECU_ADDRESS 0x800D328 FORMAT "%.15" /end MEASUREMENT
/begin MEASUREMENT Meas_MCU_RteTaskMaxCycles_u32 "" ULONG NO_COMPU_METHOD 0 0 0 4294967295 ECU_ADDRESS 0x800D330 FORMAT "%.15" /end MEASUREMENT
/begin MEASUREMENT Meas_MCU_Status_u8 "" UBYTE NO_COMPU_METHOD 0 0 0 255 ECU_ADDRESS 0x800D2E8 FORMAT "%.15" /end MEASUREMENT
/begin MEASUREMENT Meas_MCU_SysTickLastCycles_u32 "" ULONG NO_COMPU_METHOD 0 0 0 4294967295 ECU_ADDRESS 0x800D308 FORMAT "%.15" /end MEASUREMENT
/begin MEASUREMENT Meas_MCU_SysTickLoad_pct_f32 "" FLOAT32_IEEE NO_COMPU_METHOD 0 0 -3.40282346639E+38 3.40282346639E+38 ECU_ADDRESS 0x800D304 FORMAT "%.15" /end MEASUREMENT
/begin MEASUREMENT Meas_MCU_SysTickMaxCycles_u32 "" ULONG NO_COMPU_METHOD 0 0 0 4294967295 ECU_ADDRESS 0x800D30C FORMAT "%.15" /end MEASUREMENT
/begin MEASUREMENT Meas_MCU_Test500msTaskLastCycles_u32 "" ULONG NO_COMPU_METHOD 0 0 0 4294967295 ECU_ADDRESS 0x800D338 FORMAT "%.15" /end MEASUREMENT
/begin MEASUREMENT Meas_MCU_Test500msTaskLoad_pct_f32 "" FLOAT32_IEEE NO_COMPU_METHOD 0 0 -3.40282346639E+38 3.40282346639E+38 ECU_ADDRESS 0x800D334 FORMAT "%.15" /end MEASUREMENT
/begin MEASUREMENT Meas_MCU_Test500msTaskMaxCycles_u32 "" ULONG NO_COMPU_METHOD 0 0 0 4294967295 ECU_ADDRESS 0x800D33C FORMAT "%.15" /end MEASUREMENT
/begin MEASUREMENT Meas_MCU_TotalLoad_pct_f32 "" FLOAT32_IEEE NO_COMPU_METHOD 0 0 -3.40282346639E+38 3.40282346639E+38 ECU_ADDRESS 0x800D340 FORMAT "%.15" /end MEASUREMENT
/begin MEASUREMENT Meas_MCU_UpdateSeq_u32 "" ULONG NO_COMPU_METHOD 0 0 0 4294967295 ECU_ADDRESS 0x800D34C FORMAT "%.15" /end MEASUREMENT
/begin MEASUREMENT Meas_MCU_WindowCycles_u32 "" ULONG NO_COMPU_METHOD 0 0 0 4294967295 ECU_ADDRESS 0x800D348 FORMAT "%.15" /end MEASUREMENT
/begin MEASUREMENT Meas_PwrEst_Pcu_W_f32 "" FLOAT32_IEEE NO_COMPU_METHOD 0 0 -3.40282346639E+38 3.40282346639E+38 ECU_ADDRESS 0x800D218 FORMAT "%.15" /end MEASUREMENT
/begin MEASUREMENT Meas_PwrEst_Pdq_W_f32 "" FLOAT32_IEEE NO_COMPU_METHOD 0 0 -3.40282346639E+38 3.40282346639E+38 ECU_ADDRESS 0x800D214 FORMAT "%.15" /end MEASUREMENT
/begin MEASUREMENT Meas_PwrEst_Pfe_W_f32 "" FLOAT32_IEEE NO_COMPU_METHOD 0 0 -3.40282346639E+38 3.40282346639E+38 ECU_ADDRESS 0x800D21C FORMAT "%.15" /end MEASUREMENT
/begin MEASUREMENT Meas_PwrEst_PinvCond_W_f32 "" FLOAT32_IEEE NO_COMPU_METHOD 0 0 -3.40282346639E+38 3.40282346639E+38 ECU_ADDRESS 0x800D220 FORMAT "%.15" /end MEASUREMENT
/begin MEASUREMENT Meas_PwrEst_PinvSw_W_f32 "" FLOAT32_IEEE NO_COMPU_METHOD 0 0 -3.40282346639E+38 3.40282346639E+38 ECU_ADDRESS 0x800D224 FORMAT "%.15" /end MEASUREMENT
/begin MEASUREMENT Meas_PwrEst_Pout_W_f32 "" FLOAT32_IEEE NO_COMPU_METHOD 0 0 -3.40282346639E+38 3.40282346639E+38 ECU_ADDRESS 0x800D22C FORMAT "%.15" /end MEASUREMENT
/begin MEASUREMENT Meas_PwrEst_Ptotal_W_f32 "" FLOAT32_IEEE NO_COMPU_METHOD 0 0 -3.40282346639E+38 3.40282346639E+38 ECU_ADDRESS 0x800D228 FORMAT "%.15" /end MEASUREMENT
/begin MEASUREMENT Meas_RRCDOB_Act_u8 "" UBYTE NO_COMPU_METHOD 0 0 0 255 ECU_ADDRESS 0x800D385 FORMAT "%.15" /end MEASUREMENT
/begin MEASUREMENT Meas_RRCDOB_Freq_Hz_u16 "" UWORD NO_COMPU_METHOD 0 0 0 65535 ECU_ADDRESS 0x800D38A FORMAT "%.15" /end MEASUREMENT
/begin MEASUREMENT Meas_RRCDOB_Lead_us_u16 "" UWORD NO_COMPU_METHOD 0 0 0 65535 ECU_ADDRESS 0x800D394 /end MEASUREMENT
/begin MEASUREMENT Meas_RRCDOB_OutAct_u8 "" UBYTE NO_COMPU_METHOD 0 0 0 255 ECU_ADDRESS 0x800D386 FORMAT "%.15" /end MEASUREMENT
/begin MEASUREMENT Meas_RRCDOB_Pend_u8 "" UBYTE NO_COMPU_METHOD 0 0 0 255 ECU_ADDRESS 0x800D398 FORMAT "%.15" /end MEASUREMENT
/begin MEASUREMENT Meas_RRCDOB_Sat_u8 "" UBYTE NO_COMPU_METHOD 0 0 0 255 ECU_ADDRESS 0x800D389 FORMAT "%.15" /end MEASUREMENT
/begin MEASUREMENT Meas_RRCDOB_Sel_u8 "" UBYTE NO_COMPU_METHOD 0 0 0 255 ECU_ADDRESS 0x800D384 FORMAT "%.15" /end MEASUREMENT
/begin MEASUREMENT Meas_RRCDOB_Stat_u8 "" UBYTE NO_COMPU_METHOD 0 0 0 255 ECU_ADDRESS 0x800D388 FORMAT "%.15" /end MEASUREMENT
/begin MEASUREMENT Meas_RRCDOB_Valid_u8 "" UBYTE NO_COMPU_METHOD 0 0 0 255 ECU_ADDRESS 0x800D387 FORMAT "%.15" /end MEASUREMENT
/begin MEASUREMENT Meas_RRCDOB_VdHat_Q15_s16 "" SWORD NO_COMPU_METHOD 0 0 -32768 32767 ECU_ADDRESS 0x800D38C FORMAT "%.15" /end MEASUREMENT
/begin MEASUREMENT Meas_RRCDOB_VdOut_Q15_s16 "" SWORD NO_COMPU_METHOD 0 0 -32768 32767 ECU_ADDRESS 0x800D390 FORMAT "%.15" /end MEASUREMENT
/begin MEASUREMENT Meas_RRCDOB_VqHat_Q15_s16 "" SWORD NO_COMPU_METHOD 0 0 -32768 32767 ECU_ADDRESS 0x800D38E FORMAT "%.15" /end MEASUREMENT
/begin MEASUREMENT Meas_RRCDOB_VqOut_Q15_s16 "" SWORD NO_COMPU_METHOD 0 0 -32768 32767 ECU_ADDRESS 0x800D392 FORMAT "%.15" /end MEASUREMENT
/begin CHARACTERISTIC Meas_Rte_VoltUtilFlt_pct_f32 "" VALUE 0x800D24C __FLOAT32_IEEE_S 0 NO_COMPU_METHOD -3.40282346639E+38 3.40282346639E+38 FORMAT "%.15" /end CHARACTERISTIC
/begin CHARACTERISTIC Meas_Rte_VoltUtilLpfAlpha_f32 "" VALUE 0x800D250 __FLOAT32_IEEE_S 0 NO_COMPU_METHOD -3.40282346639E+38 3.40282346639E+38 FORMAT "%.15" /end CHARACTERISTIC
/begin CHARACTERISTIC Meas_Rte_VoltUtilRaw_pct_f32 "" VALUE 0x800D248 __FLOAT32_IEEE_S 0 NO_COMPU_METHOD -3.40282346639E+38 3.40282346639E+38 FORMAT "%.15" /end CHARACTERISTIC
/begin MEASUREMENT Meas_Rte_VoltUtilUpdCnt_u32 "" ULONG NO_COMPU_METHOD 0 0 0 4294967295 ECU_ADDRESS 0x800D254 FORMAT "%.15" /end MEASUREMENT
/begin CHARACTERISTIC P_MAX "" VALUE 0x8001174 __FLOAT32_IEEE_S 0 NO_COMPU_METHOD -3.40282346639E+38 3.40282346639E+38 FORMAT "%.15" /end CHARACTERISTIC
/begin MEASUREMENT XCP_CalibrationTest_Readback "Dedicated XCP calibration test value" UWORD NO_COMPU_METHOD 0 0 0 65535 ECU_ADDRESS 0x8000800 FORMAT "%5.0" /end MEASUREMENT
/begin CHARACTERISTIC XCP_CalibrationTest_Value "Writable M0 XCP calibration test value" VALUE 0x8000800 __UWORD_S 0 NO_COMPU_METHOD 0 65535 FORMAT "%5.0" SYMBOL_LINK "XcpM0Calibration.testValue" 0 /end CHARACTERISTIC
/begin CHARACTERISTIC XCP_M0_AccelerationTime "M0 acceleration time; increment ApplySequence to commit" VALUE 0x8000806 __UWORD_S 0 NO_COMPU_METHOD 0 65535 FORMAT "%.15" SYMBOL_LINK "XcpM0Calibration.accelerationTime" 0 /end CHARACTERISTIC
/begin MEASUREMENT XCP_M0_AppliedSequence "M0 calibration apply acknowledgement" UBYTE NO_COMPU_METHOD 0 0 0 255 ECU_ADDRESS 0x800080C FORMAT "%3.0" SYMBOL_LINK "XcpM0Calibration.appliedSequence" 0 /end MEASUREMENT
/begin CHARACTERISTIC XCP_M0_ApplySequence "Apply M0 calibration values" VALUE 0x800080B __UBYTE_S 0 NO_COMPU_METHOD 0 255 FORMAT "%.15" SYMBOL_LINK "XcpM0Calibration.applySequence" 0 /end CHARACTERISTIC
/begin CHARACTERISTIC XCP_M0_DecelerationTime "M0 deceleration time; increment ApplySequence to commit" VALUE 0x8000808 __UWORD_S 0 NO_COMPU_METHOD 0 65535 FORMAT "%.15" SYMBOL_LINK "XcpM0Calibration.decelerationTime" 0 /end CHARACTERISTIC
/begin CHARACTERISTIC XCP_M0_MotorEnable "M0 motor enable request; increment ApplySequence to commit" VALUE 0x800080A __UBYTE_S 0 NO_COMPU_METHOD 0 1 FORMAT "%.15" SYMBOL_LINK "XcpM0Calibration.motorEnable" 0 /end CHARACTERISTIC
/begin CHARACTERISTIC XCP_M0_MotorSpeedRpm "M0 motor speed request; increment ApplySequence to commit" VALUE 0x8000802 __UWORD_S 0 NO_COMPU_METHOD 0 8500 FORMAT "%.15" SYMBOL_LINK "XcpM0Calibration.motorSpeedRpm" 0 /end CHARACTERISTIC
/begin CHARACTERISTIC XCP_M0_PowerLimit "M0 motor power limit; increment ApplySequence to commit" VALUE 0x8000804 __UWORD_S 0 NO_COMPU_METHOD 0 65535 FORMAT "%.15" SYMBOL_LINK "XcpM0Calibration.powerLimit" 0 /end CHARACTERISTIC
/begin MEASUREMENT XCP_M4_ForceDutyAppliedSequence "M4 force-duty apply acknowledgement" SBYTE NO_COMPU_METHOD 0 0 0 255 BIT_MASK 0x1 ECU_ADDRESS 0x8008A7D FORMAT "%3.0" SYMBOL_LINK "FocDemoClosedLoop.modulator.p_forceDutyEnable" 0 /end MEASUREMENT
/begin CHARACTERISTIC XCP_M4_ForceDutyApplySequence "Apply M4 force-duty shadow values" VALUE 0x800D2BF __UBYTE_S 0 NO_COMPU_METHOD 0 255 FORMAT "%.15" SYMBOL_LINK "XcpM4Calibration.applySequence" 0 /end CHARACTERISTIC
/begin CHARACTERISTIC control_cmd.PtcRunCmd "" VALUE 0x800682C __UBYTE_S 0 NO_COMPU_METHOD 0 255 FORMAT "%.15" /end CHARACTERISTIC
/begin CHARACTERISTIC debug_info.PTC_Power "" VALUE 0x80062DA __UWORD_S 0 NO_COMPU_METHOD 0 65535 FORMAT "%.15" /end CHARACTERISTIC
/begin MEASUREMENT debug_info.Temp_COM_SIC "" UWORD temp 0 0 0 65535 ECU_ADDRESS 0x80062F2 FORMAT "%.15" /end MEASUREMENT
/begin MEASUREMENT debug_info.Temp_IN "" UWORD NO_COMPU_METHOD 0 0 0 65535 ECU_ADDRESS 0x80062F8 FORMAT "%.15" /end MEASUREMENT
/begin MEASUREMENT debug_info.Temp_M "" UWORD NO_COMPU_METHOD 0 0 0 65535 ECU_ADDRESS 0x80062F6 FORMAT "%.15" /end MEASUREMENT
/begin MEASUREMENT debug_info.Temp_OUT "" UWORD NO_COMPU_METHOD 0 0 0 65535 ECU_ADDRESS 0x80062FA FORMAT "%.15" /end MEASUREMENT
/begin MEASUREMENT debug_info.Temp_PCB "" UWORD temp 0 0 0 65535 ECU_ADDRESS 0x80062F4 FORMAT "%.15" /end MEASUREMENT
/begin MEASUREMENT debug_info.Temp_PTC_SIC "" UWORD NO_COMPU_METHOD 0 0 0 65535 ECU_ADDRESS 0x80062F0 FORMAT "%.15" /end MEASUREMENT
/begin MEASUREMENT debug_info.fault_status_flag_motor.Word "" ULONG NO_COMPU_METHOD 0 0 0 4294967295 ECU_ADDRESS 0x8006308 FORMAT "%.15" /end MEASUREMENT
/begin MEASUREMENT debug_info.fault_status_flag_motor.bit.BusOff "" UBYTE NO_COMPU_METHOD 0 0 0 1 BIT_MASK 0x1 ECU_ADDRESS 0x8006308 FORMAT "%.15" /end MEASUREMENT
/begin MEASUREMENT debug_info.fault_status_flag_motor.bit.CurrentUnbalance "" UBYTE NO_COMPU_METHOD 0 0 0 1 BIT_MASK 0x1 ECU_ADDRESS 0x8006308 FORMAT "%.15" /end MEASUREMENT
/begin MEASUREMENT debug_info.fault_status_flag_motor.bit.ERR_OUTCAN "" UBYTE NO_COMPU_METHOD 0 0 0 1 BIT_MASK 0x1 ECU_ADDRESS 0x8006308 FORMAT "%.15" /end MEASUREMENT
/begin MEASUREMENT debug_info.fault_status_flag_motor.bit.OcFault "" UBYTE NO_COMPU_METHOD 0 0 0 1 BIT_MASK 0x1 ECU_ADDRESS 0x8006308 FORMAT "%.15" /end MEASUREMENT
/begin MEASUREMENT debug_info.fault_status_flag_motor.bit.OffsetError "" UBYTE NO_COMPU_METHOD 0 0 0 1 BIT_MASK 0x1 ECU_ADDRESS 0x8006308 FORMAT "%.15" /end MEASUREMENT
/begin MEASUREMENT debug_info.fault_status_flag_motor.bit.OvBusCurrent "" UBYTE NO_COMPU_METHOD 0 0 0 1 BIT_MASK 0x1 ECU_ADDRESS 0x8006308 FORMAT "%.15" /end MEASUREMENT
/begin MEASUREMENT debug_info.fault_status_flag_motor.bit.OvFault "" UBYTE NO_COMPU_METHOD 0 0 0 1 BIT_MASK 0x1 ECU_ADDRESS 0x8006308 FORMAT "%.15" /end MEASUREMENT
/begin MEASUREMENT debug_info.fault_status_flag_motor.bit.OvFaultLow "" UBYTE NO_COMPU_METHOD 0 0 0 1 BIT_MASK 0x1 ECU_ADDRESS 0x8006308 FORMAT "%.15" /end MEASUREMENT
/begin MEASUREMENT debug_info.fault_status_flag_motor.bit.OvLoadFault "" UBYTE NO_COMPU_METHOD 0 0 0 1 BIT_MASK 0x1 ECU_ADDRESS 0x8006308 FORMAT "%.15" /end MEASUREMENT
/begin MEASUREMENT debug_info.fault_status_flag_motor.bit.OvSoftRmsCurrent "" UBYTE NO_COMPU_METHOD 0 0 0 1 BIT_MASK 0x1 ECU_ADDRESS 0x8006308 FORMAT "%.15" /end MEASUREMENT
/begin MEASUREMENT debug_info.fault_status_flag_motor.bit.OvSoftwarePeakCurrent "" UBYTE NO_COMPU_METHOD 0 0 0 1 BIT_MASK 0x1 ECU_ADDRESS 0x8006308 FORMAT "%.15" /end MEASUREMENT
/begin MEASUREMENT debug_info.fault_status_flag_motor.bit.OvTemp "" UBYTE NO_COMPU_METHOD 0 0 0 1 BIT_MASK 0x1 ECU_ADDRESS 0x8006308 FORMAT "%.15" /end MEASUREMENT
/begin MEASUREMENT debug_info.fault_status_flag_motor.bit.PowerOverFault "" UBYTE NO_COMPU_METHOD 0 0 0 1 BIT_MASK 0x1 ECU_ADDRESS 0x8006308 FORMAT "%.15" /end MEASUREMENT
/begin MEASUREMENT debug_info.fault_status_flag_motor.bit.StallDetected "" UBYTE NO_COMPU_METHOD 0 0 0 1 BIT_MASK 0x1 ECU_ADDRESS 0x8006308 FORMAT "%.15" /end MEASUREMENT
/begin MEASUREMENT debug_info.fault_status_flag_motor.bit.UvFault "" UBYTE NO_COMPU_METHOD 0 0 0 1 BIT_MASK 0x1 ECU_ADDRESS 0x8006308 FORMAT "%.15" /end MEASUREMENT
/begin MEASUREMENT debug_info.fault_status_flag_motor.bit.UvFaultLow "" UBYTE NO_COMPU_METHOD 0 0 0 1 BIT_MASK 0x1 ECU_ADDRESS 0x8006308 FORMAT "%.15" /end MEASUREMENT
/begin MEASUREMENT debug_info.fault_status_flag_motor.bit.speedFault "" UBYTE NO_COMPU_METHOD 0 0 0 1 BIT_MASK 0x1 ECU_ADDRESS 0x8006308 FORMAT "%.15" /end MEASUREMENT
/begin MEASUREMENT debug_info.pVdcValue "" UWORD NO_COMPU_METHOD 0 0 0 65535 ECU_ADDRESS 0x80062D8 FORMAT "%.15" /end MEASUREMENT
/begin MEASUREMENT m4_set_data.motor_power.value "" ULONG NO_COMPU_METHOD 0 0 0 2147483647 BIT_MASK 0x7FFFFFFF ECU_ADDRESS 0x800924C FORMAT "%.15" /end MEASUREMENT
/begin MEASUREMENT s_task_tick "" ULONG NO_COMPU_METHOD 0 0 0 4294967295 ECU_ADDRESS 0x80092DC FORMAT "%.15" /end MEASUREMENT
/begin COMPU_METHOD FocDemoClosedLoop.bridgeDrvTLE9563.p_clrFaultsStep.CONVERSION "enumeration table" TAB_VERB "%.0" "" COMPU_TAB_REF FocDemoClosedLoop.bridgeDrvTLE9563.p_clrFaultsStep.CONVERSION /end COMPU_METHOD
/begin COMPU_METHOD Foc_Q15_to_A "FOC Q15 normalized current to ampere" LINEAR "%8.3" "A" COEFFS_LINEAR 0.00152587890625 0 /end COMPU_METHOD
/begin COMPU_METHOD Foc_Q15_to_V "FOC Q15 normalized voltage to volt" LINEAR "%8.3" "V" COEFFS_LINEAR 0.030517578125 0 /end COMPU_METHOD
/begin COMPU_METHOD Foc_Q15_to_radps "FOC Q15 normalized electrical speed to rad/s" LINEAR "%8.3" "rad/s" COEFFS_LINEAR 0.108642578125 0 /end COMPU_METHOD
/begin COMPU_METHOD Foc_Q15_to_rpm "FOC Q15 normalized mechanical speed to rpm" LINEAR "%8.1" "rpm" COEFFS_LINEAR 0.3052 0 /end COMPU_METHOD
/begin COMPU_METHOD Foc_Q32_to_rad "FOC Q32 angle index to radian" LINEAR "%8.3" "rad" COEFFS_LINEAR 1.46291807927E-09 0 /end COMPU_METHOD
/begin COMPU_METHOD Foc_Q32_to_rpss "" LINEAR "%6.3" "" COEFFS_LINEAR 0.0186 0 /end COMPU_METHOD
/begin COMPU_METHOD IdMap_Q15_to_Alpha "IdMap Q15 low-pass alpha" LINEAR "%7.4" "" COEFFS_LINEAR 3.0517578125E-05 0 /end COMPU_METHOD
/begin COMPU_METHOD Ifx_MAS_ModulatorF16_State "enumeration table" TAB_VERB "%.0" "" COMPU_TAB_REF Ifx_MAS_ModulatorF16_State /end COMPU_METHOD
/begin COMPU_METHOD Ifx_MAS_ModulatorF16_State.OLD_Copy1 "" TAB_VERB "%6.3" "" COMPU_TAB_REF Ifx_MAS_ModulatorF16_State.OLD_1 /end COMPU_METHOD
/begin COMPU_METHOD Ifx_MHA_BridgeDrv_TLE9563_State "enumeration table" TAB_VERB "%.0" "" COMPU_TAB_REF Ifx_MHA_BridgeDrv_TLE9563_State /end COMPU_METHOD
/begin COMPU_METHOD Ifx_MHA_BridgeDrv_TLE9563_State.OLD_Copy1 "" TAB_VERB "%6.3" "" COMPU_TAB_REF Ifx_MHA_BridgeDrv_TLE9563_State.OLD_1 /end COMPU_METHOD
/begin COMPU_METHOD Ifx_MHA_MeasurementADC_CYT2B7_State "enumeration table" TAB_VERB "%.0" "" COMPU_TAB_REF Ifx_MHA_MeasurementADC_CYT2B7_State /end COMPU_METHOD
/begin COMPU_METHOD Ifx_MHA_MeasurementADC_CYT2B7_State.OLD_Copy1 "" TAB_VERB "%6.3" "" COMPU_TAB_REF Ifx_MHA_MeasurementADC_CYT2B7_State.OLD_1 /end COMPU_METHOD
/begin COMPU_METHOD Ifx_MHA_MeasurementADC_CYT2B7_optionCsaGain "enumeration table" TAB_VERB "%.0" "" COMPU_TAB_REF Ifx_MHA_MeasurementADC_CYT2B7_optionCsaGain /end COMPU_METHOD
/begin COMPU_METHOD Ifx_MHA_MeasurementADC_CYT2B7_optionCsaGain.OLD_Copy1 "" TAB_VERB "%6.3" "" COMPU_TAB_REF Ifx_MHA_MeasurementADC_CYT2B7_optionCsaGain.OLD_1 /end COMPU_METHOD
/begin COMPU_METHOD Ifx_MHA_PatternGen_CYT2B7_State "enumeration table" TAB_VERB "%.0" "" COMPU_TAB_REF Ifx_MHA_PatternGen_CYT2B7_State /end COMPU_METHOD
/begin COMPU_METHOD Ifx_MHA_PatternGen_CYT2B7_State.OLD_Copy1 "" TAB_VERB "%6.3" "" COMPU_TAB_REF Ifx_MHA_PatternGen_CYT2B7_State.OLD_1 /end COMPU_METHOD
/begin COMPU_METHOD Ifx_MS_FocSolutionF16_ControlMode "enumeration table" TAB_VERB "%.0" "" COMPU_TAB_REF Ifx_MS_FocSolutionF16_ControlMode /end COMPU_METHOD
/begin COMPU_METHOD Ifx_MS_FocSolutionF16_ControlMode.OLD_Copy1 "" TAB_VERB "%6.3" "" COMPU_TAB_REF Ifx_MS_FocSolutionF16_ControlMode.OLD_1 /end COMPU_METHOD
/begin COMPU_METHOD Ifx_MS_FocSolutionF16_State "enumeration table" TAB_VERB "%.0" "" COMPU_TAB_REF Ifx_MS_FocSolutionF16_State /end COMPU_METHOD
/begin COMPU_METHOD Ifx_MS_FocSolutionF16_State.OLD_Copy1 "" TAB_VERB "%6.3" "" COMPU_TAB_REF Ifx_MS_FocSolutionF16_State.OLD_1 /end COMPU_METHOD
/begin COMPU_METHOD Ifx_MS_FocSolutionF16_SubState "enumeration table" TAB_VERB "%.0" "" COMPU_TAB_REF Ifx_MS_FocSolutionF16_SubState /end COMPU_METHOD
/begin COMPU_METHOD Ifx_MS_FocSolutionF16_SubState.OLD_Copy1 "" TAB_VERB "%6.3" "" COMPU_TAB_REF Ifx_MS_FocSolutionF16_SubState.OLD_1 /end COMPU_METHOD
/begin COMPU_METHOD Table_0 "" TAB_VERB "%6.3" "" COMPU_TAB_REF Table_0 /end COMPU_METHOD
/begin COMPU_METHOD Table_0._Copy1 "" TAB_VERB "%6.3" "" COMPU_TAB_REF Table_0._Copy1 /end COMPU_METHOD
/begin COMPU_METHOD temp "" FORM "%6.3" "" /begin FORMULA "x-40" /end FORMULA /end COMPU_METHOD
/begin COMPU_VTAB_RANGE FocDemoClosedLoop.bridgeDrvTLE9563.p_clrFaultsStep.CONVERSION "" 3 0 0 "Ifx_MHA_BridgeDrv_TLE9563_clrFaultsWaitProc" 1 1 "Ifx_MHA_BridgeDrv_TLE9563_clrFaultsInitCounter" 2 2 "Ifx_MHA_BridgeDrv_TLE9563_clrFaultsWaitCounter" DEFAULT_VALUE "" /end COMPU_VTAB_RANGE
/begin COMPU_VTAB_RANGE Ifx_MAS_ModulatorF16_State "" 5 0 0 "Ifx_MAS_ModulatorF16_State_init" 1 1 "Ifx_MAS_ModulatorF16_State_off" 2 2 "Ifx_MAS_ModulatorF16_State_on" 3 3 "Ifx_MAS_ModulatorF16_State_fault" 4 4 "Ifx_MAS_ModulatorF16_State_brake" DEFAULT_VALUE "" /end COMPU_VTAB_RANGE
/begin COMPU_VTAB Ifx_MAS_ModulatorF16_State.OLD_1 "" TAB_VERB 5 0 "Ifx_MAS_ModulatorF16_State_init" 1 "Ifx_MAS_ModulatorF16_State_off" 2 "Ifx_MAS_ModulatorF16_State_on" 3 "Ifx_MAS_ModulatorF16_State_fault" 4 "Ifx_MAS_ModulatorF16_State_brake" DEFAULT_VALUE "" /end COMPU_VTAB
/begin COMPU_VTAB Ifx_MAS_ModulatorF16_State._Copy1 "" TAB_VERB 5 0 "Ifx_MAS_ModulatorF16_State_init" 1 "Ifx_MAS_ModulatorF16_State_off" 2 "Ifx_MAS_ModulatorF16_State_on" 3 "Ifx_MAS_ModulatorF16_State_fault" 4 "Ifx_MAS_ModulatorF16_State_brake" DEFAULT_VALUE "" /end COMPU_VTAB
/begin COMPU_VTAB_RANGE Ifx_MHA_BridgeDrv_TLE9563_State "" 4 0 0 "Ifx_MHA_BridgeDrv_TLE9563_State_init" 1 1 "Ifx_MHA_BridgeDrv_TLE9563_State_off" 2 2 "Ifx_MHA_BridgeDrv_TLE9563_State_on" 3 3 "Ifx_MHA_BridgeDrv_TLE9563_State_fault" DEFAULT_VALUE "" /end COMPU_VTAB_RANGE
/begin COMPU_VTAB Ifx_MHA_BridgeDrv_TLE9563_State.OLD_1 "" TAB_VERB 4 0 "Ifx_MHA_BridgeDrv_TLE9563_State_init" 1 "Ifx_MHA_BridgeDrv_TLE9563_State_off" 2 "Ifx_MHA_BridgeDrv_TLE9563_State_on" 3 "Ifx_MHA_BridgeDrv_TLE9563_State_fault" DEFAULT_VALUE "" /end COMPU_VTAB
/begin COMPU_VTAB Ifx_MHA_BridgeDrv_TLE9563_State._Copy1 "" TAB_VERB 4 0 "Ifx_MHA_BridgeDrv_TLE9563_State_init" 1 "Ifx_MHA_BridgeDrv_TLE9563_State_off" 2 "Ifx_MHA_BridgeDrv_TLE9563_State_on" 3 "Ifx_MHA_BridgeDrv_TLE9563_State_fault" DEFAULT_VALUE "" /end COMPU_VTAB
/begin COMPU_VTAB_RANGE Ifx_MHA_MeasurementADC_CYT2B7_State "" 4 0 0 "Ifx_MHA_MeasurementADC_CYT2B7_State_init" 1 1 "Ifx_MHA_MeasurementADC_CYT2B7_State_off" 2 2 "Ifx_MHA_MeasurementADC_CYT2B7_State_on" 3 3 "Ifx_MHA_MeasurementADC_CYT2B7_State_calibration" DEFAULT_VALUE "" /end COMPU_VTAB_RANGE
/begin COMPU_VTAB Ifx_MHA_MeasurementADC_CYT2B7_State.OLD_1 "" TAB_VERB 4 0 "Ifx_MHA_MeasurementADC_CYT2B7_State_init" 1 "Ifx_MHA_MeasurementADC_CYT2B7_State_off" 2 "Ifx_MHA_MeasurementADC_CYT2B7_State_on" 3 "Ifx_MHA_MeasurementADC_CYT2B7_State_calibration" DEFAULT_VALUE "" /end COMPU_VTAB
/begin COMPU_VTAB Ifx_MHA_MeasurementADC_CYT2B7_State._Copy1 "" TAB_VERB 4 0 "Ifx_MHA_MeasurementADC_CYT2B7_State_init" 1 "Ifx_MHA_MeasurementADC_CYT2B7_State_off" 2 "Ifx_MHA_MeasurementADC_CYT2B7_State_on" 3 "Ifx_MHA_MeasurementADC_CYT2B7_State_calibration" DEFAULT_VALUE "" /end COMPU_VTAB
/begin COMPU_VTAB_RANGE Ifx_MHA_MeasurementADC_CYT2B7_optionCsaGain "" 4 0 0 "Ifx_MHA_MeasurementADC_CYT2B7_optionCsaGain_10" 1 1 "Ifx_MHA_MeasurementADC_CYT2B7_optionCsaGain_20" 2 2 "Ifx_MHA_MeasurementADC_CYT2B7_optionCsaGain_40" 3 3 "Ifx_MHA_MeasurementADC_CYT2B7_optionCsaGain_60" DEFAULT_VALUE "" /end COMPU_VTAB_RANGE
/begin COMPU_VTAB Ifx_MHA_MeasurementADC_CYT2B7_optionCsaGain.OLD_1 "" TAB_VERB 4 0 "Ifx_MHA_MeasurementADC_CYT2B7_optionCsaGain_10" 1 "Ifx_MHA_MeasurementADC_CYT2B7_optionCsaGain_20" 2 "Ifx_MHA_MeasurementADC_CYT2B7_optionCsaGain_40" 3 "Ifx_MHA_MeasurementADC_CYT2B7_optionCsaGain_60" DEFAULT_VALUE "" /end COMPU_VTAB
/begin COMPU_VTAB Ifx_MHA_MeasurementADC_CYT2B7_optionCsaGain._Copy1 "" TAB_VERB 4 0 "Ifx_MHA_MeasurementADC_CYT2B7_optionCsaGain_10" 1 "Ifx_MHA_MeasurementADC_CYT2B7_optionCsaGain_20" 2 "Ifx_MHA_MeasurementADC_CYT2B7_optionCsaGain_40" 3 "Ifx_MHA_MeasurementADC_CYT2B7_optionCsaGain_60" DEFAULT_VALUE "" /end COMPU_VTAB
/begin COMPU_VTAB_RANGE Ifx_MHA_PatternGen_CYT2B7_State "" 4 0 0 "Ifx_MHA_PatternGen_CYT2B7_State_init" 1 1 "Ifx_MHA_PatternGen_CYT2B7_State_off" 2 2 "Ifx_MHA_PatternGen_CYT2B7_State_on" 3 3 "Ifx_MHA_PatternGen_CYT2B7_State_fault" DEFAULT_VALUE "" /end COMPU_VTAB_RANGE
/begin COMPU_VTAB Ifx_MHA_PatternGen_CYT2B7_State.OLD_1 "" TAB_VERB 4 0 "Ifx_MHA_PatternGen_CYT2B7_State_init" 1 "Ifx_MHA_PatternGen_CYT2B7_State_off" 2 "Ifx_MHA_PatternGen_CYT2B7_State_on" 3 "Ifx_MHA_PatternGen_CYT2B7_State_fault" DEFAULT_VALUE "" /end COMPU_VTAB
/begin COMPU_VTAB Ifx_MHA_PatternGen_CYT2B7_State._Copy1 "" TAB_VERB 4 0 "Ifx_MHA_PatternGen_CYT2B7_State_init" 1 "Ifx_MHA_PatternGen_CYT2B7_State_off" 2 "Ifx_MHA_PatternGen_CYT2B7_State_on" 3 "Ifx_MHA_PatternGen_CYT2B7_State_fault" DEFAULT_VALUE "" /end COMPU_VTAB
/begin COMPU_VTAB_RANGE Ifx_MS_FocSolutionF16_ControlMode "" 2 0 0 "Ifx_MS_FocSolutionF16_ControlMode_vToF" 1 1 "Ifx_MS_FocSolutionF16_ControlMode_foc" DEFAULT_VALUE "" /end COMPU_VTAB_RANGE
/begin COMPU_VTAB Ifx_MS_FocSolutionF16_ControlMode.OLD_1 "" TAB_VERB 2 0 "Ifx_MS_FocSolutionF16_ControlMode_vToF" 1 "Ifx_MS_FocSolutionF16_ControlMode_foc" DEFAULT_VALUE "" /end COMPU_VTAB
/begin COMPU_VTAB Ifx_MS_FocSolutionF16_ControlMode._Copy1 "" TAB_VERB 2 0 "Ifx_MS_FocSolutionF16_ControlMode_vToF" 1 "Ifx_MS_FocSolutionF16_ControlMode_foc" DEFAULT_VALUE "" /end COMPU_VTAB
/begin COMPU_VTAB_RANGE Ifx_MS_FocSolutionF16_State "" 7 0 0 "Ifx_MS_FocSolutionF16_State_init" 1 1 "Ifx_MS_FocSolutionF16_State_off" 2 2 "Ifx_MS_FocSolutionF16_State_standBy" 3 3 "Ifx_MS_FocSolutionF16_State_fault" 4 4 "Ifx_MS_FocSolutionF16_State_run" 5 5 "Ifx_MS_FocSolutionF16_State_rampDown" 6 6 "Ifx_MS_FocSolutionF16_State_startAngleIdent" DEFAULT_VALUE "" /end COMPU_VTAB_RANGE
/begin COMPU_VTAB Ifx_MS_FocSolutionF16_State.OLD_1 "" TAB_VERB 7 0 "Ifx_MS_FocSolutionF16_State_init" 1 "Ifx_MS_FocSolutionF16_State_off" 2 "Ifx_MS_FocSolutionF16_State_standBy" 3 "Ifx_MS_FocSolutionF16_State_fault" 4 "Ifx_MS_FocSolutionF16_State_run" 5 "Ifx_MS_FocSolutionF16_State_rampDown" 6 "Ifx_MS_FocSolutionF16_State_startAngleIdent" DEFAULT_VALUE "" /end COMPU_VTAB
/begin COMPU_VTAB Ifx_MS_FocSolutionF16_State._Copy1 "" TAB_VERB 7 0 "Ifx_MS_FocSolutionF16_State_init" 1 "Ifx_MS_FocSolutionF16_State_off" 2 "Ifx_MS_FocSolutionF16_State_standBy" 3 "Ifx_MS_FocSolutionF16_State_fault" 4 "Ifx_MS_FocSolutionF16_State_run" 5 "Ifx_MS_FocSolutionF16_State_rampDown" 6 "Ifx_MS_FocSolutionF16_State_startAngleIdent" DEFAULT_VALUE "" /end COMPU_VTAB
/begin COMPU_VTAB_RANGE Ifx_MS_FocSolutionF16_SubState "" 4 0 0 "Ifx_MS_FocSolutionF16_SubState_openLoop" 1 1 "Ifx_MS_FocSolutionF16_SubState_transitionUp" 2 2 "Ifx_MS_FocSolutionF16_SubState_closedLoop" 3 3 "Ifx_MS_FocSolutionF16_SubState_transitionDown" DEFAULT_VALUE "" /end COMPU_VTAB_RANGE
/begin COMPU_VTAB Ifx_MS_FocSolutionF16_SubState.OLD_1 "" TAB_VERB 4 0 "Ifx_MS_FocSolutionF16_SubState_openLoop" 1 "Ifx_MS_FocSolutionF16_SubState_transitionUp" 2 "Ifx_MS_FocSolutionF16_SubState_closedLoop" 3 "Ifx_MS_FocSolutionF16_SubState_transitionDown" DEFAULT_VALUE "" /end COMPU_VTAB
/begin COMPU_VTAB Ifx_MS_FocSolutionF16_SubState._Copy1 "" TAB_VERB 4 0 "Ifx_MS_FocSolutionF16_SubState_openLoop" 1 "Ifx_MS_FocSolutionF16_SubState_transitionUp" 2 "Ifx_MS_FocSolutionF16_SubState_closedLoop" 3 "Ifx_MS_FocSolutionF16_SubState_transitionDown" DEFAULT_VALUE "" /end COMPU_VTAB
/begin COMPU_VTAB Table_0 "" TAB_VERB 3 0 "Ifx_MHA_BridgeDrv_TLE9563_clrFaultsWaitProc" 1 "Ifx_MHA_BridgeDrv_TLE9563_clrFaultsInitCounter" 2 "Ifx_MHA_BridgeDrv_TLE9563_clrFaultsWaitCounter" DEFAULT_VALUE "" /end COMPU_VTAB
/begin COMPU_VTAB Table_0._Copy1 "" TAB_VERB 3 0 "Ifx_MHA_BridgeDrv_TLE9563_clrFaultsWaitProc" 1 "Ifx_MHA_BridgeDrv_TLE9563_clrFaultsInitCounter" 2 "Ifx_MHA_BridgeDrv_TLE9563_clrFaultsWaitCounter" DEFAULT_VALUE "" /end COMPU_VTAB
/begin RECORD_LAYOUT SSV__A_INT64_S AXIS_PTS_X 1 A_INT64 INDEX_INCR DIRECT /end RECORD_LAYOUT
/begin RECORD_LAYOUT SSV__A_UINT64_S AXIS_PTS_X 1 A_UINT64 INDEX_INCR DIRECT /end RECORD_LAYOUT
/begin RECORD_LAYOUT SSV__FLOAT32_IEEE_S AXIS_PTS_X 1 FLOAT32_IEEE INDEX_INCR DIRECT /end RECORD_LAYOUT
/begin RECORD_LAYOUT SSV__FLOAT64_IEEE_S AXIS_PTS_X 1 FLOAT64_IEEE INDEX_INCR DIRECT /end RECORD_LAYOUT
/begin RECORD_LAYOUT SSV__SBYTE_S AXIS_PTS_X 1 SBYTE INDEX_INCR DIRECT /end RECORD_LAYOUT
/begin RECORD_LAYOUT SSV__SLONG_S AXIS_PTS_X 1 SLONG INDEX_INCR DIRECT /end RECORD_LAYOUT
/begin RECORD_LAYOUT SSV__SWORD_S AXIS_PTS_X 1 SWORD INDEX_INCR DIRECT /end RECORD_LAYOUT
/begin RECORD_LAYOUT SSV__UBYTE_S AXIS_PTS_X 1 UBYTE INDEX_INCR DIRECT /end RECORD_LAYOUT
/begin RECORD_LAYOUT SSV__ULONG_S AXIS_PTS_X 1 ULONG INDEX_INCR DIRECT /end RECORD_LAYOUT
/begin RECORD_LAYOUT SSV__UWORD_S AXIS_PTS_X 1 UWORD INDEX_INCR DIRECT /end RECORD_LAYOUT
/begin RECORD_LAYOUT __A_INT64_S FNC_VALUES 1 A_INT64 COLUMN_DIR DIRECT /end RECORD_LAYOUT
/begin RECORD_LAYOUT __A_INT64_Z FNC_VALUES 1 A_INT64 ROW_DIR DIRECT /end RECORD_LAYOUT
/begin RECORD_LAYOUT __A_UINT64_S FNC_VALUES 1 A_UINT64 COLUMN_DIR DIRECT /end RECORD_LAYOUT
/begin RECORD_LAYOUT __A_UINT64_Z FNC_VALUES 1 A_UINT64 ROW_DIR DIRECT /end RECORD_LAYOUT
/begin RECORD_LAYOUT __FLOAT32_IEEE_S FNC_VALUES 1 FLOAT32_IEEE COLUMN_DIR DIRECT /end RECORD_LAYOUT
/begin RECORD_LAYOUT __FLOAT32_IEEE_Z FNC_VALUES 1 FLOAT32_IEEE ROW_DIR DIRECT /end RECORD_LAYOUT
/begin RECORD_LAYOUT __FLOAT64_IEEE_S FNC_VALUES 1 FLOAT64_IEEE COLUMN_DIR DIRECT /end RECORD_LAYOUT
/begin RECORD_LAYOUT __FLOAT64_IEEE_Z FNC_VALUES 1 FLOAT64_IEEE ROW_DIR DIRECT /end RECORD_LAYOUT
/begin RECORD_LAYOUT __SBYTE_S FNC_VALUES 1 SBYTE COLUMN_DIR DIRECT /end RECORD_LAYOUT
/begin RECORD_LAYOUT __SBYTE_Z FNC_VALUES 1 SBYTE ROW_DIR DIRECT /end RECORD_LAYOUT
/begin RECORD_LAYOUT __SLONG_S FNC_VALUES 1 SLONG COLUMN_DIR DIRECT /end RECORD_LAYOUT
/begin RECORD_LAYOUT __SLONG_Z FNC_VALUES 1 SLONG ROW_DIR DIRECT /end RECORD_LAYOUT
/begin RECORD_LAYOUT __SWORD_S FNC_VALUES 1 SWORD COLUMN_DIR DIRECT /end RECORD_LAYOUT
/begin RECORD_LAYOUT __SWORD_Z FNC_VALUES 1 SWORD ROW_DIR DIRECT /end RECORD_LAYOUT
/begin RECORD_LAYOUT __UBYTE_S FNC_VALUES 1 UBYTE COLUMN_DIR DIRECT /end RECORD_LAYOUT
/begin RECORD_LAYOUT __UBYTE_Z FNC_VALUES 1 UBYTE ROW_DIR DIRECT /end RECORD_LAYOUT
/begin RECORD_LAYOUT __ULONG_S FNC_VALUES 1 ULONG COLUMN_DIR DIRECT /end RECORD_LAYOUT
/begin RECORD_LAYOUT __ULONG_Z FNC_VALUES 1 ULONG ROW_DIR DIRECT /end RECORD_LAYOUT
/begin RECORD_LAYOUT __UWORD_S FNC_VALUES 1 UWORD COLUMN_DIR DIRECT /end RECORD_LAYOUT
/begin RECORD_LAYOUT __UWORD_Z FNC_VALUES 1 UWORD ROW_DIR DIRECT /end RECORD_LAYOUT
/end MODULE
/end PROJECT
